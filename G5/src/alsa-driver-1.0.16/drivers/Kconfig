## G5/src/tchitcha-sources-2.6.23.17.125.71_p32-r1/arch/sh/Kconfig
```kconfig
#
# For a description of the syntax of this configuration file,
# see Documentation/kbuild/kconfig-language.txt.
#

mainmenu "Linux/SuperH Kernel Configuration"

config SUPERH
	bool
	default y
	select EMBEDDED
	help
	  The SuperH is a RISC processor targeted for use in embedded systems
	  and consumer electronics; it was also used in the Sega Dreamcast
	  gaming console.  The SuperH port has a home page at
	  <http://www.linux-sh.org/>.

config REBOOT_ON_PANIC
	bool "Reboot on PANIC"
	default n

config REBOOT_ON_OOM
	bool "Reboot on OOM"
	default n

config REBOOT_ON_OOPS
	bool "Reboot on OOPS"
	default n

config REBOOT_ON_SIGNAL
	bool "Reboot on SIGBUS or SIGSEGV (EXPERIMENTAL)"
	default n

config RWSEM_GENERIC_SPINLOCK
	bool
	default y

config RWSEM_XCHGADD_ALGORITHM
	bool

config GENERIC_BUG
	def_bool y
	depends on BUG

config GENERIC_FIND_NEXT_BIT
	bool
	default y

config GENERIC_GPIO
	def_bool n

config GENERIC_HWEIGHT
	bool
	default y

config GENERIC_HARDIRQS
	bool
	default y

config GENERIC_IRQ_PROBE
	bool
	default y

config GENERIC_IOMAP
	bool
	default n

config GENERIC_TIME
	def_bool n

config GENERIC_CLOCKEVENTS
	def_bool n

config SYS_SUPPORTS_PM
	bool
	default y

config SYS_SUPPORTS_APM_EMULATION
	bool
	select SYS_SUPPORTS_PM

config SYS_SUPPORTS_SMP
	bool

config SYS_SUPPORTS_NUMA
	bool

config SYS_SUPPORTS_PCI
	bool

config ARCH_MAY_HAVE_PC_FDC
	bool

config STACKTRACE_SUPPORT
	bool
	default y

config LOCKDEP_SUPPORT
	bool
	default y

config ARCH_HAS_ILOG2_U32
	bool
	default n

config ARCH_HAS_ILOG2_U64
	bool
	default n

config ARCH_NO_VIRT_TO_BUS
	def_bool y

config ARCH_SUPPORTS_LTT_CLOCK
	def_bool y

config ARCH_NEEDS_LTT_SYNTHETIC_TSC
	def_bool y

source "init/Kconfig"

menu "System type"

source "arch/sh/mm/Kconfig"

menu "Processor features"

choice
	prompt "Endianess selection" 
	default CPU_LITTLE_ENDIAN
	help
	  Some SuperH machines can be configured for either little or big
	  endian byte order. These modes require different kernels.

config CPU_LITTLE_ENDIAN
	bool "Little Endian"

config CPU_BIG_ENDIAN
	bool "Big Endian"

endchoice

config SH_FPU
	bool "FPU support"
	depends on CPU_HAS_FPU
	default y
	help
	  Selecting this option will enable support for SH processors that
	  have FPU units (ie, SH77xx).

	  This option must be set in order to enable the FPU.

config SH_FPU_EMU
	bool "FPU emulation support"
	depends on !SH_FPU && EXPERIMENTAL
	default n
	help
	  Selecting this option will enable support for software FPU emulation.
	  Most SH-3 users will want to say Y here, whereas most SH-4 users will
	  want to say N.

config SH_DSP
	bool "DSP support"
	depends on CPU_HAS_DSP
	default y
	help
	  Selecting this option will enable support for SH processors that
	  have DSP units (ie, SH2-DSP, SH3-DSP, and SH4AL-DSP).

	  This option must be set in order to enable the DSP.

config SH_ADC
	bool "ADC support"
	depends on CPU_SH3
	default y
	help
	  Selecting this option will allow the Linux kernel to use SH3 on-chip
	  ADC module.

	  If unsure, say N.

config SH_STORE_QUEUES
	bool "Support for Store Queues"
	depends on CPU_SH4
	help
	  Selecting this option will enable an in-kernel API for manipulating
	  the store queues integrated in the SH-4 processors.

config SPECULATIVE_EXECUTION
	bool "Speculative subroutine return"
	depends on CPU_SUBTYPE_SH7780 && EXPERIMENTAL
	help
	  This enables support for a speculative instruction fetch for
	  subroutine return. There are various pitfalls associated with
	  this, as outlined in the SH7780 hardware manual.

	  If unsure, say N.

config CPU_HAS_INTEVT
	bool

config CPU_HAS_MASKREG_IRQ
	bool

config CPU_HAS_IPR_IRQ
	bool

config CPU_HAS_SR_RB
	bool "CPU has SR.RB"
	depends on CPU_SH3 || CPU_SH4
	default y
	help
	  This will enable the use of SR.RB register bank usage. Processors
	  that are lacking this bit must have another method in place for
	  accomplishing what is taken care of by the banked registers.

	  See <file:Documentation/sh/register-banks.txt> for further
	  information on SR.RB and register banking in the kernel in general.

config CPU_HAS_PTEA
	bool

config CPU_HAS_DSP
	bool

config CPU_HAS_FPU
	bool

config SH_GRB
	bool "Implement atomic operations by roll-back (gRB) (EXPERIMENTAL)"
	default n
	---help---
	  Enabling this option will allow the kernel to implement some
	  atomic operations using a software implemention of load-locked/
	  store-conditional (LLSC). On machines which do not have hardware
	  LLSC, this should be more efficient than the other alternative of
	  disabling insterrupts around the atomic sequence.

endmenu

menu "Board support"

config SOLUTION_ENGINE
	bool

config SH_SOLUTION_ENGINE
	bool "SolutionEngine"
	select SOLUTION_ENGINE
	select CPU_HAS_IPR_IRQ
	depends on CPU_SUBTYPE_SH7709 || CPU_SUBTYPE_SH7750
	help
	  Select SolutionEngine if configuring for a Hitachi SH7709
	  or SH7750 evaluation board.

config SH_7206_SOLUTION_ENGINE
	bool "SolutionEngine7206"
	select SOLUTION_ENGINE
	depends on CPU_SUBTYPE_SH7206
	help
	  Select 7206 SolutionEngine if configuring for a Hitachi SH7206
	  evaluation board.

config SH_7619_SOLUTION_ENGINE
	bool "SolutionEngine7619"
	select SOLUTION_ENGINE
	depends on CPU_SUBTYPE_SH7619
	help
	  Select 7619 SolutionEngine if configuring for a Hitachi SH7619
	  evaluation board.
	
config SH_7722_SOLUTION_ENGINE
	bool "SolutionEngine7722"
	select SOLUTION_ENGINE
	depends on CPU_SUBTYPE_SH7722
	help
	  Select 7722 SolutionEngine if configuring for a Hitachi SH772
	  evaluation board.

config SH_7751_SOLUTION_ENGINE
	bool "SolutionEngine7751"
	select SOLUTION_ENGINE
	select CPU_HAS_IPR_IRQ
	depends on CPU_SUBTYPE_SH7751
	help
	  Select 7751 SolutionEngine if configuring for a Hitachi SH7751
	  evaluation board.
	  
config SH_7780_SOLUTION_ENGINE
	bool "SolutionEngine7780"
	select SOLUTION_ENGINE
	select SYS_SUPPORTS_PCI
	depends on CPU_SUBTYPE_SH7780
	help
	  Select 7780 SolutionEngine if configuring for a Renesas SH7780
	  evaluation board.

config SH_7343_SOLUTION_ENGINE
	bool "SolutionEngine7343"
	select SOLUTION_ENGINE
	depends on CPU_SUBTYPE_SH7343
	help
	  Select 7343 SolutionEngine if configuring for a Hitachi
	  SH7343 (SH-Mobile 3AS) evaluation board.

config SH_7751_SYSTEMH
	bool "SystemH7751R"
	depends on CPU_SUBTYPE_SH7751R
	help
	  Select SystemH if you are configuring for a Renesas SystemH
	  7751R evaluation board.

config SH_HP6XX
	bool "HP6XX"
	select SYS_SUPPORTS_APM_EMULATION
	select HD6446X_SERIES
	depends on CPU_SUBTYPE_SH7709
	help
	  Select HP6XX if configuring for a HP jornada HP6xx.
	  More information (hardware only) at
	  <http://www.hp.com/jornada/>.

config SH_DREAMCAST
	bool "Dreamcast"
	select SYS_SUPPORTS_PCI
	depends on CPU_SUBTYPE_SH7091
	help
	  Select Dreamcast if configuring for a SEGA Dreamcast.
	  More information at
	  <http://www.m17n.org/linux-sh/dreamcast/>.  There is a
	  Dreamcast project is at <http://linuxdc.sourceforge.net/>.

config SH_MPC1211
	bool "Interface MPC1211"
	depends on CPU_SUBTYPE_SH7751 && BROKEN
	help
	  CTP/PCI-SH02 is a CPU module computer that is produced
	  by Interface Corporation.
	  More information at <http://www.interface.co.jp>

config SH_SH03
	bool "Interface CTP/PCI-SH03"
	depends on CPU_SUBTYPE_SH7751
	select CPU_HAS_IPR_IRQ
	select SYS_SUPPORTS_PCI
	help
	  CTP/PCI-SH03 is a CPU module computer that is produced
	  by Interface Corporation.
	  More information at <http://www.interface.co.jp>

config SH_SECUREEDGE5410
	bool "SecureEdge5410"
	depends on CPU_SUBTYPE_SH7751R
	select CPU_HAS_IPR_IRQ
	select SYS_SUPPORTS_PCI
	help
	  Select SecureEdge5410 if configuring for a SnapGear SH board.
	  This includes both the OEM SecureEdge products as well as the
	  SME product line.

config SH_HS7751RVOIP
	bool "HS7751RVOIP"
	depends on CPU_SUBTYPE_SH7751R
	help
	  Select HS7751RVOIP if configuring for a Renesas Technology
	  Sales VoIP board.

config SH_7710VOIPGW
	bool "SH7710-VOIP-GW"
	depends on CPU_SUBTYPE_SH7710
	help
	  Select this option to build a kernel for the SH7710 based
	  VOIP GW.

config SH_RTS7751R2D
	bool "RTS7751R2D"
	depends on CPU_SUBTYPE_SH7751R
	select SYS_SUPPORTS_PCI
	help
	  Select RTS7751R2D if configuring for a Renesas Technology
	  Sales SH-Graphics board.

config SH_HIGHLANDER
	bool "Highlander"
	depends on CPU_SUBTYPE_SH7780 || CPU_SUBTYPE_SH7785
	select SYS_SUPPORTS_PCI

config SH_EDOSK7705
	bool "EDOSK7705"
	depends on CPU_SUBTYPE_SH7705

config SH_SH4202_MICRODEV
	bool "SH4-202 MicroDev"
	depends on CPU_SUBTYPE_SH4_202
	help
	  Select SH4-202 MicroDev if configuring for a SuperH MicroDev board
	  with an SH4-202 CPU.

config SH_LANDISK
	bool "LANDISK"
	depends on CPU_SUBTYPE_SH7751R
	select SYS_SUPPORTS_PCI
	help
	  I-O DATA DEVICE, INC. "LANDISK Series" support.

config SH_TITAN
	bool "TITAN"
	depends on CPU_SUBTYPE_SH7751R
	select CPU_HAS_IPR_IRQ
	select SYS_SUPPORTS_PCI
	help
	  Select Titan if you are configuring for a Nimble Microsystems
	  NetEngine NP51R.

config SH_SHMIN
	bool "SHMIN"
	depends on CPU_SUBTYPE_SH7706
	select CPU_HAS_IPR_IRQ
	help
	  Select SHMIN if configuring for the SHMIN board.

config SH_LBOX_RE2
	bool "L-BOX RE2"
	depends on CPU_SUBTYPE_SH7751R
	select SYS_SUPPORTS_PCI
	help
	  Select L-BOX RE2 if configuring for the NTT COMWARE L-BOX RE2.

config SH_X3PROTO
	bool "SH-X3 Prototype board"
	depends on CPU_SUBTYPE_SHX3

config SH_MAGIC_PANEL_R2
	bool "Magic Panel R2"
	depends on CPU_SUBTYPE_SH7720
	help
	  Select Magic Panel R2 if configuring for Magic Panel R2.

comment "ST Main Boards"

config SH_ST_HARP_IRQ
	bool
	default n

config SH_ST_EPLD
	bool
	default n

config SH_ST_STEM
	bool
	default n

config SH_ST_STPM_HD_V1
	bool
	default n

config SH_ST_STPM_HD_V2
	bool
	default n


# Old style PCI controller, used on ST40RA, GX1 etc
config SH_ST_ST40RA_PCI
	bool
	default n

# Completely different PCI controller from synopsys
config SH_ST_SYNOPSYS_PCI
	bool
	select GENERIC_IOMAP
	default n

config SH_ST_CB104
	bool "cb104: ST Customer board 104"
	depends on CPU_SUBTYPE_STX7200
	help
	  Select SH_ST_CB104 if configuring for this board.

config SH_ST_CB104_MC
	bool "cb104_mc: ST Customer board 104 microconnect mode"
	depends on SH_ST_CB104
	default y
	help
	  Select this option if microconnect support should
	  always be available on this board

config SH_ST_HDK5289
	bool "HDK5289: STi5289 Reference board"
	depends on CPU_SUBTYPE_STX5206
	select SYS_SUPPORTS_PCI
	help
	  Select HDK5289 if configuring for a
	  STMicroelectronics STi5289 Reference Board.

config SH_ST_HDK7106
	bool "HDK7106: STi7106 Reference board"
	depends on CPU_SUBTYPE_STX7105
	select SYS_SUPPORTS_PCI
	help
	  Select SH_ST_HDK7106 if configuring for a
	  STMicroelectronics STi7106 Reference Board.

config SH_ST_HDK7108
	bool "HDK7108: STi7108 Reference board"
	depends on CPU_SUBTYPE_STX7108
	select SYS_SUPPORTS_PCI
	help
	  Select SH_ST_HDK7108 if configuring for a
	  STMicroelectronics STi7108 Reference Board.

config SH_ST_FLDB
	bool "fldb: Freeman 510 (Lite) Development Board"
	depends on CPU_SUBTYPE_FLI7510
	select SYS_SUPPORTS_PCI
	select SND_STM_CONV_GPIO if SND_STM
	help
	  Select this if configuring for a
	  Freeman 510 (Lite) Development Board.

config SH_ST_FUDB
	bool "fudb: Freeman 530 (Ultra) Development Board"
	depends on CPU_SUBTYPE_FLI7510
	select SYS_SUPPORTS_PCI
	select SND_STM_CONV_DUMMY if SND_STM
	help
	  Select this if configuring for a
	  Freeman 530 (Ultra) Development Board.
	  
config SH_ST_CB16
	bool "cb161: ST Customer board 161"
	depends on CPU_SUBTYPE_STX7200
	select SND_STM_CONV_DUMMY if SND_STM
	help
	  Select SH_ST_CB161 if configuring for this board.

config SH_ST_CB180
	bool "cb180: ST Customer board 180"
	depends on CPU_SUBTYPE_STX7105
	select SND_STM_CONV_DUMMY if SND_STM
	help
	  Select SH_ST_CB180 if configuring for this board.
	  
	  
config SH_ST_HMS1
	bool "HMS1"
	depends on CPU_SUBTYPE_STB7100
	help
	  Select HMS1 if configuring for a HMS1 board.
	  More information at:
	  <http://www.linuxsh.st.com/boards/hms1/>

config SH_ST_MB360
	bool "mb360: ST40RA Eval"
	depends on CPU_SUBTYPE_ST40STB1
	select SH_ST_HARP_IRQ
	select SH_ST_STEM
	help
	  Select ST40RA-Eval if configuring for an
	  STMicroelectronics ST40RA Eval Board (product code: ST40RA-Eval,
	  ST board ID: mb360). More information at:
	  <http://www.stlinux.com/boards/mb360/>

config SH_ST_MB374
	bool "mb374: ST40RA Starter"
	depends on CPU_SUBTYPE_ST40STB1
	select SYS_SUPPORTS_PCI
	select SH_ST_HARP_IRQ
	select SH_ST_STEM
	select SH_ST_ST40RA_PCI
	help
	  Select ST40RA-Starter if configuring for an
	  STMicroelectronics ST40RA Starter Board (also known as the
	  ST40RA DDR Eval board) (product code: ST40RA-Starter,
	  ST board ID: mb374). More information at:
	  <http://www.stlinux.com/boards/mb374/>

config SH_ST_MB411
	bool "mb411: STB7100 Validation board"
	depends on CPU_SUBTYPE_STB7100
	select SH_ST_HARP_IRQ
	select SH_ST_EPLD
	select SH_ST_STEM
	help
	  Select STB7100 Validation if configuring for an
	  STMicroelectronics STB7100 Validation Board (product code:
	  STB7100-MBOARD, ST board ID: mb411). More information at:
	  <http://www.stlinux.com/boards/mb411/>

config SH_ST_MB442
	bool "mb442: STB7100 Reference board"
	depends on CPU_SUBTYPE_STB7100
	help
	  Select STB7100 Reference if configuring for an
	  STMicroelectronics STB7100 Reference Board (product code:
	  STB7100-REF). This is sometimes referred to as the CoCo board.
	  More information at: <http://www.stlinux.com/boards/mb442/>

config SH_ST_MB448
	bool "mb448: STB7109E Reference board"
	depends on CPU_SUBTYPE_STB7100
	help
	  Select STB7109E Reference if configuring for an
	  STMicroelectronics STB7109E Reference Board (product code:
	  STB7109E-REF, ST board ID: mb448). More information at:
	  <http://www.stlinux.com/boards/mb448/>

config SH_ST_MB519
	bool "mb519: STx7200 Mboard"
	depends on CPU_SUBTYPE_STX7200
	select SH_ST_EPLD
	select SH_ST_STEM
	select SH_ST_STPM_HD_V1
	help
	  Select SH_ST_MB519 if configuring for an
	  STMicroelectronics STx7200 Mboard (product code: STB7200-MBOARD,
	  ST board ID: mb519). More information at:
	  <http://www.stlinux.com/boards/mb519/>

config SH_ST_MB602
	bool "STB5202 Reference board"
	depends on CPU_SUBTYPE_STB7100
	help
	  Select STB5202 Reference if configuring for an
	  STMicroelectronics STB5202 Reference Board (product code: STB5202-REF,
	  ST board ID: mb602). More information at:
	  <http://www.linuxsh.st.com/boards/mb602/>

config SH_ST_HDREF
        bool "ST HDref board"
        depends on CPU_SUBTYPE_STB7100
        help
          Select ST HDref board if configuring for an
          STMicroelectronics ST HD Reference Board
          More information at:
          <http://www.linuxsh.st.com/boards/hdref/>

config SH_ST_HMP7100
        bool "STB7100 HMP board"
        depends on CPU_SUBTYPE_STB7100
        help
          Select STB7100 HMP board if configuring for an
          STMicroelectronics STB71xx HMP Reference Board

config SH_ST_MB618
	bool "mb618: STx7111 Validation board"
	depends on CPU_SUBTYPE_STX7111
	select SH_ST_EPLD
	select SH_ST_STEM
	select SYS_SUPPORTS_PCI
	select I2C if SND_STM
	help
	  Select STx7111 Validation if configuring for an
	  STMicroelectronics STx7111 Validation Board (product code:
	  STB7111-MBOARD, ST board ID: mb618). More information at:
	  <http://www.stlinux.com/boards/mb618/>

config SH_ST_MB628
	bool "mb628: STx7141 Mboard"
	depends on CPU_SUBTYPE_STX7141
	select SH_ST_EPLD
	select SH_ST_STEM
	select SND_STM_CONV_DUMMY if SND_STM
	select SND_STM_CONV_EPLD if SND_STM
	help
	  Select STx7141 Mboard if configuring for an
	  STMicroelectronics STx7141 MBoard (product code:
	  STi7141-MBOARD, ST board ID: mb628). More information at:
	  <http://www.stlinux.com/boards/mb628/>

config SH_ST_7141EUD
	bool "7141eud board"
	depends on CPU_SUBTYPE_STX7141
	help
	  Select the 7141eud board (tested 1.1 version).

config SH_ST_MB671
	bool "mb671: STx7200 cut 2.0 Mboard"
	depends on CPU_SUBTYPE_STX7200
	select CPU_ST40_300
	select SH_ST_EPLD
	select SH_ST_STEM
	select SH_ST_STPM_HD_V1
	help
	  Select SH_ST_MB671 if configuring for an STMicroelectronics
	  STx7200 cut 2.0 Mboard (ST board ID: mb671).
	  More information at: <http://www.stlinux.com/boards/>

config SH_ST_MB680
	bool "mb680: STx7105 Validation board"
	depends on CPU_SUBTYPE_STX7105
	select SH_ST_STEM
	select SH_ST_STPM_HD_V2
	select SYS_SUPPORTS_PCI
	help
	  Select STx7105 Validation if configuring for an
	  STMicroelectronics STx7105 Validation Board (product code:
	  STi7105-MBOARD, ST board ID: mb680). More information at:
	  <http://www.stlinux.com/boards/mb680/>

config SH_ST_MB796
	bool "mb796: STx5206/Stx5289 Validation board"
	depends on CPU_SUBTYPE_STX5206
	select SH_ST_STEM
	select SH_ST_STPM_HD_V2
	select SYS_SUPPORTS_PCI
	help
	  Select STx5289 Validation if configuring for an
	  STMicroelectronics STx5289 Validation Board (product code:
	  STi5289-MBOARD, ST board ID: mb796). More information at:
	  <http://www.stlinux.com/boards/mb796/>

config SH_ST_PDK7105
	bool "PDK7105-SDK : STi7105 SDK Reference board"
	depends on CPU_SUBTYPE_STX7105
	select SYS_SUPPORTS_PCI
	help
	  Select PDK7105-SDK if configuring for an
	  STMicroelectronics STi7105 SDK Reference Board.

config SH_ST_DORADE
	bool "Dorade : customer board"
	depends on CPU_SUBTYPE_STX7105
	select SYS_SUPPORTS_PCI
	help
	  Select Dorade if configuring for a
	  Dorade customer board.

config SH_ST_HMP7105
	bool "HMP7105: STx7105 Reference board"
	depends on CPU_SUBTYPE_STX7105
	select SYS_SUPPORTS_PCI
	help
	  Select HMP7105 if configuring for an STMicroelectronics
	  HMP7105 reference board.

config SH_ST_IPTV7105
	bool "iptv7105: STx7105 IPTV pluggin board"
	depends on CPU_SUBTYPE_STX7105
	select SYS_SUPPORTS_PCI
	help
	  Select SH_ST_IPTV7105 if configuring for an iptv7105 board

config SH_ST_7167ADT
	bool "7167adt: STi7162/7 ADT board"
	depends on CPU_SUBTYPE_STX7105
	help
	  Select SH_ST_7167ADT if configuring for an 7167adt board

config SH_ST_SEQUOIA7104IDTV
	bool "sequoia7104idtv: STx7104 SEQUOIA IDTV board"
	depends on CPU_SUBTYPE_STX7105
	select SYS_SUPPORTS_PCI
	help
	  Select SH_ST_SEQUOIA7104IDTV if configuring for an sequoia7104idtv board

config SH_ST_MB704
	bool "mb704: STx5197 Validation board"
	depends on CPU_SUBTYPE_STX5197
	select SH_ST_STEM
	select SH_ST_STPM_HD_V2
	help
	  Select STx5197 Validation if configuring for an
	  STMicroelectronics STx5197 Validation Board (product code:
	  STx5197-MBOARD, ST board ID: mb704). More information at:
	  <http://www.stlinux.com/boards/mb704/>

config SH_ST_5197CAB
	bool "5197CAB: STx5197 CAB reference board"
	depends on CPU_SUBTYPE_STX5197
	select SH_ST_STEM
	select SH_ST_STPM_HD_V2
	help
	  Select STx5197 CAB Reference if configuring for an
	  STMicroelectronics STx5197 CAB reference Board.

config SH_ST_MB837
	bool "mb837: STx7108 Validation board"
	depends on CPU_SUBTYPE_STX7108
	select SH_ST_STEM
	select SH_ST_STPM_HD_V2
	select SYS_SUPPORTS_PCI
	help
	  Select STx7108 Validation if configuring for an
	  STMicroelectronics STx7108 Validation Board (product code:
	  STi7108-MBOARD, ST board ID: mb837).

config SH_ST_MB839
	bool "mb839: STi7105 Reference Board"
	depends on CPU_SUBTYPE_STX7105
	help
	  Select MB839 if configuring for an
	  STMicroelectronics STi7105 MB839 Reference Board.

comment "G5 boards"

config SH_ST_CUSTOM002007
	bool "custom002007: STi7105 Custom002007 board"
	depends on CPU_SUBTYPE_STX7105
	select DVB_ANTENNA_BRIDGE
	select DVB_STV090x_SHARED_GPIO
	help
	  Select Custom002007 if configuring for an
	  STMicroelectronics STi7105 custom002007 board.

source "arch/sh/boards/st/custom002007/Kconfig"

config SH_ST_CUSTOM002012
	bool "custom002012: STi7105 Custom002012 board"
	depends on CPU_SUBTYPE_STX7105
	select DVB_ANTENNA_BRIDGE
	select DVB_STV090x_SHARED_GPIO
	help
	  Select custom002012-SDK if configuring for an
	  STMicroelectronics STi7105 custom002012 board.

source "arch/sh/boards/st/custom002012/Kconfig"

config SH_ST_C275
	bool "c275: STi7105 C275 board"
	depends on CPU_SUBTYPE_STX7105
	help
	  Select c275 if configuring for an
	  STMicroelectronics STi7105 C275 (aka G5 TER) board.

source "arch/sh/boards/st/c275/Kconfig"

config SH_ST_CUSTOM003019
	bool "custom003019: STi7105 G5+ SAT SAGEM board"
	depends on CPU_SUBTYPE_STX7105
	select DVB_ANTENNA_BRIDGE
	select DVB_STV090x_SHARED_GPIO
	help
	  Select custom003019-SDK if configuring for an
	  STMicroelectronics STi7105 G5+ SAT SAGEM board.

source "arch/sh/boards/st/custom003019/Kconfig"

config SH_ST_S5210
	bool "SMT-S5210: Samsung STi7105-JUD board"
	depends on CPU_SUBTYPE_STX7105
	select DVB_ANTENNA_BRIDGE
	help
	  Select SMT-S5210 if configuring for an
	  Samsung STi7105 board.

source "arch/sh/boards/st/s5210/Kconfig"

config SH_ST_MB903
	bool "mb903: STi7108M Reference board"
	depends on CPU_SUBTYPE_STX7108
	help
	  Select SH_ST_MB903 if configuring for a
	  STMicroelectronics STi7108M Reference Board.

comment "ST Peripheral Boards"

config SH_ST_DB641
	bool "db641: STEM board with double SMSC LAN9117 Ethernet interface"
	depends on SH_ST_STEM
	help
	  Supports DB641 STEM board. Only first port (CN1) is supported.
	  See "arch/sh/boards/st/common/db641.c" for configuration
	  informations.

config SH_ST_DB679
	bool "db679: STEM based EMI to ATAPI drive interface"
	depends on SH_ST_STEM
	help
	  Supports DB679 STEM board. See "arch/sh/boards/st/common/db679.c"
	  for configuration informations.

config SH_ST_MB520
	bool "mb520: STB peripherals board"
	depends on SH_ST_STPM_HD_V1
	select I2C
	select I2C_BOARDINFO
	select I2C_STM_SSC
	select GPIO_PCF857X
	select SND_STM_CONV_GPIO if SND_STM
	help
	  Select SH_ST_MB520 if your processor board is connected
	  to this STB-like peripherals board.

config SH_ST_MB562
	bool "mb562: BD-DVD peripherals board"
	depends on SH_ST_STPM_HD_V1
	help
	  Select SH_ST_MB562 if your processor board is connected
	  to this multi-audio-outputs board.

config SH_ST_MB588
	bool "mb588: NAND Flash STEM board"
	depends on SH_ST_STEM
	help
	  Supports MB588 STEM board. See "arch/sh/boards/st/common/mb588.c"
	  for configuration informations.

config SH_ST_MB705
	bool "mb705: Generic HD peripherals board"
	depends on SH_ST_STPM_HD_V2
	select SH_ST_EPLD
	help
	  Select SH_ST_MB705 if your processor board is connected
	  to this STB-like peripherals board.

config SH_ST_MB705_AUDIO
	tristate "Driver for audio peripherals on mb705"
	depends on SH_ST_MB705
	depends on SND_STM
	default y
	help
	  Select this option to enable support for audio perypeharals
	  on the mb705 (DACs and SPDIF-I2S converter).

	  If you compile this driver as a module, it will be
	  called mb705-audio.ko

config SH_ST_MB705_DISPLAY
	bool "Driver for LED display on mb705"
	depends on SH_ST_MB705
	default y
	help
	  Select this option to enable a simple driver for the alphanumeric
	  LED display on the mb705.

config SH_ST_MB705_FPBUTTON
	bool "Driver for the front pannel button on mb705"
	depends on SH_ST_MB705
	default y
	help
	  Select this option to enable a simple driver for the front
	  pannel button on the mb705.

endmenu

source "arch/sh/boards/renesas/hs7751rvoip/Kconfig"
source "arch/sh/boards/renesas/rts7751r2d/Kconfig"
source "arch/sh/boards/renesas/r7780rp/Kconfig"
source "arch/sh/boards/magicpanelr2/Kconfig"
source "arch/sh/boards/st/hdk7108/Kconfig"
source "arch/sh/boards/st/mb837/Kconfig"

menu "Timer and clock configuration"

config SH_TMU
	bool "TMU timer support"
	depends on CPU_SH3 || CPU_SH4
	select GENERIC_TIME
	select GENERIC_CLOCKEVENTS
	default y
	help
	  This enables the use of the TMU as the system timer.

config SH_CMT
	bool "CMT timer support"
	depends on CPU_SH2
	default y
	help
	  This enables the use of the CMT as the system timer.

config SH_MTU2
	bool "MTU2 timer support"
	depends on CPU_SH2A
	default n
	help
	  This enables the use of the MTU2 as the system timer.

config SH_LPRTC
	bool "Persistent software real-time clock"
	depends on SH_TMU
	depends on CPU_SUBTYPE_STX7105
	default n
	help
	  This enables a software RTC which keeps time when the SoC is
	  partially powered down. Aimed at systems which miss a physical RTC.

config SH_TIMER_IRQ
	int
	default "28" if CPU_SUBTYPE_SH7780 || CPU_SUBTYPE_SH7785
	default "86" if CPU_SUBTYPE_SH7619
	default "140" if CPU_SUBTYPE_SH7206
	default "16"

config SH_PCLK_FREQ
	int "Peripheral clock frequency (in Hz)"
	default "27000000" if CPU_SUBTYPE_SH7343
	default "31250000" if CPU_SUBTYPE_SH7619
	default "32000000" if CPU_SUBTYPE_SH7722
	default "33333333" if CPU_SUBTYPE_SH7770 || \
			      CPU_SUBTYPE_SH7760 || CPU_SUBTYPE_SH7705 || \
			      CPU_SUBTYPE_SH7206
	default "60000000" if CPU_SUBTYPE_SH7751 || CPU_SUBTYPE_SH7751R
	default "66000000" if CPU_SUBTYPE_SH4_202
	default "50000000"
	help
	  This option is used to specify the peripheral clock frequency.
	  This is necessary for determining the reference clock value on
	  platforms lacking an RTC.

config SH_CLK_MD
	int "CPU Mode Pin Setting"
	depends on CPU_SUBTYPE_SH7619 || CPU_SUBTYPE_SH7206
	default 6 if CPU_SUBTYPE_SH7206
	default 5 if CPU_SUBTYPE_SH7619
	default 0
	help
	  MD2 - MD0 pin setting.

source "kernel/time/Kconfig"

endmenu

config SH_EXTERNAL_CLOCK
	int "External clock"
	depends on CPU_SUBTYPE_STB7100 || CPU_SUBTYPE_STX7200
	default "30000000" if SH_ST_MB442
	default "27000000" if SH_ST_HMP7100
	default "27000000"
	help
	  The kernel needs to know what the frequency of chip's external
	  clock is, so that it can calculate what frequency the internal
	  clocks are running at.

	  The usual symptoms of getting this wrong are the serial port
	  output being corrupted.

config SH_FAST_HZ
	bool "Fast kernel tick"
	default n
	help
	  Enabling this option will increase the rate at which the kernel's
	  internal timer ticks from 100Hz to 1000Hz. This will increase the
	  accuracy of the kernel's internal time, at the expense of a higher
	  interrupt load.

	  This option needs to be set to use the SH watchdog.

choice
	prompt "Calibrate delay"
	default GENERIC_CALIBRATE_DELAY

config GENERIC_CALIBRATE_DELAY
	bool "Use the generic calibrate delay"

config SH4_CALIBRATE_DELAY
	depends on CPU_SH4
	bool "Use an SH-4 specific fast calibrate delay"
endchoice

menu "CPU Frequency scaling"

source "drivers/cpufreq/Kconfig"

config SH_CPU_FREQ
	tristate "SuperH CPU Frequency driver"
	depends on CPU_FREQ
	select CPU_FREQ_TABLE
	help
	  This adds the cpufreq driver for SuperH. At present, only
	  the SH-4 is supported.

	  For details, take a look at <file:Documentation/cpu-freq>.

	  If unsure, say N.

config STM_CPU_FREQ
	tristate "STMicroelectronics CPU Frequency driver"
	default y
	select CPU_FREQ_TABLE
	depends on CPU_FREQ
	help
	  This adds the cpufreq driver for STMicroelectronics micro.
	  For details, take a look at <file:Documentation/cpu-freq>.

config STM_CPU_FREQ_OBSERVE
	bool "Observe the CPU frequency"
	default n
	depends STM_CPU_FREQ && CPU_FREQ_DEBUG
	help
	  Enable this option to program the ClkGenA Observer to route
	  the sh4_clk on an external pin

endmenu

source "arch/sh/drivers/Kconfig"

endmenu

config ISA_DMA_API
	bool
	depends on SH_MPC1211
	default y

menu "Kernel features"

source kernel/Kconfig.hz

config ST_BIOS
	bool "ST BIOS call support"
	depends on CPU_SH4
	help
	  This enables some SoC hardware configuration to be done by
	  using the OS independent ST hardware independent layer (HIL)
	  BIOS.

          It is important to make sure there is enough space reserved
          in the Zero page for the BIOS to work.

config KEXEC
	bool "kexec system call (EXPERIMENTAL)"
	depends on EXPERIMENTAL
	help
	  kexec is a system call that implements the ability to shutdown your
	  current kernel, and to start another kernel.  It is like a reboot
	  but it is independent of the system firmware.  And like a reboot
	  you can start any kernel with it, not just Linux.

	  The name comes from the similarity to the exec system call.

	  It is an ongoing process to be certain the hardware in a machine
	  is properly shutdown, so do not be surprised if this code does not
	  initially work for you.  It may help to enable device hotplugging
	  support.  As of this writing the exact hardware interface is
	  strongly in flux, so no good recommendation can be made.

config CRASH_DUMP
	bool "kernel crash dumps (EXPERIMENTAL)"
	depends on EXPERIMENTAL
	help
	  Generate crash dump after being started by kexec.
	  This should be normally only set in special crash dump kernels
	  which are loaded in the main kernel with kexec-tools into
	  a specially reserved region and then later executed after
	  a crash by kdump/kexec. The crash dump kernel must be compiled
	  to a memory address not used by the main kernel using
	  MEMORY_START.

	  For more details see Documentation/kdump/kdump.txt

config SMP
	bool "Symmetric multi-processing support"
	depends on SYS_SUPPORTS_SMP
	---help---
	  This enables support for systems with more than one CPU. If you have
	  a system with only one CPU, like most personal computers, say N. If
	  you have a system with more than one CPU, say Y.

	  If you say N here, the kernel will run on single and multiprocessor
	  machines, but will use only one CPU of a multiprocessor machine. If
	  you say Y here, the kernel will run on many, but not all,
	  singleprocessor machines. On a singleprocessor machine, the kernel
	  will run faster if you say N here.

	  People using multiprocessor machines who say Y here should also say
	  Y to "Enhanced Real Time Clock Support", below.

	  See also the <file:Documentation/smp.txt>,
	  <file:Documentation/nmi_watchdog.txt> and the SMP-HOWTO available
	  at <http://www.tldp.org/docs.html#howto>.

	  If you don't know what to do here, say N.

config NR_CPUS
	int "Maximum number of CPUs (2-32)"
	range 2 32
	depends on SMP
	default "4" if CPU_SHX3
	default "2"
	help
	  This allows you to specify the maximum number of CPUs which this
	  kernel will support.  The maximum supported value is 32 and the
	  minimum value which makes sense is 2.

	  This is purely to save memory - each supported CPU adds
	  approximately eight kilobytes to the kernel image.

source "kernel/Kconfig.preempt"

config GUSA
	def_bool y
	depends on !SMP
	help
	  This enables support for gUSA (general UserSpace Atomicity).
	  This is the default implementation for both UP and non-ll/sc
	  CPUs, and is used by the libc, amongst others.

	  For additional information, design information can be found 
	  in <http://lc.linux.or.jp/lc2002/papers/niibe0919p.pdf>.

	  This should only be disabled for special cases where alternate
	  atomicity implementations exist.

endmenu

menu "Boot options"

config ZERO_PAGE_OFFSET
	hex "Zero page offset"
	default "0x00004000" if SH_MPC1211 || SH_SH03
	default "0x00010000" if PAGE_SIZE_64KB || ST_BIOS
	default "0x00002000" if PAGE_SIZE_8KB
	default "0x00001000"
	help
	  This sets the default offset of zero page.

config BOOT_LINK_OFFSET
	hex "Link address offset for booting"
	default "0x00800000"
	help
	  This option allows you to set the link address offset of the zImage.
	  This can be useful if you are on a board which has a small amount of
	  memory.

config UBC_WAKEUP
	bool "Wakeup UBC on startup"
	depends on CPU_SH4 && (!CPU_SUBTYPE_ST40)
	help
	  Selecting this option will wakeup the User Break Controller (UBC) on
	  startup. Although the UBC is left in an awake state when the processor
	  comes up, some boot loaders misbehave by putting the UBC to sleep in a
	  power saving state, which causes issues with things like ptrace().

	  If unsure, say N.

choice
	prompt "Kernel command line"
	optional
	default CMDLINE_OVERWRITE
	help
	  Setting this option allows the kernel command line arguments
	  to be set.

config CMDLINE_OVERWRITE
	bool "Overwrite bootloader kernel arguments"
	help
	  Given string will overwrite any arguments passed in by
	  a bootloader.

config CMDLINE_EXTEND
	bool "Extend bootloader kernel arguments"
	help
	  Given string will be concatenated with arguments passed in
	  by a bootloader.

endchoice

config CMDLINE
	string "Kernel command line arguments string"
	depends on CMDLINE_OVERWRITE || CMDLINE_EXTEND
	default "console=ttySC1,115200"

endmenu

menu "Bus options"

# Even on SuperH devices which don't have an ISA bus,
# this variable helps the PCMCIA modules handle
# IRQ requesting properly -- Greg Banks.
#
# Though we're generally not interested in it when
# we're not using PCMCIA, so we make it dependent on
# PCMCIA outright. -- PFM.
config ISA
	def_bool y
	depends on PCMCIA && HD6446X_SERIES
	help
	  Find out whether you have ISA slots on your motherboard.  ISA is the
	  name of a bus system, i.e. the way the CPU talks to the other stuff
	  inside your box.  Other bus systems are PCI, EISA, MicroChannel
	  (MCA) or VESA.  ISA is an older system, now being displaced by PCI;
	  newer boards don't support it.  If you have ISA, say Y, otherwise N.

config EISA
	bool
	---help---
	  The Extended Industry Standard Architecture (EISA) bus was
	  developed as an open alternative to the IBM MicroChannel bus.

	  The EISA bus provided some of the features of the IBM MicroChannel
	  bus while maintaining backward compatibility with cards made for
	  the older ISA bus.  The EISA bus saw limited use between 1988 and
	  1995 when it was made obsolete by the PCI bus.

	  Say Y here if you are building a kernel for an EISA-based machine.

	  Otherwise, say N.

config MCA
	bool
	help
	  MicroChannel Architecture is found in some IBM PS/2 machines and
	  laptops.  It is a bus system similar to PCI or ISA. See
	  <file:Documentation/mca.txt> (and especially the web page given
	  there) before attempting to build an MCA bus kernel.

config SBUS
	bool

config SUPERHYWAY
	tristate "SuperHyway Bus support"
	depends on CPU_SUBTYPE_SH4_202

config MAPLE
       bool "Maple Bus support"
       depends on SH_DREAMCAST
       help
         The Maple Bus is SEGA's serial communication bus for peripherals
         on the Dreamcast. Without this bus support you won't be able to
         get your Dreamcast keyboard etc to work, so most users
         probably want to say 'Y' here, unless you are only using the
         Dreamcast with a serial line terminal or a remote network
         connection.

config CF_ENABLER
	bool "Compact Flash Enabler support"
	depends on SOLUTION_ENGINE || SH_SH03
	---help---
	  Compact Flash is a small, removable mass storage device introduced
	  in 1994 originally as a PCMCIA device.  If you say `Y' here, you
	  compile in support for Compact Flash devices directly connected to
	  a SuperH processor.  A Compact Flash FAQ is available at
	  <http://www.compactflash.org/faqs/faq.htm>.

	  If your board has "Directly Connected" CompactFlash at area 5 or 6,
	  you may want to enable this option.  Then, you can use CF as
	  primary IDE drive (only tested for SanDisk).

	  If in doubt, select 'N'.

choice
	prompt "Compact Flash Connection Area"
	depends on CF_ENABLER
	default CF_AREA6

config CF_AREA5
	bool "Area5"
	help
	  If your board has "Directly Connected" CompactFlash, You should
	  select the area where your CF is connected to.

	  - "Area5" if CompactFlash is connected to Area 5 (0x14000000)
	  - "Area6" if it is connected to Area 6 (0x18000000)

	  "Area6" will work for most boards.

config CF_AREA6
	bool "Area6"

endchoice

config CF_BASE_ADDR
	hex
	depends on CF_ENABLER
	default "0xb8000000" if CF_AREA6
	default "0xb4000000" if CF_AREA5

source "arch/sh/drivers/pci/Kconfig"

source "drivers/pci/Kconfig"

source "drivers/pcmcia/Kconfig"

source "drivers/pci/hotplug/Kconfig"

endmenu

menu "Executable file formats"

source "fs/Kconfig.binfmt"

endmenu

menu "Power management options (EXPERIMENTAL)"
depends on EXPERIMENTAL && SYS_SUPPORTS_PM

source kernel/power/Kconfig

config STM_LPFP
	bool "Low Power Front Panel"
	default n
	depends on CPU_SH4 && PM
	---help---
	  This allows to use the frontpanel in lowpower mode

config STM_LPIR
	bool "Low Power IR filter"
	default n
	depends on CPU_SH4 && PM
	---help---
	  This allows to filter the IR frame that wake up from lowpower mode
endmenu

config PM_SH3_FRQCR
	bool
	default y if PM && CPU_SH3
	default n

source "net/Kconfig"

source "drivers/Kconfig"

source "fs/Kconfig"

source "arch/sh/oprofile/Kconfig"

source "kernel/Kconfig.instrumentation"

source "arch/sh/Kconfig.debug"

source "security/Kconfig"

source "crypto/Kconfig"

source "lib/Kconfig"
```
