## G5/src/tchitcha-sources-2.6.23.17.125.71_p32-r1/arch/sh/boards/st/c275/Kconfig
```kconfig
if SH_ST_C275

config SH_G5_SPLASH
	bool "Splash screen"
	default y
	help
	  This enable splash for G5 boards.
config MTD_PACE_BSL_COMPATIBILITY
	bool "NAND compatibility with Pace BSL"
	default y
	help
	  This sets the configuration allowing NAND
	  devices to be compatible with Pace BSL.

endif
```

## G5/src/tchitcha-sources-2.6.23.17.125.71_p32-r1/arch/sh/boards/st/custom002007/Kconfig
```kconfig
if SH_ST_CUSTOM002007

config SH_G5_SPLASH
	bool "Splash screen"
	default y
	help
	  This enable splash for G5 boards.

endif
```

## G5/src/tchitcha-sources-2.6.23.17.125.71_p32-r1/arch/sh/boards/st/custom002012/Kconfig
```kconfig
if SH_ST_CUSTOM002012

config SH_G5_SPLASH
	bool "Splash screen"
	default y
	help
	  This enable splash for G5 boards.

endif
```

## G5/src/tchitcha-sources-2.6.23.17.125.71_p32-r1/arch/sh/boards/st/hdk7108/Kconfig
```kconfig
if SH_ST_HDK7108

menu "hdk7108: STx7108 Reference board options"

config SH_ST_HDK7108_STMMAC0
	bool "Enable STMMAC 0"
	default n
	help
	  Enable STMMAC 0

config SH_ST_HDK7108_STMMAC0_FIXED_PHY
	bool "Use fixed PHY for STMMAC 0"
	depends on SH_ST_HDK7108_STMMAC0
	select FIXED_PHY
	help
	  Associate STMMAC0 with an emulated PHY on the "fixed" MDIO Bus.
	  This is useful for PHYs which have insufficient SMI registers
	  to support the normal PHY management interface.

endmenu

endif
```

## G5/src/tchitcha-sources-2.6.23.17.125.71_p32-r1/arch/sh/boards/st/mb837/Kconfig
```kconfig
if SH_ST_MB837

menu "mb837: STx7108 Validation board options"

config SH_ST_MB837_STMMAC0
	bool "Enable STMMAC 0"
	default n
	help
	  Enable STMMAC 0

config SH_ST_MB837_STMMAC0_FIXED_PHY
	bool "Use fixed PHY for STMMAC 0"
	depends on SH_ST_MB837_STMMAC0
	select FIXED_PHY
	help
	  Associate STMMAC0 with an emulated PHY on the "fixed" MDIO Bus.
	  This is useful for PHYs which have insufficient SMI registers
	  to support the normal PHY management interface.

config SH_ST_MB837_STMMAC1
	bool "Enable STMMAC 1"
	default n
	help
	  Enable STMMAC 1

config SH_ST_MB837_STMMAC1_FIXED_PHY
	bool "Use fixed PHY for STMMAC 1"
	depends on SH_ST_MB837_STMMAC1
	select FIXED_PHY
	help
	  Associate STMMAC1 with an emulated PHY on the "fixed" MDIO Bus.
	  This is useful for PHYs which have insufficient SMI registers
	  to support the normal PHY management interface.

endmenu

endif
```

## G5/src/tchitcha-sources-2.6.23.17.125.71_p32-r1/arch/sh/boards/st/s5210/Kconfig
```kconfig
if SH_ST_S5210

config SH_G5_SPLASH
	bool "Splash screen"
	default y
	help
	  This enable splash for G5 boards.

endif
```

## G5/src/tchitcha-sources-2.6.23.17.125.71_p32-r1/arch/sh/drivers/dma/Kconfig
```kconfig
menu "DMA support"

config SH_DMA_API
	bool

config SH_DMA
	bool "SuperH on-chip DMA controller (DMAC) support"
	depends on CPU_SH3 || CPU_SH4 && !CPU_SUBTYPE_ST40
	select SH_DMA_API
	default n
	help
	  Selecting this option will allow the use of the Hitachi/Renesas
	  DMA controller (DMAC). The DMAC is programmed using the generic
	  SH DMA API, although a wrapper providing compatibility with the
	  ISA DMA API used on PC's is also available.

config NR_ONCHIP_DMA_CHANNELS
	int
	depends on SH_DMA
	default "6" if CPU_SUBTYPE_SH7720
	default "8" if CPU_SUBTYPE_SH7750R || CPU_SUBTYPE_SH7751R
	default "12" if CPU_SUBTYPE_SH7780
	default "4"
	help
	  This allows you to specify the number of channels that the on-chip
	  DMAC supports. This will be 4 for SH7750/SH7751 and 8 for the
	  SH7750R/SH7751R.

config NR_DMA_CHANNELS_BOOL
	depends on SH_DMA
	bool "Override default number of maximum DMA channels"
	help
	  This allows you to forcibly update the maximum number of supported
	  DMA channels for a given board. If this is unset, this will default
	  to the number of channels that the on-chip DMAC has.

config NR_DMA_CHANNELS
	int "Maximum number of DMA channels"
	depends on SH_DMA && NR_DMA_CHANNELS_BOOL
	default NR_ONCHIP_DMA_CHANNELS
	help
	  This allows you to specify the maximum number of DMA channels to
	  support. Setting this to a higher value allows for cascading DMACs
	  with additional channels.

config SH_DMABRG
	bool "SH7760 DMABRG support"
	depends on CPU_SUBTYPE_SH7760
	help
	  The DMABRG does data transfers from main memory to Audio/USB units
	  of the SH7760.
	  Say Y if you want to use Audio/USB DMA on your SH7760 board.

endmenu
```

## G5/src/tchitcha-sources-2.6.23.17.125.71_p32-r1/arch/sh/oprofile/Kconfig
```kconfig
menu "Profiling support"
	depends on EXPERIMENTAL

config PROFILING
	bool "Profiling support (EXPERIMENTAL)"
	help
	  Say Y here to enable the extended profiling support mechanisms used
	  by profilers such as OProfile.
	  

config OPROFILE
	tristate "OProfile system profiling (EXPERIMENTAL)"
	depends on PROFILING
	help
	  OProfile is a profiling system capable of profiling the
	  whole system, include the kernel, kernel modules, libraries,
	  and applications.

	  If unsure, say N.

config OPROFILE_TMU
	bool "Use 710x TMU for profiling (EXPERIMENTAL)"
	depends on OPROFILE
	depends on CPU_SUBTYPE_STB7100
	help
	  Say Y here to use the 710x PWM timer for oprofile sampling.

endmenu
```

## G5/src/tchitcha-sources-2.6.23.17.125.71_p32-r1/drivers/char/lirc/Kconfig
```kconfig
# LIRC http://lirc.sf.net/
# Kernel patch by Flameeyes <dgp85@users.sf.net>
# Check for new patch at http://flameeyes.web.ctonet.it
#
# Thanks to Koos Vriezen <koos.vriezen@xs4all.nl> for the Homebrew support.
# Thanks to Jeff Clark <jeff@tmtrading.com> for support when I wasn't able
# to update it and for his patch (found at http://www.clarkmania.com/~jclark/
# Thanks to Bernhard Rosenkraenzer <bero@arklinux.org> for SMP patch.
# Thanks to Vince <fuzzy77@free.fr> for the temporary lirc_atiusb driver.
# Thanks to Paul Miller <pmiller9@users.sourceforge.net> for the new working
# lirc_atiusb driver.

menu "Linux InfraRed Controller"

config LIRC_SUPPORT
	tristate "Linux InfraRed Controller"

	config LIRC_I2C
		tristate "I2C Driver"
		depends on LIRC_SUPPORT && VIDEO_BT848 && I2C && I2C_ALGOBIT
		help
		  Say Y here if you need support for the following cards:

		  Pixelview IR
		  Hauppauage IR
		  PV951 IR
		  TV-Box IR
		  KNC ONE IR
		  Asus TV-Box and Creative
		  VisionTek BreakOut-Box
		  Leadtek Winfast PVR2000

		  If these dont make sense to you, then dont use the module.

	config LIRC_GPIO
		tristate "GPIO Driver"
		depends on LIRC_SUPPORT && VIDEO_BT848
		help
		  TV-card remote control support for bttv based systems:
		    AverMedia
		    BestBuy
		    Winfast TV2000
		    I-O Data GV-BCTV5/PCI

	config LIRC_BT829
		tristate "BT829 Driver"
		depends on LIRC_SUPPORT
		help
		  TV-card remote control support for BT829 based systems

	config LIRC_IT87
		tristate "IT87 Driver"
		depends on LIRC_SUPPORT
		help
		  ITE IT8705 and IT8712(not tested) CIR-port support

	config LIRC_ATIUSB
		tristate "ATI USB Driver"
		depends on LIRC_SUPPORT && USB
		help
		  Use this driver if you have an ATI X10 USB remote
		  or an ATI Remote Wonder or ATI Remote Wonder II

	config LIRC_MCEUSB
		tristate "MCE USB Driver"
		depends on LIRC_SUPPORT && USB
		help
		  USB Microsoft IR Transceiver driver

	config LIRC_MCEUSB2
		tristate "MCE USB Driver"
		depends on LIRC_SUPPORT && USB
		help
		  LIRC driver for the Philips eHome USB Infrared
		  Transciever and the Microsoft MCE 2005 Remote Control

	config LIRC_STREAMZAP
		tristate "Streamzap Driver"
		depends on LIRC_SUPPORT
		help
		  Install this driver if you have a Streamzap Remote Control

	config LIRC_IGORPLUGUSB
		tristate "Igorplugusb Driver"
		depends on LIRC_SUPPORT
		help
		  Install this driver if you have a homebrew IgorPlugUSB
		  receiver

	config LIRC_IMON
		tristate "IMON LIRC/VFD Driver"
		depends on LIRC_SUPPORT
		help
		  Install this driver if you have an Ahanix/Soundgraph IMON
		  IR receiver.  It also allows control of the VFD (display)

	config LIRC_CMDIR
		tristate "CMDIR Driver"
		depends on LIRC_SUPPORT && USB
		help
		  Install this driver if you have an InnovationOne's
		  COMMANDIR USB Transceiver

	config LIRC_SASEM
		tristate "Sasem Driver"
		depends on LIRC_SUPPORT && USB
		help
		  This driver provides support for the USB Sasem Remote
		  Controller V1.1

	config LIRC_PARALLEL
		tristate "Parallel Driver"
		depends on LIRC_SUPPORT && !SMP && PARPORT

		choice
			prompt "Parallel Port"
			depends on LIRC_PARALLEL
			config LIRC_PARALLEL_LPT1
				bool "LPT1 (0x378, 7)"
			config LIRC_PARALLEL_LPT2
				bool "LPT2 (0x278, 5)"
			config LIRC_PARALLEL_LPT3
				bool "COM3 (0x3bc, none)"
			config LIRC_PARALLEL_OTHER
				bool "Other (custom values)"
		endchoice

		config LIRC_PORT_PARALLEL
			hex "I/O Port"
				default "0x378" if LIRC_PARALLEL_LPT1
				default "0x278" if LIRC_PARALLEL_LPT2
				default "0x3bc" if LIRC_PARALLEL_LPT3
			depends on LIRC_PARALLEL

		config LIRC_IRQ_PARALLEL
			hex "IRQ"
				default "7" if LIRC_PARALLEL_LPT1
				default "5" if LIRC_PARALLEL_LPT2
			depends on LIRC_PARALLEL

		config LIRC_TIMER
			int "Timer"
			default "65535"
			depends on LIRC_PARALLEL

	config LIRC_SERIAL
		tristate "Serial Driver"
		depends on LIRC_SUPPORT && SERIAL_8250

		choice
			prompt "Serial Receiver Type"
			depends on LIRC_SERIAL

			config LIRC_HOMEBREW
				bool "Homebrew"

			config LIRC_SERIAL_ANIMAX
				bool "Animax"

			config LIRC_SERIAL_IRDEO
				bool "IRdeo"

			config LIRC_SERIAL_IRDEO_REMOTE
				bool "IRdeo Remote"

			config LIRC_SERIAL_NSLU2
				bool "NSLU2"

			config LIRC_SERIAL_IGOR
				bool "Igor Ceska's variation"

		endchoice

		config LIRC_SERIAL_TRANSMITTER
			bool "With transmitter diode"
			depends on LIRC_SERIAL && !LIRC_SERIAL_ANIMAX

		config LIRC_SERIAL_SOFTCARRIER
			bool "With software carrier"
			depends on LIRC_SERIAL_TRANSMITTER

		choice
			prompt "Serial Port"
			depends on LIRC_SERIAL
			config LIRC_SERIAL_COM1
				bool "COM1 (0x3f8, 4)"
			config LIRC_SERIAL_COM2
				bool "COM2 (0x2f8, 3)"
			config LIRC_SERIAL_COM3
				bool "COM3 (0x3e8, 4)"
			config LIRC_SERIAL_COM4
				bool "COM4 (0x2e8, 3)"
			config LIRC_SERIAL_OTHER
				bool "Other (custom values)"
		endchoice

		config LIRC_PORT_SERIAL
			hex "I/O Port"
				default "0x3f8" if LIRC_SERIAL_COM1
				default "0x2f8" if LIRC_SERIAL_COM2
				default "0x3e8" if LIRC_SERIAL_COM3
				default "0x2e8" if LIRC_SERIAL_COM4
			depends on LIRC_SERIAL

		config LIRC_IRQ_SERIAL
			hex "IRQ"
				default "4" if LIRC_SERIAL_COM1 || LIRC_SERIAL_COM3
				default "3" if LIRC_SERIAL_COM2 || LIRC_SERIAL_COM4
			depends on LIRC_SERIAL

	config LIRC_SIR
		tristate "SIR Driver"
		depends on LIRC_SUPPORT

		config LIRC_ON_SA1100
			bool "LIRC driver for StrongARM SA1100 embedded microprocessor"
			depends on LIRC_SIR

		choice
			prompt "SIR Type"
			depends on LIRC_SIR && !LIRC_ON_SA1100

			config LIRC_SIR_IRDA
				bool "SIR IrDA (built-in IR ports)"

			config LIRC_SIR_TEKRAM
				bool "Tekram Irmate 210 (16x50 UART compatible serial port)"

			config LIRC_SIR_ACTISYS_ACT200L
				bool "Actisys Act200L SIR driver support"

		endchoice

		choice
			prompt "Serial Port"
			depends on LIRC_SIR
			config LIRC_SIR_COM1
				bool "COM1 (0x3f8, 4)"
			config LIRC_SIR_COM2
				bool "COM2 (0x2f8, 3)"
			config LIRC_SIR_COM3
				bool "COM3 (0x3e8, 4)"
			config LIRC_SIR_COM4
				bool "COM4 (0x2e8, 3)"
			config LIRC_SIR_OTHER
				bool "Other (custom values)"
		endchoice

		config LIRC_PORT_SIR
			hex "I/O Port"
				default "0x3f8" if LIRC_SIR_COM1
				default "0x2f8" if LIRC_SIR_COM2
				default "0x3e8" if LIRC_SIR_COM3
				default "0x2e8" if LIRC_SIR_COM4
			depends on LIRC_SIR

		config LIRC_IRQ_SIR
			hex "IRQ"
				default "4" if LIRC_SIR_COM1 || LIRC_SIR_COM3
				default "3" if LIRC_SIR_COM2 || LIRC_SIR_COM4
			depends on LIRC_SIR
        config LIRC_STM
                tristate "STM Lirc support"
                depends on LIRC_SUPPORT && CPU_SUBTYPE_ST40
		help
		  The IR and UHF are identical and independent, except
		  that the IRB receiver does not use the noise filter.
		  Not all ST platforms support both type of receivers.
		  IR RX is the default mode.

        config LIRC_STM_UHF_RX
	        bool "UHF Receiver mode"
		depends on LIRC_STM
		help
		  This causes the driver to use UHF RX mode.

 	config LIRC_STM_DEBUG
 		depends on LIRC_STM
 		bool "Lirc debug"
 		default n
 		help
 		  Say yes if you want enable some debug printk information

 	config LIRC_LCD_NOISE_RUWIDO
 		depends on LIRC_STM
 		bool "STM Lirc LCD noise fix (Ruwido)"
 		help
		  Enables fix for LCD noise with ruwido IR protocol.

endmenu
```

## G5/src/tchitcha-sources-2.6.23.17.125.71_p32-r1/drivers/net/wireless/rt73/Kconfig
```kconfig
config RT73_WIRELESS
  tristate "rt73 wireless usb device"
  depends on USB && MAC80211 && WLAN_80211
	select FW_LOADER
  default n
 	---help---
	Say Y if you want to use one of the following Wirelles USB Ethernet
	devices based on the rt2571w, rt2573 and rt2671 chips.
	Development comes from http://sourceforge.net/projects/rt2400/
	Supported devices are:
	* Asus WL-167G
	* Belkin F5D7050EF
	* Belkin F5D7050ES
	* Conceptronic C54RU Ver2
	* D-Link DWL-G122 H/W Ver.:C1
	* Edimax EW7318UG
	* Linksys WUSB54GC
	* Sitecom WL-113
	* Sitecom WL-172
	* Surecom EP-9001-g
	* PLanex GW-US54HP
	* Digitus DN-7003GR VPR 1.0

	This driver makes the adapter appear as a normal Ethernet interface,
	typically on wlan0.

	rt73 device requires external firmware to be loaded (rt73.bin).
	This can be found as rpm starting from STLinux-2.3 release.

	To enable debug, please, add the following in command line:
	--------------
	rt73wlan=debug:<level>, with level=1,2,4,8 to enable respectively ERROR, WARN,
	TRACE and INFO debug.
	--------------
	Take care to have copied rt73.bin firmware file under /lib/firmware of your
	filesystem before plugging dongle in usb port.
	Please, plug dongles after kernel has booted, to avoid problems due to the
	firmware lack at startup.
	
	To compile this driver as a module, choose M here: the module will be called 
	rt73.ko.

config RT73_WIRELESS_FRMW_BUILTIN
	bool "Rt73 firmware loaded inside kernel"
	depends on RT73_WIRELESS=y
	default n
	---help---
	Enabling this kernel option you will be able to load rt73 firmware
	directly from kernel. In this case you have to put your rt73.bin
	file under usr kernel directory.
	To note that once on board, for each plug/unplug operation on your
	physical wireless device, the original rt73.bin firmware (/lib/firmware)
	will be used, so is mandatory to maintain it under the specified
	directory.
```
