## G5/src/tchitcha-sources-2.6.23.17.125.71_p32-r1/ltt/Kconfig
```kconfig
config LTT_TIMESTAMP
	bool "LTTng fine-grained timestamping"
	default y
	help
	  Allow fine-grained timestamps to be taken from tracing applications.

config LTT
	bool "Linux Trace Toolkit Instrumentation Support"
	depends on EXPERIMENTAL
	depends on MARKERS
	depends on LTT_TIMESTAMP
	default n
	help
	  It is possible for the kernel to log important events to a trace
	  facility. Doing so enables the use of the generated traces in order
	  to reconstruct the dynamic behavior of the kernel, and hence the
	  whole system.

	  The tracing process contains 4 parts :
	      1) The logging of events by key parts of the kernel.
	      2) The tracer that keeps the events in a data buffer (uses
	         relay).
	      3) A trace daemon that interacts with the tracer and is
	         notified every time there is a certain quantity of data to
	         read from the tracer.
	      4) A trace event data decoder that reads the accumulated data
	         and formats it in a human-readable format.

	  If you say Y, the first component will be built into the kernel.

	  For more information on kernel tracing, the trace daemon or the event
	  decoder, please check the following address :
	       http://www.opersys.com/ltt
	  See also the experimental page of the project :
	       http://ltt.polymtl.ca

config LTT_RELAY
	tristate "Linux Trace Toolkit Relay+DebugFS Support"
	select RELAY
	select DEBUG_FS
	depends on LTT_TRACER
	default y
	help
	  Support using relay and debugfs to log the data obtained through LTT.

	  If you don't have special hardware, you almost certainly want
	  to say Y here.

config LTT_SERIALIZE
	tristate "Linux Trace Toolkit Serializer"
	default y
	depends on LTT
	help
	  Library for serializing information from format string and argument
	  list to the trace buffers.

config LTT_MARKER_CONTROL
	tristate "Linux Trace Toolkit Marker Control"
	depends on LTT_SERIALIZE
	default y
	help
	  Interface (/proc/ltt) to enable markers.

config LTT_TRACER
	tristate "Linux Trace Toolkit Tracer"
	depends on LTT
	depends on LTT_MARKER_CONTROL
	default y
	help
	  If you enable this option, the Linux Trace Toolkit Tracer will be
	  either built in the kernel or as module.

	  Critical parts of the kernel will call upon the kernel tracing
	  function. The data is then recorded by the tracer if a trace daemon
	  is running in user-space and has issued a "start" command.

	  For more information on kernel tracing, the trace daemon or the event
	  decoder, please check the following address :
	       http://www.opersys.com/ltt
	  See also the experimental page of the project :
	       http://ltt.polymtl.ca

config LTT_ALIGNMENT
	bool "Align Linux Trace Toolkit Traces"
	depends on LTT
	default y
	help
	  This option enables dynamic alignment of data in buffers. The
	  alignment is made on the smallest size between architecture size
	  and the size of the value to be written.

	  Dynamically calculating the offset of the data has a performance cost,
	  but it is more efficient on some architectures (especially 64 bits) to
	  align data than to write it unaligned.

config LTT_VMCORE
	bool "Support trace extraction from crash dump"
	depends on LTT
	default y
	help
	  If you enable this option, the Linux Trace Toolkit Tracer will
	  support extacting ltt log from vmcore, which can be generated with
	  kdump or LKCD tools.

	  Special crash extension should be used to extract ltt buffers.

config LTT_HEARTBEAT
	bool "Write heartbeat event to shrink traces (EXPERIMENTAL)"
	depends on EXPERIMENTAL
	depends on LTT
	default n
	help
	  The Linux Trace Toolkit Heartbeat Timer fires at an interval small
	  enough to guarantee that the 32 bits truncated TSC won't overflow
	  between two timer executions. An event is written in the active
	  traces each time the timer is executed.

	  Note : it is currently broken with CPU hotplug and does not support
	  trace stop / restart correctly.

config LTT_NETLINK_CONTROL
	tristate "Linux Trace Toolkit Netlink Controller"
	depends on LTT_TRACER
	depends on NET
	default m
	help
	  If you enable this option, the Linux Trace Toolkit Netlink Controller
	  will be either built in the kernel or as module.

config LTT_STATEDUMP
	tristate "Linux Trace Toolkit State Dump"
	depends on LTT_TRACER
	default m
	help
	  If you enable this option, the Linux Trace Toolkit State Dump will
	  be either built in the kernel or as module.

	  This module saves the state of the running kernel at trace start
	  into the trace buffers along with the ongoing tracing information.

menu "Probes"
	depends on LTT_MARKER_CONTROL

config LTT_PROBE_FS
	tristate "Linux Trace Toolkit File System Probe"
	depends on LTT_MARKER_CONTROL
	depends on CRC32
	default m
	help
	  Activate per facility LTT probes. This is the dynamic mechanism
	  where the data gathering is. Probes connect to markers when their
	  module is loaded.

	  Probe file system events. It instruments the file operations and
	  dumps the beginning of data sent through read and write system calls.

config LTT_PROBE_STACK
	tristate "Sample process or kernel stacks (EXPERIMENTAL)"
	depends on LTT_MARKER_CONTROL
	depends on X86 || X86_64
	depends on CRC32
	default n
	help
	  Get complete process and/or kernel stack (architecture specific)

config LTT_PROCESS_STACK
	bool "Get complete process stack"
	depends on LTT_MARKER_CONTROL
	depends on X86
	depends on CRC32
	depends on UNWIND_INFO || !X86_64
	depends on STACK_UNWIND || !X86_64
	default n
	help
	  Get complete process stack.

	  It has three limitations : it only considers functions in the loaded
	  executable (not libraries) to be actual function pointers.
	  Furthermore, it will dump the stack of many threads at once for
	  multithreaded processes (it is protected from races between threads
	  though). It can also believe that arbitrary data on the stack
	  "looks like" a function pointer.

config LTT_PROCESS_MAX_FUNCTION_STACK
	int "Maximum number of longs on the stack between functions"
	depends on LTT_PROCESS_STACK
	default 100
	help
	  Maximum threshold over which, if we do not find a function pointer on
	  the process stack, we stop dumping the pointers on the stack.

config LTT_PROCESS_MAX_STACK_LEN
	int "Maximum number of longs on the stack to read"
	depends on LTT_PROCESS_STACK
	default 250
	help
	  Maximum threshold of stack size over which we stop looking for
	  function pointers.

config LTT_KERNEL_STACK
	bool "Get complete kernel stack"
	depends on LTT_PROBE_STACK
	default n
	help
	  Get complete kernel stack

endmenu
```

## G5/src/tchitcha-sources-2.6.23.17.125.71_p32-r1/mm/Kconfig
```kconfig
config SELECT_MEMORY_MODEL
	def_bool y
	depends on EXPERIMENTAL || ARCH_SELECT_MEMORY_MODEL

choice
	prompt "Memory model"
	depends on SELECT_MEMORY_MODEL
	default DISCONTIGMEM_MANUAL if ARCH_DISCONTIGMEM_DEFAULT
	default SPARSEMEM_MANUAL if ARCH_SPARSEMEM_DEFAULT
	default FLATMEM_MANUAL

config FLATMEM_MANUAL
	bool "Flat Memory"
	depends on !(ARCH_DISCONTIGMEM_ENABLE || ARCH_SPARSEMEM_ENABLE) || ARCH_FLATMEM_ENABLE
	help
	  This option allows you to change some of the ways that
	  Linux manages its memory internally.  Most users will
	  only have one option here: FLATMEM.  This is normal
	  and a correct option.

	  Some users of more advanced features like NUMA and
	  memory hotplug may have different options here.
	  DISCONTIGMEM is an more mature, better tested system,
	  but is incompatible with memory hotplug and may suffer
	  decreased performance over SPARSEMEM.  If unsure between
	  "Sparse Memory" and "Discontiguous Memory", choose
	  "Discontiguous Memory".

	  If unsure, choose this option (Flat Memory) over any other.

config DISCONTIGMEM_MANUAL
	bool "Discontiguous Memory"
	depends on ARCH_DISCONTIGMEM_ENABLE
	help
	  This option provides enhanced support for discontiguous
	  memory systems, over FLATMEM.  These systems have holes
	  in their physical address spaces, and this option provides
	  more efficient handling of these holes.  However, the vast
	  majority of hardware has quite flat address spaces, and
	  can have degraded performance from extra overhead that
	  this option imposes.

	  Many NUMA configurations will have this as the only option.

	  If unsure, choose "Flat Memory" over this option.

config SPARSEMEM_MANUAL
	bool "Sparse Memory"
	depends on ARCH_SPARSEMEM_ENABLE
	help
	  This will be the only option for some systems, including
	  memory hotplug systems.  This is normal.

	  For many other systems, this will be an alternative to
	  "Discontiguous Memory".  This option provides some potential
	  performance benefits, along with decreased code complexity,
	  but it is newer, and more experimental.

	  If unsure, choose "Discontiguous Memory" or "Flat Memory"
	  over this option.

endchoice

config DISCONTIGMEM
	def_bool y
	depends on (!SELECT_MEMORY_MODEL && ARCH_DISCONTIGMEM_ENABLE) || DISCONTIGMEM_MANUAL

config SPARSEMEM
	def_bool y
	depends on SPARSEMEM_MANUAL

config FLATMEM
	def_bool y
	depends on (!DISCONTIGMEM && !SPARSEMEM) || FLATMEM_MANUAL

config FLAT_NODE_MEM_MAP
	def_bool y
	depends on !SPARSEMEM

#
# Both the NUMA code and DISCONTIGMEM use arrays of pg_data_t's
# to represent different areas of memory.  This variable allows
# those dependencies to exist individually.
#
config NEED_MULTIPLE_NODES
	def_bool y
	depends on DISCONTIGMEM || NUMA

config HAVE_MEMORY_PRESENT
	def_bool y
	depends on ARCH_HAVE_MEMORY_PRESENT || SPARSEMEM

#
# SPARSEMEM_EXTREME (which is the default) does some bootmem
# allocations when memory_present() is called.  If this cannot
# be done on your architecture, select this option.  However,
# statically allocating the mem_section[] array can potentially
# consume vast quantities of .bss, so be careful.
#
# This option will also potentially produce smaller runtime code
# with gcc 3.4 and later.
#
config SPARSEMEM_STATIC
	def_bool n

#
# Architecture platforms which require a two level mem_section in SPARSEMEM
# must select this option. This is usually for architecture platforms with
# an extremely sparse physical address space.
#
config SPARSEMEM_EXTREME
	def_bool y
	depends on SPARSEMEM && !SPARSEMEM_STATIC

# eventually, we can have this option just 'select SPARSEMEM'
config MEMORY_HOTPLUG
	bool "Allow for memory hot-add"
	depends on SPARSEMEM || X86_64_ACPI_NUMA
	depends on HOTPLUG && !HIBERNATION && ARCH_ENABLE_MEMORY_HOTPLUG
	depends on (IA64 || X86 || PPC64 || SUPERH)

comment "Memory hotplug is currently incompatible with Software Suspend"
	depends on SPARSEMEM && HOTPLUG && HIBERNATION

config MEMORY_HOTPLUG_SPARSE
	def_bool y
	depends on SPARSEMEM && MEMORY_HOTPLUG

# Heavily threaded applications may benefit from splitting the mm-wide
# page_table_lock, so that faults on different parts of the user address
# space can be handled with less contention: split it at this NR_CPUS.
# Default to 4 for wider testing, though 8 might be more appropriate.
# ARM's adjust_pte (unused if VIPT) depends on mm-wide page_table_lock.
# PA-RISC 7xxx's spinlock_t would enlarge struct page from 32 to 44 bytes.
#
config SPLIT_PTLOCK_CPUS
	int
	default "4096" if ARM && !CPU_CACHE_VIPT
	default "4096" if PARISC && !PA20
	default "4096" if XEN
	default "4"

#
# support for page migration
#
config MIGRATION
	bool "Page migration"
	def_bool y
	depends on NUMA
	help
	  Allows the migration of the physical location of pages of processes
	  while the virtual addresses are not changed. This is useful for
	  example on NUMA systems to put pages nearer to the processors accessing
	  the page.

config RESOURCES_64BIT
	bool "64 bit Memory and IO resources (EXPERIMENTAL)" if (!64BIT && EXPERIMENTAL)
	default 64BIT
	help
	  This option allows memory and IO resources to be 64 bit.

config ZONE_DMA_FLAG
	int
	default "0" if !ZONE_DMA
	default "1"

config BOUNCE
	def_bool y
	depends on BLOCK && MMU && (ZONE_DMA || HIGHMEM)

config NR_QUICK
	int
	depends on QUICKLIST
	default "2" if (SUPERH && !SUPERH64)
	default "1"

config VIRT_TO_BUS
	def_bool y
	depends on !ARCH_NO_VIRT_TO_BUS

config BPA2
	bool "Big Physical Area version 2"
	help
	  Enables kernel support for reserving large areas of physical
	  memory at boot-time for use by certain device drivers (such as
	  video framegrabbers, etc.) which require it. This is backwards
	  compatible wit the origional "Big Physical Area" API,
	  but with extensions for multiple areas. It can also be configured
	  from the architecture specific setup code.

config BPA2_USERSPACE_ALLOCATION
       bool "Enable /dev/bpa2 for userspace allocation"
       depends on BPA2
       default n
       help
         Enables userspace memory allocator.

config BPA2_ALLOC_TRACE
	bool "Trace BPA2 allocations"
	depends on BPA2
	depends on PROC_FS
	default n
	help
	  Enables tracing of BPA2 allocations - /proc/bpa2 will list
	  all the allocations together with information about a code which
	  called the allocator function.

config DEFAULT_MMAP_MIN_ADDR
        int "Low address space to protect from user allocation"
        default 4096
        help
	  This is the portion of low virtual memory which should be protected
	  from userspace allocation.  Keeping a user from writing to low pages
	  can help reduce the impact of kernel NULL pointer bugs.

	  For most ia64, ppc64 and x86 users with lots of address space
	  a value of 65536 is reasonable and should cause no problems.
	  On arm and other archs it should not be higher than 32768.
	  Programs which use vm86 functionality or have some need to map
	  this low address space will need CAP_SYS_RAWIO or disable this
	  protection by setting the value to 0.

	  This value can be changed after boot using the
	  /proc/sys/vm/mmap_min_addr tunable.
```

## G5/src/wypti-ng-modules-2.3.17/linux/drivers/media/dvb/stm/frontend/Kconfig
```kconfig
config DVB_FRONTEND_STM
       bool "Enable STMicroelectronics frontends"
       depends on DVB_CORE
       ---help---
         Support for ST frontends.

	 Enables automatic and manual connection to PTI/FEI
	 with STV299, STV360 and NIM299, NIM360, Thomson DTF,
	 STEM299, STB6000.

	 Also allows direct connection to the Havana player.
	 
config DVB_STFEI
	tristate "ST FEI Support"
	depends on DVB_FRONTEND_STM && CPU_SUBTYPE_STX7200
	select DVB_STV0299
	select DVB_STV0360
	---help---
	  Support for ST front-end interfaces.

config DVB_STPTI
	tristate "ST-PTI Driver"
	depends on DVB_FRONTEND_STM && (CPU_SUBTYPE_STB5301 || CPU_SUBTYPE_STB7100)
	help
	  Support for the PTI

	  Say Y if you own such a device and want to use it.
```

## G6/src/alsa-headers-1.0.16/alsa-driver-1.0.16/acore/Kconfig
```kconfig
# for backward compatibility
config SND_BIT32_EMUL
	tristate

config SND_DEBUG_MEMORY
	bool "Debug memory"
	depends on SND_DEBUG
	help
	  Say Y here to enable debugging of memory allocations.

config SND_HPET
	tristate "High Precision Event Timer support"
	depends on SND && HPET
	select SND_TIMER
	help
	  Say Y here to enable HPET support for ALSA.  ALSA uses the
	  HPE timers as a precise timing source and maps the HPE
	  timers to ALSA's timer interface.  The ALSA sequencer code
	  also can use this timing source.

	  To compile this driver as a module, choose M here: the module
	  will be called snd-hpet.
```

## G6/src/alsa-headers-1.0.16/alsa-driver-1.0.16/arm/Kconfig
```kconfig
menu "ALSA ARM devices"
	depends on SND!=n && ARM

config SND_S3C2410
	tristate "S3C24XX Sound core"
	depends on ARCH_S3C2410 && SND
	select I2C_SENSOR
	select SND_PCM
	help
	  Say Y here if you want to use the inbuilt audio controller
	  on the S3C2410 or S3C2440

config SND_PXA2xx_I2SOUND
	tristate
	select SND_PCM

endmenu
```
