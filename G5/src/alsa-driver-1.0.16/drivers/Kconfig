## G5/src/tchitcha-sources-2.6.23.17.125.71_p32-r1/drivers/stm/Kconfig
```kconfig
#
# STM specific device configuration
#

config STM_DRIVERS
	boolean
	default y if CPU_SUBTYPE_ST40
	default n

menu "STM specific devices"
        depends on STM_DRIVERS

config STM_PIO
	tristate "STMicroelectronics PIO Support"
	depends on CPU_SUBTYPE_ST40
	default y
	help
	  Driver for the PIO pins on STMicroelectronics ST40 and ST200
	  based parts.

config STM_PIO10
	bool
	depends on STM_PIO
	default n

config STM_DMA
	bool "STMicroelectronics DMA API"
	select SH_DMA_API
	default y
	---help---
	  Selecting this option will provide support for STMicroelectronics'
	  custom DMA API. This API provides support for data transfers of
	  various dimensions and complex linked list operations. In addition
	  to these free-running operations it also allows management of the
	  paced-transfer peripherals on recent STM parts.

	  On STb710x and STx7200 DMA support is vital for the correct operation of the
	  sound system.

	  If you have a device from STMicroelectronics, then say Y here.
	  Otherwise say N.

config MIN_STM_DMA_CHANNEL_NR
	depends on STM_DMA
	int "Lowest STM-FDMAC channel"
	default "0"
	help
	  This allows you to specify the low boundary FDMA channel number to
	  use with STM-DMA

config MAX_STM_DMA_CHANNEL_NR
	depends on STM_DMA
	int "Highest STM-FDMAC channel"
	default "15"
	help
	  This allows you to specify the high boundary FDMA channel number to
	  use with STM-DMA

config STM_DMA_DEBUG
	bool "STMicroelectronics DMA Debug"
	depends on STM_DMA
	default n

choice
	prompt "FDMA firmware loading strategy"
	depends on STM_DMA
	default STM_DMA_FW_KERNEL

config  STM_DMA_FW_USERSPACE
	depends on EXPERIMENTAL
	bool "Use hotplug firmware loading framework (EXPERIMENTAL)"

config STM_DMA_FW_KERNEL
	bool "Use firmware linked into the kernel image"

endchoice

config STM_COPROCESSOR_SUPPORT
	bool "STMicroelectronics coprocessor support"
	default y
	depends on CPU_SUBTYPE_STB7100 || CPU_SUBTYPE_STX7105 || CPU_SUBTYPE_STX7111 || CPU_SUBTYPE_STX7141 || CPU_SUBTYPE_STX7200 || CPU_SUBTYPE_STX7108
	---help---
        Many of the ST system-on-chip devices have multiple CPUs, where a
        master CPU running Linux has control over a number of slave CPUs,
        which are usually used to run dedicated algorithms.
        Enabling this option will add support to the Linux kernel to
        control these slave CPUs, reserve memory for them, and thus allow
        code to be downloaded onto them and executed.
        Adding in the command line the following string:
        coprocessor_mem=[offset]:size0[,size1][,size2]...
        where:
        offset defines where the co-processors region starts.
               It's an offset from ST40 RAM start.
        size{n} defines the region size for the n.th slave core (max 16M).

        Example: coprocessor_mem=32m:16m,16m

config STM_NUM_COPROCESSOR
	int
	depends on STM_COPROCESSOR_SUPPORT
	default 2 if CPU_SUBTYPE_STB7100
	default 2 if CPU_SUBTYPE_STX7105
	default 3 if CPU_SUBTYPE_STX7108
	default 2 if CPU_SUBTYPE_STX7111
	default 2 if CPU_SUBTYPE_STX7141
	default 4 if CPU_SUBTYPE_STX7200
	default 0

choice
	prompt "STM coprocessor loading strategy"
        depends on STM_COPROCESSOR_SUPPORT
        default STM_COPROCESSOR

config  STM_COPROCESSOR
	bool "STM coprocessor support"
	help
	  Select this option to enable support for the slave coprocessors
	  found on many ST system-on-chip devices.

config  STM_COPROCESSOR_FRMW
	bool "The new STM coprocessor firmware support "
	select FW_LOADER
	help
	  Select this option to enable support for the slave coprocessors
	  found on many ST system-on-chip devices.

endchoice

config  COPROCESSOR_DEBUG
        depends on STM_COPROCESSOR_SUPPORT
        bool "STM coprocessor debug"
        default n
        ---help---
        Enable this option to print out information about the slave CPUs
        addresses and operations you are using for coprocessor.

config STM_RNG
       depends on CPU_SUBTYPE_ST40
       bool "STM Random Number Generator Support"
       default y
       ---help---
         This option adds support for the hardware Random Number Generator
          (RNG) present on the STx71xx and STx7200 SoCs.  It allows the
         RNG to feed /dev/random with entropy thereby ensuring real
         random numbers from this device.

         Without this option, /dev/random has little entropy and is not
         useful.  In fact, it may block for a long time while waiting for
         entropy.

         This option should always be enabled for the STx71xx and STx7200
         SoCs.

          This option can be used in conjunction with the /dev/hw_random
          driver found in the char drivers menu.

config STM_LPC
	depends on STM_DRIVERS
	bool "STM Low Power Controller"
	default n if !PM
	default y if PM
	---help---
	  This option adds support for the hardware low power controller.

config STM_LPC_DEBUG
	depends on STM_LPC
	bool "STM Low Power Controller debug"
	default n
	---help---
	  Enable this option to print out information about the LPC

config PMS
	bool "Power Management Scheme"
	default n
	depends on PM
	help
	  This option enables the power management scheme on clocks and devices system

config PMS_CHECK_GROUP
	bool "PMS always checks the state group"
	depends on PMS
	default n
	help
	  Enable this option if the state group has to be controlled

config PMS_DEBUG
	bool "PMS debug"
	default n
	depends on PMS

config STM_MIPHY
	bool
	depends on SATA_STM
	default y if CPU_SUBTYPE_STX7105 
	default y if CPU_SUBTYPE_STX7108
	default y if CPU_SUBTYPE_STX7141
	default y if CPU_SUBTYPE_STX7200
	default n

endmenu
```

## G5/src/tchitcha-sources-2.6.23.17.125.71_p32-r1/kernel/Kconfig.instrumentation
```kconfig
menu "Instrumentation Support"

config KPROBES
	bool "Kprobes (EXPERIMENTAL)"
	depends on EXPERIMENTAL
	help
	  Kprobes allows you to trap at almost any kernel address and
	  execute a callback function.  register_kprobe() establishes
	  a probepoint and specifies the callback.  Kprobes is useful
	  for kernel debugging, non-intrusive instrumentation and testing.
	  If in doubt, say "N".

config KPTRACE
	tristate "KPTrace (EXPERIMENTAL)"
	select KPROBES
	select DEBUG_FS
	select RELAY
	select SYSFS
	select KALLSYMS
	help
	  KPTrace is a Kprobes-based trace tool. It provides a full set
	  of pre-defined tracepoints, plus a simple way to add and remove
	  tracepoints at runtime.

config KPTRACE_SYNC
	bool "Trace synchronization events"
	depends on KPTRACE
	default n
	help
	 For KPTrace to be able to trace synchonization events (for example
	 mutex and semaphore usage), certain key functions like mutex_lock
	 must not be inlined. This may adversely affect system performance,
	 and so this option must be used with care.

config MARKERS
	bool "Activate markers"
	help
	  Place an empty function call at each marker site. Can be
	  dynamically changed for a probe function.

source "ltt/Kconfig"

endmenu
```

## G5/src/tchitcha-sources-2.6.23.17.125.71_p32-r1/lib/Kconfig.kgdb
```kconfig
config WANT_EXTRA_DEBUG_INFORMATION
	bool
	select DEBUG_INFO
	select UNWIND_INFO
	select FRAME_POINTER if SUPERH
	default n

config UNWIND_INFO
	bool
	default n

config KGDB
	bool "KGDB: kernel debugging with remote gdb"
	select WANT_EXTRA_DEBUG_INFORMATION
	depends on DEBUG_KERNEL
	help
	  If you say Y here, it will be possible to remotely debug the
	  kernel using gdb.  Documentation of kernel debugger is available
	  at http://kgdb.sourceforge.net as well as in DocBook form
	  in Documentation/DocBook/.  If unsure, say N.

config KGDB_ARCH_HAS_SHADOW_INFO
	bool

config KGDB_CONSOLE
	bool "KGDB: Console messages through gdb"
	depends on KGDB
	help
	  If you say Y here, console messages will appear through gdb.
	  Other consoles such as tty or ttyS will continue to work as usual.
	  Note that if you use this in conjunction with KGDBOE, if the
	  ethernet driver runs into an error condition during use with KGDB,
	  it is possible to hit an infinite recursion, causing the kernel
	  to crash, and typically reboot.  For this reason, it is preferable
	  to use NETCONSOLE in conjunction with KGDBOE instead of
	  KGDB_CONSOLE.

choice
	prompt "Method for KGDB communication"
	depends on KGDB
	default KGDB_ST_ASC
	help
	  There are a number of different ways in which you can communicate
	  with KGDB.  The most common is via serial.
	  Another option is to use the NETPOLL framework and UDP, should
	  your ethernet card support this.  Other options may exist.
	  You can elect to have one core I/O driver that is built into the
	  kernel for debugging as the kernel is booting, or using only
	  kernel modules.

config KGDB_ST_ASC
	bool "KGDB: On STASC serial port"
	depends on SUPERH
	help
	   Uses the STASC serial port to communicate with the host GDB.

config KGDBOE
	bool "KGDB: On ethernet"
	depends on NET
	select NETPOLL
	select NETPOLL_TRAP
	select NET_POLL_CONTROLLER
	help
	  Uses the NETPOLL API to communicate with the host GDB via UDP.
	  In order for this to work, the ethernet interface specified must
	  support the NETPOLL API, and this must be initialized at boot.
	  See the documentation for syntax.

endchoice

config KGDB_SIMPLE_SERIAL
	bool "Simple selection of KGDB serial port"
	depends on KGDB_ST_ASC
	default y
	help
	  If you say Y here, you will only have to pick the baud rate
	  and port number that you wish to use for KGDB.  Note that this
	  only works on architectures that register known serial ports
	  early on.  If you say N, you will have to provide, either here
	  or on the command line, the type (I/O or MMIO), IRQ and
	  address to use.  If in doubt, say Y.

config KGDB_BAUDRATE
	int "Debug serial port baud rate"
	depends on KGDB_SIMPLE_SERIAL
	default "115200"
	help
	  gdb and the kernel stub need to agree on the baud rate to be
	  used.  Standard rates from 9600 to 115200 are allowed, and this
	  may be overridden via the commandline.

config KGDB_PORT_NUM
	int "Serial port number for KGDB"
	depends on KGDB_SIMPLE_SERIAL
	range 0 4
	default "0"
	help
	  Pick the port number for KGDB to use.

config KGDB_ATTACH_WAIT
	depends on KGDB
	bool "KGDB: Wait for debugger to attach on an unknown exception"
	help
	  If a panic occurs, or any kind of exception, the kgdb will
	  stop and wait for a debugger to attach.  This sets the
	  default behavior for waiting for the debugger to attach.  This
	  value can also be changed at runtime through
	  /sys/module/kgdb/parameters/attachwait
```
