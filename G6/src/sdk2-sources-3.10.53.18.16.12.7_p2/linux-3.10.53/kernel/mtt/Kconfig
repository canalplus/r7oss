## G9/src/armbcm-linux-sources-3.14.28.1.14_p14/linux/Documentation/devicetree/bindings/mtd/brcmstb_nand.txt
```
* Broadcom STB NAND Controller

The Broadcom STB NAND controller utilizes the MTD subsystem to provide generic
access to NAND flash chips.

Required properties:
- compatible     : should contain "brcm,brcmnand" and an appropriate version
                   compatibility string, like "brcm,brcmnand-v7.0"
- reg            : the register start and length for NAND and (if present)
                   FLASH_DMA blocks
- reg-names      : a list of the names corresponding to the previous register
		   ranges. Should contain "nand" and (if FLASH_DMA is
                   available) "flash-dma".
- interrupts     : The HIF L2 interrupts for NAND_CLTRDY and (if FLASH_DMA is
                   available) FLASH_DMA_DONE
- interrupt-parent: The phandle to the HIF L2 interrupt controller node
- #address-cells : <1> - subnodes give the chip-select number
- #size-cells    : <0>

Each controller (compatible: "brcm,brcmnand") may contain one or more subnodes
to represent enabled chip-selects which (may) contain NAND flash chips. Their
properties are as follows.

Required properties:
- compatible        : should contain "brcm,nandcs"
- reg               : a single integer representing the chip-select number
                      (e.g., 0, 1, 2, etc.)
- #address-cells    : see partition.txt
- #size-cells       : see partition.txt

Optional properties:
- nand-on-flash-bbt : boolean, to enable the on-flash BBT for this chip-select

Each nandcs device node may optionally contain sub-nodes describing the flash
partition mapping. See partition.txt for more detail.

Example:

nand@f0442800 {
	compatible = "brcm,brcmnand-v7.0", "brcm,brcmnand";
	reg = <0xF0442800 0x600>,
	      <0xF0443000 0x100>;
	reg-names = "nand", "flash-dma";
	interrupt-parent = <&hif_intr2_intc>;
	interrupts = <24>, <4>;

	#address-cells = <1>;
	#size-cells = <0>;

	nandcs@1 {
		compatible = "brcm,nandcs";
		reg = <1>; // Chip select 1
		nand-on-flash-bbt;

		// Partitions
		#address-cells = <1>;  // <2>, for 64-bit offset
		#size-cells = <1>;     // <2>, for 64-bit length
		flash0.rootfs@0 {
			reg = <0 0x10000000>;
		};
		flash0@0 {
			reg = <0 0>; // MTDPART_SIZ_FULL
		};
		flash0.kernel@10000000 {
			reg = <0x10000000 0x400000>;
		};
	};
};
```

## G9/src/armbcm-linux-sources-3.14.28.1.14_p14/linux/Documentation/devicetree/bindings/net/broadcom-bcmgenet.txt
```
* Broadcom BCM7xxx Ethernet Controller (GENET)

Required properties:
- compatible: should be "brcm,genet-v1", "brcm,genet-v2", "brcm,genet-v3",
  "brcm,genet-v4".
- reg: address and length of the register set for the device.
- interrupts: interrupt for the device
- mdio bus node: this node should always be present regarless of the PHY
  configuration of the GENET instance
- phy-mode: The interface between the SoC and the PHY (a string that
  of_get_phy_mode() can understand).

MDIO bus node required properties:

- compatible: should be "brcm,genet-v<N>-mdio"
- reg: address and length relative to the parent node base register address
- address-cells: address cell for MDIO bus addressing, should be 1
- size-cells: size of the cells for MDIO bus addressing, should be 0

Optional properties:
- phy-handle: A phandle to a phy node defining the PHY address (as the reg
  property, a single integer), used to describe configurations where a PHY
  (internal or external) is used.

- fixed-link: When the GENET interface is connected to a MoCA hardware block
  or when operating in a RGMII to RGMII type of connection, or when the
  MDIO bus is voluntarily disabled, this property should be used to describe
  the "fixed link", the property is described as follows:

  fixed-link: <a b c d e> where a is emulated phy id - choose any,
  but unique to the all specified fixed-links, b is duplex - 0 half,
  1 full, c is link speed - d#10/d#100/d#1000, d is pause - 0 no
  pause, 1 pause, e is asym_pause - 0 no asym_pause, 1 asym_pause.

- clocks: When provided, must be two phandles to the functional clock nodes
  of the GENET block. The first phandle is the main GENET clock used during
  normal operation, while the second phandle is the Wake-on-LAN clock.

- clock-names: When provided, names of the functional clock phandles, first
  name should be "sw_genet" and second should be "sw_genetwol".

Internal Gigabit PHY example:

ethernet@f0b60000 {
	phy-mode = "internal";
	phy-handle = <&phy1>;
	mac-address = [ 00 10 18 36 23 1a ];
	compatible = "brcm,genet-v4";
	#address-cells = <0x1>;
	#size-cells = <0x1>;
	device_type = "ethernet";
	reg = <0xf0b60000 0xfc4c>;
	interrupts = <0x0 0x14 0x0 0x0 0x15 0x0>;

	mdio@b60e14 {
		compatible = "brcm,genet-mdio-v4";
		#address-cells = <0x1>;
		#size-cells = <0x0>;
		reg = <0xb60e14 0x8>;

		phy1: ethernet-phy@1 {
			device_type = "ethernet-phy";
			max-speed = <1000>;
			reg = <0x1>;
			compatible = "brcm,28nm-gphy", "ethernet-phy-ieee802.3-c22";
		};
	};
};

MoCA interface / MAC to MAC example:

ethernet@f0b80000 {
	phy-mode = "moca";
	fixed-link = <1 0 1000 0 0>;
	mac-address = [ 00 10 18 36 24 1a ];
	compatible = "brcm,genet-v4";
	#address-cells = <0x1>;
	#size-cells = <0x1>;
	device_type = "ethernet";
	reg = <0xf0b80000 0xfc4c>;
	interrupts = <0x0 0x16 0x0 0x0 0x17 0x0>;

	mdio@b80e14 {
		compatible = "brcm,genet-mdio-v4";
		#address-cells = <0x1>;
		#size-cells = <0x0>;
		reg = <0xb80e14 0x8>;
	};
};


External MDIO-connected Gigabit PHY/switch:

ethernet@f0ba0000 {
	phy-mode = "rgmii";
	phy-handle = <&phy0>;
	mac-address = [ 00 10 18 36 26 1a ];
	compatible = "brcm,genet-v4";
	#address-cells = <0x1>;
	#size-cells = <0x1>;
	device_type = "ethernet";
	reg = <0xf0ba0000 0xfc4c>;
	interrupts = <0x0 0x18 0x0 0x0 0x19 0x0>;

	mdio@ba0e14 {
		compatible = "brcm,genet-mdio-v4";
		#address-cells = <0x1>;
		#size-cells = <0x0>;
		reg = <0xba0e14 0x8>;

		phy0: ethernet-phy@0 {
			device_type = "ethernet-phy";
			max-speed = <1000>;
			reg = <0x0>;
			compatible = "brcm,bcm53125", "ethernet-phy-ieee802.3-c22";
		};
	};
};
```

## G9/src/armbcm-linux-sources-3.14.28.1.14_p14/linux/Documentation/devicetree/bindings/net/broadcom-mdio-unimac.txt
```
* Broadcom UniMAC MDIO bus controller

Required properties:
- compatible: should be "brcm,unimac-mdio"
- reg: address and length of the regsiter set for the device, first one is the
  base register, and the second one is optional and for indirect accesses
- reg-names: name(s) of the register must be "mdio" and optional "mdio_indir_rw"
- #size-cells: must be 1
- #address-cells: must be 0

Optional properties:
- interrupts: must be two interrupts, one for MDIO done, one for MDIO error
- interrupt-names: must be "mdio_done" for the first interrupt and "mdio_error"
  for the second

Child nodes of this MDIO bus controller node are standard Ethernet PHY device
nodes as described in Documentation/devicetree/bindings/net/phy.txt

Example:

mdio@403c0 {
	compatible = "brcm,unimac-mdio";
	reg = <0x403c0 0x8 0x40300 0x18>;
	reg-names = "mdio", "mdio_indir_rw";
	#size-cells = <1>;
	#address-cells = <0>;

	...
	phy@0 {
		compatible = "ethernet-phy-ieee802.3-c22";
		reg = <0>;
	};
};
```

## G9/src/armbcm-linux-sources-3.14.28.1.14_p14/linux/Documentation/devicetree/bindings/net/broadcom-systemport.txt
```
* Broadcom BCM7xxx Ethernet Systemport Controller (SYSTEMPORT)

Required properties:
- compatible: should be one of "brcm,systemport-v1.00" or "brcm,systemport"
- reg: address and length of the register set for the device.
- interrupts: interrupt(s) for the device, 1 interrupt is the RX and misc
  interrupts, the second is the TX queues interrupts. A 3rd optional interupt
  is used for Wake-on-LAN
- local-mac-address: Ethernet MAC address (48 bits) of this adapter
- phy-mode: Should be a string describing the PHY interface to the
  Ethernet switch/PHY
- fixed-link: <a b c d e> where a is emulated phy id - choose any,
  but unique to the all specified fixed-links, b is duplex - 0 half,
  1 full, c is link speed - d#10/d#100/d#1000, d is pause - 0 no
  pause, 1 pause, e is asym_pause - 0 no asym_pause, 1 asym_pause.

Optional properties:
- systemport,num-tier2-arb: number of tier 2 arbiters, an integer
- systemport,num-tier1-arb: number of tier 1 arbiters, an integer
- systemport,num-txq: number of HW transmit queues, an integer
- systemport,num-rxq: number of HW receive queues, an integer

Example:
ethernet@f04a0000 {
	compatible = "brcm,systemport-v1.00";
	reg = <0xf04a0000 0x4650>;
	local-mac-address = [ 00 11 22 33 44 55 ];
	fixed-link = <0 1 1000 0 0>;
	phy-mode = "gmii";
	interrupts = <0x0 0x16 0x0>,
		<0x0 0x17 0x0>;
};
```

## G9/src/armbcm-linux-sources-3.14.28.1.14_p14/linux/Documentation/devicetree/bindings/pci/brcmstb-pci.txt
```
Brcmstb PCIe Host Controller Device Tree Bindings

Introduction:

The brcmstb host controller closely follows the example set in

	[1] http://devicetree.org/Device_Tree_Usage#PCI_Host_Bridge

The rest of this document explains some added customizations and
offers an example Brcmstb PCIe host controller DT node.

Required Properties:
  reg -- the register start address and length for the PCIe block.
      Additional start,length pairs may be specified for clock addresses.
  interrupts -- this must be specified but it is used indirectly.  Interrupt
      zero must be specified; the Brcmstb driver code uses this interrupt
      to determine the offset used for all interrupts, specifically, those
      listed in interrupt-map.
  compatible -- must specify the string "brcm,pci-plat-dev".
  #address-cells -- the number of address cells for PCI-space.
  #size-cells -- the number of size cells for PCI-space.
  ranges -- See [1]; a specification of the outbound windows for the host
      controller.  Each outbound window is described by a 7-tuple:
          (3 entries) -- PCIe space start address (0th entry is ignored).
          (2 entries) -- CPU/System start address
          (2 entries) -- Size of region.
      Due to hardware limitations, there may be a maximum of four windows
      specified.
  #interrupt-cells -- number of cells used to describe the interrupt.
  interrupt-map -- See [1]; each interrupt requires 7 entries, and
      currently all but the fifth entry (order 0) -- the interrupt
      number -- is ignored.  There must be four interrupts specified
      for the PCI's INTA, INTB, INTC, and INTD.

Optional Properties:
  interrupt-names -- names of the interrupts listed in the interrupt map.
  clocks -- list of clock phandles.  If specified, this should list one
      clock.
  clock-names -- the "local" names of the clocks specified in 'clocks'.  Note
      that if the 'clocks' property is given, 'clock-names' is mandatory,
      and the name of the clock is expected to be "sw_pcie".
  brcm,ssc -- (boolean) indicates usage of spread-spectrum clocking.
  brcm,gen --  (integer) indicates desired generation of link:
      1 => 2.5 Gbps, 2 => 5.0 Gbps, 3 => 8.0 Gbps.
  supply-names -- the names of voltage regulators that the root
      complex should turn off/on/on on suspend/resume/boot.  This
      is a string list.  
  supplies -- A collection of phandles to a regulator nodes, see
	Documentation/devicetree/bindings/regulator/ for specific
	bindings. The number and order of phandles must match
	exactly the number of strings in the "supply-names" property.

Example Node:

	pcie@f0460000 {
		reg = <0x0 0xf0460000 0x0 0x9310>;
		interrupts = <0x0 0x0 0x4>;
		compatible = "brcm,pci-plat-dev";
		#address-cells = <3>;
		#size-cells = <2>;
		ranges = <0x02000000 0x00000000 0x00000000 0x00000000 0xc0000000 0x00000000 0x08000000
			  0x02000000 0x00000000 0x08000000 0x00000000 0xc8000000 0x00000000 0x08000000>;
		#interrupt-cells = <1>;
		interrupt-map-mask = <0xf800 0 0 7>;
		interrupt-map = <0 0 0 1 &intc 47 3
				 0 0 0 2 &intc 48 3
				 0 0 0 3 &intc 49 3
				 0 0 0 4 &intc 50 3>;
		interrupt-names = "pcie_0_inta",
				  "pcie_0_intb",
				  "pcie_0_intc",
				  "pcie_0_intd";
		clocks = <&sw_pcie0>;
		clock-names = "sw_pcie";
		brcm,ssc;
		brcm,gen = <1>;
		supply-names = "vreg-wifi-pwr";
		supplies = <&vreg-wifi-pwr>;

	};
```

## G9/src/armbcm-linux-sources-3.14.28.1.14_p14/linux/Documentation/devicetree/bindings/serial/brcm-broken-dw-apb-uart.txt
```
* Broadcom buggy variant on Synopsys DW APB UART

This UART variant is for a Synopsys DW APB UART that cannot reset the
"busy detect" interrupt (IIR == 7).

Required properties:
- compatible: should be "brcm,buggy-dw-apb-uart"
- reg: The base address of the UART register bank
- interrupts: Should be the UART interrupt specifier.

Optional properties:
- clock-frequency: frequency of the clock input to the UART
- reg-io-width: UART register width
- reg-shift: amount by which to shift offsets


Example:

serial@f0406b00 {
	compatible = "brcm,buggy-dw-apb-uart";
	reg = <0xf0406b00 0x20>;
	reg-shift = <0x2>;
	reg-io-width = <0x4>;
	interrupts = <0x0 0x4b 0x4>;
	clock-frequency = <0x4d3f640>;
};
```

## G9/src/armbcm-linux-sources-3.14.28.1.14_p14/linux/Documentation/devicetree/bindings/spi/brcm,spi-brcmstb-mspi.txt
```
Broadcom MSPI controller

The Broadcom MSPI controller is a SPI master found on various chips, including
BRCMSTB (BCM7XXX) and Cygnus.

Required properties:

- #address-cells:
    Must be <1>, as required by generic SPI binding.

- #size-cells:
    Must be <0>, also as required by generic SPI binding.

- compatible:
    Must be "brcm,spi-brcmstb-mspi" or "brcm,spi-brcmstb".

- reg:
    Define the bases and ranges of the associated I/O address spaces.
    For historical reasons, the first range should contain the MSPI controller
    registers, while the others may be for extended interrupt control or an
    optional Boot SPI (BSPI) portion for accelerating flash reads.  Only
    the MSPI controller register range is required.

- reg-names:
    First name does not matter, but must be reserved for the MSPI controller
    register range as mentioned in 'reg' above, and will typically contain
    "mspi" or "hif_mspi".
    Other names include:
    - "bspi": BSPI register range
    - "bspi_raf": Linear read BSPI pipe register range

- interrupts + interrupt-parent OR interrupts-extended:
    The interrupts used by the MSPI controller.

- interrupt-names:
    Names of interrupts associated with this MSPI controller.
    - "mspi_done": Indicates that the requested SPI operation is complete.

Optional properties:

- clocks:
    A phandle to the reference clock for this block.  If not present, will
    assume a 27 MHz fixed clock (default for UPG).

Examples:

spi@f0416000 {
	#address-cells = <1>;
	#size-cells = <0>;
	clocks = <&upg_fixed>;
	compatible = "brcm,spi-brcmstb-mspi";
	reg = <0xf0416000 0x180>;
	reg-names = "mspi";
	interrupts = <0x14>;
	interrupt-parent = <&irq0_aon_intc>;
	interrupt-names = "mspi_done";
};

spi@f03e3400 {
	#address-cells = <1>;
	#size-cells = <0>;
	compatible = "brcm,spi-brcmstb";
	status = "disabled";
	reg = <0xf03e3400 0x188>,
		<0xf03e3200 0x50>,
		<0xf03e3300 0x24>;
	reg-names = "hif_mspi",
		"bspi",
		"bspi_raf";
	interrupts = <0x0 0x21 0x0>;
	interrupt-parent = <&intc>;
	interrupts-extended = <&intc 0x0 0x21 0x0>,
		<&hif_spi_intr2_intc 0x0>,
		<&hif_spi_intr2_intc 0x1>,
		<&hif_spi_intr2_intc 0x2>,
		<&hif_spi_intr2_intc 0x3>,
		<&hif_spi_intr2_intc 0x5>,
		<&hif_spi_intr2_intc 0x6>;
	interrupt-names = "hif_spi",
		"spi_lr_fullness_reached",
		"spi_lr_session_aborted",
		"spi_lr_impatient",
		"spi_lr_session_done",
		"mspi_done",
		"mspi_halted";
	clocks = <&sw_spi>;
	clock-names = "sw_spi";
};
```
