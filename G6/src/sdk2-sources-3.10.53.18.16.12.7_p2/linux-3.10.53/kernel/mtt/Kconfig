## G9/src/armbcm-linux-sources-3.14.28.1.14_p14/linux/Documentation/devicetree/bindings/clock/brcmstb-clock.txt
```
Device Tree Clock bindings for brcmstb

In addition to the platform bindings provided in-tree, the brcmstb common
clock driver supports the following clock providers/consumers:

	- CPU clock dividers (provider/consumer)
	- bcm_clk_gate
	- bcm_clk_sw

=== CPU clock divider ===

The CPU divider node serves as the sole clock for the CPU complex. It supports
power-of-2 clock division, with a divider of "1" as the default highest-speed
setting.

Required properties:
- compatible : shall be one of the following:
	"brcm,brcmstb-cpu-clk-div"
- reg : address and width of the divider configuration register
- #clock-cells : shall be set to 0
- clocks : phandle of clock provider which provides the source clock
	   (this would typically be a "fixed-clock" type PLL)
- div-table : list of (raw_value,divider) ordered pairs that correspond to the
	      allowed clock divider settings
- div-shift-width : least-significant bit position and width of divider value

example:
	cpupll: cpupll@0 {
		compatible = "fixed-clock";
		#clock-cells = <0>;
		clock-frequency = <1500000000>;
	};

	cpuclk: cpu-clk-div@0 {
		compatible = "brcm,brcmstb-cpu-clk-div";
		reg = <0xf03e257c 0x4>;
		#clock-cells = <0>;
		clocks = <&cpupll>;
		div-table = <0x00 1 0x11 2 0x12 4 0x13 8 0x14 16>;
		div-shift-width = <0 5>;
	};

	cpus {
		cpu@0 {
			clocks = <&cpuclk>;
		};
	};


=== bcm_clk_gate ===

bcm_clk_gate is a clock type very similar to the clk_gate defined in
drivers/clk/clk-gate.  In fact, some of the code has been copied
verbatim.  The main difference is that bcm_clk_gate may have a delay
specified.  

Required properties:
- compatible: must be "brcm,brcmstb-gate-clk"
- reg : the register address of the bit that gets set/unset.  The
	register range will always have a size of four bytes.
- #clock-cells : see clock-bindings.txt.
- bit-shift -- the bit position of reg that enables/disables the clock.

Optional properties:
- clocks : see clock-bindings.txt.
- clock-names : see clock-bindings.txt.
- set-bit-to-disable : inverts default gate programming. Setting the bit
	gates the clock and clearing the bit ungates the clock.
- brcm,delay : this indicates that there must be a delay after the
	bit is changed.  The first parameter is the delay in usec
	after the bit is being set to 0.  The second parameter is the
	delay in usec after the bit is being set to 1.  So for the
	example of <0 200>, there must be a delay of 200 usec after
	setting the bit to 1.  
- clock-output-names : see clock-bindings.txt.
- brcm,read-only : specified if a clock can whose enable and 
	disable actions do nothing as they do not write the
	register.  This is a boolean.
- brcm,inhibit-disable : specified if a clock is allowed to
	enable but not disable; ie the disable action does
	nothing.  This is a boolean.

example:
	lc_pll_reseta : lc_pll_reseta@f04e014c {
		compatible = "brcm,brcmstb-gate-clk";
		#clock-cells = <0>;
		reg = <0xf04e014c 0x4>;
		bit-shift = <0>;
		set-bit-to-disable;
		brcm,delay = <0 200>;
		clocks = <&iso_ck_pll_lc>; 
		clock-names = "iso_ck_pll_lc"; 


=== bcm_clk_sw ===

bcm_clk_sw is a clock type which has no hardware counterpart: it
is used solely to enable/disable one or more parent clocks in
unison.  

Required properties:
- compatible : must be "brcm,brcmstb-sw-clk"
- #clock-cells : see clock-bindings.txt.

Optional properties:
- clocks : the list of parent clocks.  
- clock-names : the names of the parent clocks in the same order
	as the 'clocks' property.

Example:
	top_usb21 : top_usb21 {
		compatible = "brcm,brcmstb-sw-clk";
		#clock-cells = <0>;
		clocks = <&usb1_27_mdio_ck>, <&usb1_freerun_ck>, 
		  <&usb1_gisb_ck>, <&usb1_scb_ck>, <&usb1_108_ck_ahb>, 
		  <&usb1_108_ck_axi>, <&lc_pll_pst_div_hld_ch1>; 
		clock-names = "usb1_27_mdio_ck", "usb1_freerun_ck", 
		  "usb1_gisb_ck", "usb1_scb_ck", "usb1_108_ck_ahb", 
		  "usb1_108_ck_axi", "lc_pll_pst_div_hld_ch1"; 
	};
```

## G9/src/armbcm-linux-sources-3.14.28.1.14_p14/linux/Documentation/devicetree/bindings/clock/divider-clock.txt
```
Binding for simple divider clock.

This binding uses the common clock binding[1].  It assumes a
register-mapped adjustable clock rate divider that does not gate and has
only one input clock or parent.  By default the value programmed into
the register is one less than the actual divisor value.  E.g:

register value		actual divisor value
0			1
1			2
2			3

This assumption may be modified by the following optional properties:

index-starts-at-one - valid divisor values start at 1, not the default
of 0.  E.g:
register value		actual divisor value
1			1
2			2
3			3

index-power-of-two - valid divisor values are powers of two.  E.g:
register value		actual divisor value
0			1
1			2
2			4

index-allow-zero - same as index_one, but zero is divide-by-1.  E.g:
register value		actual divisor value
0			1
1			1
2			2

Additionally a table of valid dividers may be supplied like so:

	table = <4 0>, <8, 1>;

where the first value in the pair is the divider and the second value is
the programmed register bitfield.

The binding must also provide the register to control the divider and
the mask for the corresponding control bits.  Optionally the number of
bits to shift that mask, if necessary.  If the shift value is missing it
is the same as supplying a zero shift.

[1] Documentation/devicetree/bindings/clock/clock-bindings.txt

Required properties:
- compatible : shall be "divider-clock".
- #clock-cells : from common clock binding; shall be set to 0.
- clocks : link to phandle of parent clock
- reg : base address for register controlling adjustable divider
- bit-mask : arbitrary bitmask for programming the adjustable divider

Optional properties:
- clock-output-names : from common clock binding.
- table : array of integer pairs defining divisors & bitfield values
- bit-shift : number of bits to shift the bit-mask, defaults to
  (ffs(mask) - 1) if not present
- minimum-divider : min divisor for dividing the input clock rate, only
  needed if the first divisor is offset from the default value
- maximum-divider : max divisor for dividing the input clock rate, only
  needed if the max divisor is less than (mask + 1).
- index-starts-at-one : valid divisor programming starts at 1, not zero
- index-power-of-two : valid divisor programming must be a power of two
- index-allow-zero : implies index-one, and programming zero results in
  divide-by-one
- hiword-mask : lower half of the register programs the divider, upper
  half of the register indicates bits that were updated in the lower
  half

Examples:
	clock_foo: clock_foo at 4a008100 {
		compatible = "divider-clock";
		#clock-cells = <0>;
		clocks = <&clock_baz>;
		reg = <0x4a008100 0x4>
		mask = <0x3>
		maximum-divider = <3>
	};

	clock_bar: clock_bar at 4a008108 {
		#clock-cells = <0>;
		compatible = "divider-clock";
		clocks = <&clock_foo>;
		reg = <0x4a008108 0x4>;
		mask = <0x1>;
		shift = <0>;
		table = < 4 0 >, < 8 1 >;
	};
```

## G9/src/armbcm-linux-sources-3.14.28.1.14_p14/linux/Documentation/devicetree/bindings/clock/multiplier-clock.txt
```
Binding for simple multiplier clock.

This binding uses the common clock binding[1].  It assumes a
register-mapped adjustable clock rate multiplier that does not gate and has
only one input clock or parent.  By default the value programmed into
the register is one less than the actual multiplier value.  E.g:

register value		actual multiplier value
0			1
1			2
2			3

This assumption may be modified by the following optional properties:

index-starts-at-one - valid multiplier values start at 1, not the default
of 0.  E.g:
register value		actual multiplier value
1			1
2			2
3			3

index-power-of-two - valid multiplier values are powers of two.  E.g:
register value		actual multiplier value
0			1
1			2
2			4

index-allow-zero - same as index_one, but zero is multiply-by-1.  E.g:
register value		actual multiplier value
0			1
1			1
2			2

Additionally a table of valid multipliers may be supplied like so:

	table = <4 0>, <8, 1>;

where the first value in the pair is the multiplier and the second value is
the programmed register bitfield.

The binding must also provide the register to control the multiplier and
the mask for the corresponding control bits.  Optionally the number of
bits to shift that mask, if necessary.  If the shift value is missing it
is the same as supplying a zero shift.

[1] Documentation/devicetree/bindings/clock/clock-bindings.txt

Required properties:
- compatible : shall be "multiplier-clock".
- #clock-cells : from common clock binding; shall be set to 0.
- clocks : link to phandle of parent clock
- reg : base address for register controlling adjustable multiplier
- bit-mask : arbitrary bitmask for programming the adjustable multiplier

Optional properties:
- clock-output-names : from common clock binding.
- table : array of integer pairs defining multipliers & bitfield values
- bit-shift : number of bits to shift the bit-mask, defaults to
  (ffs(mask) - 1) if not present
- index-starts-at-one : valid multiplier programming starts at 1, not zero
- index-power-of-two : valid multiplier programming must be a power of two
- index-allow-zero : implies index-one, and programming zero results in
  multiply-by-one
- index-max-mult-at-zero : same as index-starts-at-one, but the value
  of zero implies a multiplier of 2^width of the register field.

Examples:
	clock_foo: clock_foo at 4a008100 {
		compatible = "multiplier-clock";
		#clock-cells = <0>;
		clocks = <&clock_baz>;
		reg = <0x4a008100 0x4>
		mask = <0x3>
	};

	clock_bar: clock_bar at 4a008108 {
		#clock-cells = <0>;
		compatible = "multiplier-clock";
		clocks = <&clock_foo>;
		reg = <0x4a008108 0x4>;
		mask = <0x1>;
		shift = <0>;
		table = < 4 0 >, < 8 1 >;
	};
```

## G9/src/armbcm-linux-sources-3.14.28.1.14_p14/linux/Documentation/devicetree/bindings/clock/mux-clock.txt
```
Binding for simple mux clock.

This binding uses the common clock binding[1].  It assumes a
register-mapped multiplexer with multiple input clock signals or
parents, one of which can be selected as output.  This clock does not
gate or adjust the parent rate via a divider or multiplier.

By default the "clocks" property lists the parents in the same order
as they are programmed into the regster.  E.g:

	clocks = <&foo_clock>, <&bar_clock>, <&baz_clock>;

results in programming the register as follows:

register value		selected parent clock
0			foo_clock
1			bar_clock
2			baz_clock

Some clock controller IPs do not allow a value of zero to be programmed
into the register, instead indexing begins at 1.  The optional property
"index-starts-at-one" modified the scheme as follows:

register value		selected clock parent
1			foo_clock
2			bar_clock
3			baz_clock

Additionally an optional table of bit and parent pairs may be supplied
like so:

	table = <&foo_clock 0x0>, <&bar_clock, 0x2>, <&baz_clock, 0x4>;

where the first value in the pair is the parent clock and the second
value is the bitfield to be programmed into the register.

The binding must provide the register to control the mux and the mask
for the corresponding control bits.  Optionally the number of bits to
shift that mask if necessary.  If the shift value is missing it is the
same as supplying a zero shift.

[1] Documentation/devicetree/bindings/clock/clock-bindings.txt

Required properties:
- compatible : shall be "mux-clock".
- #clock-cells : from common clock binding; shall be set to 0.
- clocks : link phandles of parent clocks
- reg : base address for register controlling adjustable mux
- bit-mask : arbitrary bitmask for programming the adjustable mux

Optional properties:
- clock-output-names : From common clock binding.
- table : array of integer pairs defining parents & bitfield values
- bit-shift : number of bits to shift the bit-mask, defaults to
  (ffs(mask) - 1) if not present
- index-starts-at-one : valid input select programming starts at 1, not
  zero
- hiword-mask : lower half of the register programs the mux, upper half
  of the register indicates bits that were updated in the lower half

Examples:
	clock: clock at 4a008100 {
		compatible = "mux-clock";
		#clock-cells = <0>;
		clocks = <&clock_foo>, <&clock_bar>, <&clock_baz>;
		reg = <0x4a008100 0x4>
		mask = <0x3>;
		index-starts-at-one;
	};

	clock: clock at 4a008100 {
		#clock-cells = <0>;
		compatible = "mux-clock";
		clocks = <&clock_foo>, <&clock_bar>, <&clock_baz>;
		reg = <0x4a008100 0x4>;
		mask = <0x3>;
		shift = <0>;
		table = <&clock_foo 1>, <&clock_bar 2>, <&clock_baz 3>;
	};
```

## G9/src/armbcm-linux-sources-3.14.28.1.14_p14/linux/Documentation/devicetree/bindings/interrupt-controller/brcm,bcm7120-l2-intc.txt
```
Broadcom BCM7120 Level 2 interrupt controller

Required properties:

- compatible: should be "brcm,bcm7120-l2-intc"
- reg: specifies the base physical address and size of the registers
- interrupt-controller: identifies the node as an interrupt controller
- #interrupt-cells: specifies the number of cells needed to encode an interrupt
  source, should be 1.
- interrupt-parent: specifies the phandle to the parent interrupt controller
  this one is cascaded from
- interrupts: specifies the interrupt line(s) in the interrupt-parent domain
  to be used for cascading
- brcm,int-map-mask: 32-bits bit mask describing how the interrupts at this level
  map to their respective parents. Should match exactly the number of interrupts
  specified in the 'interrupts' property.

Optional properties:

- brcm,irq-can-wake: if present, this means the L2 controller can be used as a
  wakeup source for system suspend/resume.

- brcm,int-fwd-mask: if present, a 32-bits bit mask describing the interrupts
  which need to be enabled in this controller to flow to the higher level
  interrupt controller.

Example:

irq0_intc: interrupt-controller@f0406800 {
	compatible = "brcm,bcm7120-l2-intc";
	interrupt-parent = <&intc>;
	#interrupt-cells = <1>;
	reg = <0xf0406800 0x8>;
	interrupt-controller;
	interrupts = <0x0 0x42 0x0>, <0x0 0x40 0x0>;
	interrupt-names = "upg_main", "upg_bsc";
	brcm,int-map-mask = <0xeb8>, <0x140>;
	brcm,int-fwd-mask = <0x7>;
};
```

## G9/src/armbcm-linux-sources-3.14.28.1.14_p14/linux/Documentation/devicetree/bindings/moca/bmoca.txt
```
* Broadcom STB MoCA driver bindings

The Broadcom STB MoCA core driver provides access to the moca core
for setting various moca properties and loading moca FW

Required properties:
 compatible     : should contain "brcm,bmoca-instance"
 reg            : the register start and length for MoCA controller
 interrupts     : The MoCA interrupt
 #address-cells : <1>
 #size-cells    : <1>
 mac-address	: 6-byte mac address
 rf-band	: rf band string, possible values "highrf, midrf, wanrf,
		  ext_d, d_low, d_high, e, f, g
 hw-rev		: HW revision number
 enet-id	: phandle to the internal ethernet phy (bcmgenet)

Optional properties:
 use-dma	: boolean, indicating controller support for DMA
 i2c-base	: MoCA i2c base register address
 i2c-addr	: i2c slave address
 use-spi	: boolean, indicating controller support for spi interface

Example:

	bmoca@f0e00000 {
		compatible = "brcm,bmoca-instance";
		#address-cells = <0x1>;
		#size-cells = <0x1>;
		mac-address = [ 00 10 18 03 25 d7 ];
		rf-band = "highrf";
		reg = <0xf0e00000 0x1ffda0>;
		interrupts = <0x0 0x1d 0x0>;
		hw-rev = <0x2003>;
		enet-id = <0x7>;
	};
```
