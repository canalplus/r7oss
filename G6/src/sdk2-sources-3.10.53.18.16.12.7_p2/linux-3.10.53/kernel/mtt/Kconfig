## G6/src/sdk2-sources-3.10.53.18.16.12.7_p2/linux-3.10.53/kernel/mtt/Kconfig
```kconfig
config MTT
	bool "Multi-Target Trace (MTT) infrastructure support"
	select MODULES
	select KPROBES
	select DEBUG_FS
	select RELAY
	select SYSFS
	select KALLSYMS
	select SYSVIPC
	default n
	help
	  MTT provides a trace infrastructure with an API and binary
	  data format common to ARM/ST40/ST2xx/XP70. It also provides
	  support for kptraceV4. ST kernel code may use this API
	  (mtt_trace, mtt_print) for critical trace data, or when
	  postprocessing is wanted. See "Documentation/mtt.txt"
	  MTT is also the interface for the System Trace Module IP.

config STM_SYSTRACE
	bool "System Trace Module"
	depends on ARCH_STI
	select MTT
	default n
	---help---
	  The System Trace Module peripheral complies with MIPI-Alliance
	  specifications for the System Trace Protocol(STP) v2.
	  See http://www.mipi.org/specifications/debug and in Documentation
	  systrace.txt and mtt.txt.
	  The trace data is built and written through the MTT Trace facility
	  (see mtt-systrace.txt), and output on the MIPI wires.
```

## G6/src/sdk2-sources-3.10.53.18.16.12.7_p2/linux-3.10.53/sound/stm/Kconfig
```kconfig
menuconfig SND_STM
	tristate "STMicroelectronics SoCs support"
	depends on SND
	select SND_PCM
	select DMADEVICES
	select ST_FDMA
	select BPA2
	select SND_STM_AUDIO_GLUE
	select SND_STM_UNIPERIF_PLAYER
	select SND_STM_UNIPERIF_READER
	select SND_STM_CONV_BIPHASE
	select SND_STM_CONV_DAC_SYSCONF
	select SND_STM_CONV_DAC_BUFFER
	select SND_STM_UNIPERIF_TDM
	select SND_STM_TELSS_GLUE
	help
		Say Y here for ALSA support on the STMicroelectronics SoCs.

		It is recommended to have BPA2 enabled with dedicated
		partition defined, however it is not absolutely necessary.

		To compile this driver as a module, choose M here: the module
	 	will be called snd-stm.ko

config SND_STM_AUDIO_GLUE
       tristate "Audio Glue driver"
       depends on SND_STM

config SND_STM_UNIPERIF_PLAYER
	tristate "Uniperif Player driver"
	depends on SND_STM
	select ST_FDMA_AUDIO

config SND_STM_UNIPERIF_READER
	tristate "Uniperif Reader driver"
	depends on SND_STM

config SND_STM_CONV_BIPHASE
	tristate "Conv Biphase driver"
	depends on SND_STM

config SND_STM_CONV_DAC_SYSCONF
	tristate "Conv DAC driver"
	depends on SND_STM

config SND_STM_CONV_DAC_BUFFER
    tristate "Audio DAC Buffer st6440"
    depends on SND_STM

config SND_STM_TELSS_GLUE
       tristate "TELSS Top Glue driver"
       depends on SND_STM

config SND_STM_UNIPERIF_TDM
	tristate "Uniperipheral TDM driver"
	depends on SND_STM

config SND_STM_BPA2_PARTITION_NAME
	string "Name of BPA2 partition to allocate buffers from"
	depends on SND_STM
	depends on BPA2
	default "audio"
	help
		Define a name of BPA2 partition the driver should try to
		allocate from.

		If name is not given or given partition does not exist, driver
		will try to use "bigphysmem" partition or eventually
		preallocate some system memory using
		ALSA snd_pcm_lib_preallocate_pages_for_all() method.

		This value can be overridden by module parameter
		"bpa2_part=<name>" (or kernel command line parameter
		"snd-stm.bpa2_part=<name>", if driver is compiled into
		kernel).
```

## G6/src/stlinuxtv-modules-15.2.1.155.11.12.6_p2/linux/v4l2/stm-c8jpg/Kconfig
```kconfig
#
# stm-c8jpg Kconfig
#

config VIDEO_STM_C8JPG
	tristate "STMicroelectronics h/w JPEG decoder driver"
	depends on VIDEO_DEV && VIDEO_V4L2 && BPA2 && MACH_STM_STIH416
	select VIDEOBUF2_BPA2_CONTIG
	select V4L2_MEM2MEM_DEV
	default m
	---help---
	  This is a v4l2 driver for STMicroelectronics h/w JPEG decoder

config VIDEO_STM_C8JPG_DEBUG
	tristate "STMicroelectronics h/w JPEG decoder driver debug"
	depends on VIDEO_STM_C8JPG
	select LIBCRC32C
	default n
	---help---
	  Enable few more debugging features in stm-c8jpg
```

## G6/src/transport_engine-sources-15.2.2.87.7.12.6/linux/Documentation/devicetree/bindings/sti/stm-te.txt
```
STM Transport Engine (demux) properties
===============================================================================

Property description for stm-tango-tp, stm-tango-fe, stm-tango-dummy devices

Tango TP device
-------------------------------------------------------------------------------

Required Properties:
- compatible: "st,tango-tp"
- reg: physical address range of TP registers
- reg-names: must be named "tp"
- interrupts: mailbox interrupt for TP
- clocks: from common clock binding: handle to STFE clocks
- clock-names: from common clock binding: clock name used by driver corresponding to each entry in clocks

- tp_config: phandle to the tp hardware configuration

	Required hardware configuration properties:
	- ddem-offset: Offset of the STxP70 DMEM
	- idem-offset: Offset of the STxP70 IMEM
	- st-bux-plug-write-offset: Offset of the write plug registers
	- st-bux-plug-read-offset: Offset of the read plug registers
	- core-ctrl-offset: Offset of the core controller registers
	- mailbox0-to-xp70-offset: Offset of the host to xP70 mailbox registers
	- mailbox0-to-host-offset: Offset of the xP70 to host mailbox registers
	- writelock-error-offset: Offset of the write lock error registers
	- t3-addr-filter-offset: Offset of the T3 request filter address range base registers
	- timer-counter-offset: Offset of the STxP70 timers block
	- firmware: String representing the required TP firmware
			e.g. pti_tp3.elf or pti_tp5.elf
	- nb-vdevice: Number of vDevices supported by the TP firmware
	- nb-slot: Number of slots supported by the TP firmware
	- nb-section-filter: Number of section filters supported by the TP firmware
	- nb-dma-structure: Number of dma structures supported by the TP firmware
	- nb-indexer: Number of indexers supported by the TP firmware
	- nb-status-blk: Number of status blocks supported by the TP firmware

	- timer-counter-divider: Device timer divider

	Optional hardware configuration properties:
	- sc-bypass: If present transport packets will bypass the secure-coprocessor
	             (no [de]scrambling will be supported)
	- permit-powerdown: If present the TP can be put into a low-power state
	- software-leaky-pid: If present enables the software leaky pid workaround
	- software-leaky-pid-timeout: Timeout for software leaky pid
	                              (required if software-leaky-pid property is present)

Optional properties:
- clocks: An array of child nodes, each of which defines a clock that should
          managed by the TP driver
	- clkX: Defines clock properties
		Required clock properties:
		- clk-name: String name of the clock

		Optional clock properties:
		- clk-rate: Desired frequency of the clock (MHz)
		- clk-parent: String name of the parent clock (workaround in case the clock
		              needs to be re-parented)
- power-down: If defined "yes", TP device will be powered down

Example:

tp_hw_config: tp-hw-config {
	ddem-offset = <0x00000>;
	idem-offset = <0x10000>;
	st-bux-plug-write-offset = <0x28000>;
	st-bux-plug-read-offset = <0x2a000>;
	core-ctrl-offset = <0x2d000>;
	mailbox0-to-xp70-offset = <0x2d020>;
	mailbox0-to-host-offset = <0x2d030>;
	writelock-error-offset = <0x2d068>;
	t3-addr-filter-offset = <0x2d06c>;
	timer-counter-offset = <0x2e060>;

	firmware = "pti_tp3.elf";

	nb-vdevice = <16>;
	nb-slot = <256>;
	nb-section-filter = <256>;
	nb-dma-structure = <96>;
	nb-indexer = <32>;
	nb-status-blk = <32>;

	timer-counter-divider = <0x0b>;

	sc-bypass;
	permit-powerdown;
};

tp@fd580000 {
	compatible = "st,tango-tp";
	status = "okay";
	reg = <0xfd580000 0x2f000>;
	reg-names = "tp";
	interrupts = <0 57 0>;
	tp_config = <&tp_hw_config>;
	clocks = <&CLK_S_C0_FLEXGEN CLK_PROC_TP>;
	clock-names = "CLK_M_TP";
	clocks {
		clk0 {
			clk-name = "CLK_M_TP";
		};
	};
};

STFE device
-------------------------------------------------------------------------------

Required Properties:
- compatible: "st,tango-fe"
- reg: physical address range of STFE registers and memory
- reg-names: Register names
	Must define range "stfe" for stfe registers
	Must define range "stfe-ram" for stfe memory
- clocks: from common clock binding: handle to STFE clocks
- clock-names: from common clock binding: clock name used by driver corresponding to each entry in clocks

- stfe_config: phandle to the tp hardware configuration

	Required hardware configuration properties:
	- stfe-version: STFE hardware version
		<1> -- STFEv1
		<2> -- STFEv2
	- nb-ib: Number of IB
	- nb-mib: Number of MIB
	- nb-swts: Number of SWTS
	- nb-tsdma: Number of TSDMA
	- nb-ccsc: Number of CCSC
	- nb-tag: Number of tag

	- ib-offset: IB register offset
	- tag-offset: Tag register offset
	- pid-filter-offset: PID filter register offset
	- system-regs-offset: System register offset
	- memdma-offset: MEMDMA register offset
	- tsdma-offset: TSDMA register offset
	- ccsc-offset: CCSC register offset

	Optional hardware configuration properties:
	- firmware: String representing the required MEMDMA firmware (STFE v2 devices only)
			e.g. pti_memdma_h416.elf, pti_memdma_h407_one-pkt-dac.elf, etc

Optional properties:
- interrupts: STFE MEMDMA interrupts (STFE v2 devices only)
- interrupt-names: Interrupt names
	Must define "stfe-idle-irq" for MEMDMA idle interrupt
	Must define "stfe-error-irq" for MEMDMA error interrupt
- default_dest: Default output routing for the STFE
	* "demux", "tsout0", "tsout1", "ext_tsout0", "ext_tsout1"
	If not specified, "demux" is assumed
- clocks: An array of child nodes, each of which defines a clock that should
          managed by the TP driver
	- clkX: Defines clock properties
		Required clock properties:
		- clk-name: String name of the clock

		Optional clock properties:
		- clk-rate: Desired frequency of the clock (MHz)
		- clk-parent: String name of the parent clock (workaround in case the clock
		              needs to be re-parented)
- power-down: If defined "yes", STFE device will be powered down

Example:

stfe_hw_config: stfe-hw-config {
	stfe-version = <2>;

	nb-ib = <5>;
	nb-mib = <2>;
	nb-swts = <2>;
	nb-tsdma = <1>;
	nb-ccsc = <1>;
	nb-tag = <3>;

	ib-offset = <0x1000>;
	tag-offset = <0x2000>;
	pid-filter-offset = <0x2800>;
	system-regs-offset = <0x0000>;
	memdma-offset = <0x4000>;
	tsdma-offset = <0x3000>;
	ccsc-offset = <0x2c00>;

	firmware = "pti_memdma_h416.elf";
};

stfe@fec00000 {
	compatible = "st,tango-fe";
	status = "okay";
	reg = <0xfec00000 0x10000>, <0xfe910000 0x4000>;
	reg-names = "stfe", "stfe-ram";
	interrupts = <0 131 0>, <0 132 0>;
	interrupt-names = "stfe-idle-irq", "stfe-error-irq";
	stfe_config = <&stfe_hw_config>;
	clocks = <&CLK_S_C0_FLEXGEN CLK_PROC_STFE>,
		 <&CLK_S_D3_FLEXGEN CLK_TSOUT_0>,
		 <&CLK_S_D3_FLEXGEN CLK_TSOUT_1>,
		 <&CLK_S_D3_FLEXGEN CLK_STFE_FRC1>,
		 <&CLK_S_C0_FLEXGEN CLK_STFE_FRC2>,
		 <&CLK_S_D3_FLEXGEN CLK_MCHI>;

	clock-names = "stfe_ccsc",
		      "stfe_tsout-0",
		      "stfe_tsout-1",
		      "stfe_frc-0",
		      "stfe_frc-1",
		      "stfe_mchi";
	clocks {
		clk0 {
			clk-name = "stfe_ccsc";
		};
		clk1 {
			clk-name = "stfe_tsout-0";
			clk-rate = <108000000>;
		};
		clk2 {
			clk-name = "stfe_tsout-1";
			clk-rate = <108000000>;
		};
		clk3 {
			clk-name = "stfe_frc-0";
			clk-rate = <27000000>;
		};
		clk4 {
			clk-name = "stfe_frc-1";
			clk-rate = <27000000>;
		};
		clk5 {
			clk-name = "stfe_mchi";
			clk-rate = <27000000>;
		};
	};
};


Tango-lite device
-------------------------------------------------------------------------------
Required Properties:

- compatible: "st,tango-dummy"

Example:

tp@0 {
	compatible = "st,tango-dummy";
	status = "okay";
};
```

## G9/src/armbcm-linux-sources-3.14.28.1.14_p14/linux/Documentation/devicetree/bindings/brcmstb/pm.txt
```
** Broadcom STB Power Management

Broadcom STB power management involves several hardware components which are
documented here.

* Always-On control block (AON CTRL)

This hardware provides control registers for the "always-on" (even in low-power
modes) hardware, such as the Power Management State Machine (PMSM).

Required properties:
- compatible     : should contain "brcm,brcmstb-aon-ctrl"
- reg            : the register start and length for the AON CTRL block

Example:

aon-ctrl@f0410000 {
	compatible = "brcm,brcmstb-aon-ctrl";
	reg = <0xf0410000 0x400>;
};

* Memory controllers

A Broadcom STB SoC typically has a number of independent memory controllers,
each of which may have several associated hardware blocks, which are versioned
independently (control registers, DDR PHYs, etc.). One might consider
describing these controllers as a parent "memory controllers" block, which
contains N sub-nodes (one for each controller in the system), each of which is
associated with a number of hardware register resources (e.g., its PHY). See
the example device tree snippet below.

* MEMC (MEMory Controller)

Represents a single memory controller instance.

Required properties:
- compatible     : should contain "brcm,brcmstb-memc" and "simple-bus"

Should contain subnodes for any of the following relevant hardware resources:

* DDR PHY control

Control registers for this memory controller's DDR PHY.

Required properties:
- compatible     : should contain "brcm,brcmstb-ddr-phy-v225.1" or
                   "brcm,brcmstb-ddr-phy-v240.1"
- reg            : the DDR PHY register range

* DDR SHIMPHY

Control registers for this memory controller's DDR SHIMPHY.

Required properties:
- compatible     : should contain "brcm,brcmstb-ddr-shimphy-v1.0"
- reg            : the DDR SHIMPHY register range

* MEMC DDR control

Sequencer DRAM parameters and control registers. Used for Self-Refresh
Power-Down (SRPD), among other things.

Required properties:
- compatible     : should contain "brcm,brcmstb-memc-ddr"
- reg            : the MEMC DDR register range

Example:

memory_controllers {
	ranges;
	compatible = "simple-bus";

	memc@0 {
		compatible = "brcm,brcmstb-memc", "simple-bus";
		ranges;

		ddr-phy@f1106000 {
			compatible = "brcm,brcmstb-ddr-phy-v240.1";
			reg = <0xf1106000 0x21c>;
		};

		shimphy@f1108000 {
			compatible = "brcm,brcmstb-ddr-shimphy-v1.0";
			reg = <0xf1108000 0xe4>;
		};

		memc-ddr@f1102000 {
			reg = <0xf1102000 0x800>;
			compatible = "brcm,brcmstb-memc-ddr";
		};
	};

	memc@1 {
		compatible = "brcm,brcmstb-memc", "simple-bus";
		ranges;

		ddr-phy@f1186000 {
			compatible = "brcm,brcmstb-ddr-phy-v240.1";
			reg = <0xf1186000 0x21c>;
		};

		shimphy@f1188000 {
			compatible = "brcm,brcmstb-ddr-shimphy-v1.0";
			reg = <0xf1188000 0xe4>;
		};

		memc-ddr@f1182000 {
			reg = <0xf1182000 0x800>;
			compatible = "brcm,brcmstb-memc-ddr";
		};
	};

	memc@2 {
		compatible = "brcm,brcmstb-memc", "simple-bus";
		ranges;

		ddr-phy@f1206000 {
			compatible = "brcm,brcmstb-ddr-phy-v240.1";
			reg = <0xf1206000 0x21c>;
		};

		shimphy@f1208000 {
			compatible = "brcm,brcmstb-ddr-shimphy-v1.0";
			reg = <0xf1208000 0xe4>;
		};

		memc-ddr@f1202000 {
			reg = <0xf1202000 0x800>;
			compatible = "brcm,brcmstb-memc-ddr";
		};
	};
};
```
