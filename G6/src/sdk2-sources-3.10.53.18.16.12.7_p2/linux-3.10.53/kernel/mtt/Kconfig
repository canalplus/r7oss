## G9/src/armbcm-linux-sources-3.14.28.1.14_p14/linux/Documentation/devicetree/bindings/thermal/brcmstb-thermal.txt
```
* Broadcom STB (BCM7xxx) thermal management

Thermal management core, provided by the AVS TMON hardware block.

Required properties:

- compatible: "brcm,avs-tmon-bcm7445" and/or "brcm,avs-tmon"
- reg: address range for the AVS TMON registers
- interrupts: 'TMON' interrupt, for high/low threshold triggers
- interrupt-names: "tmon"

Example:

	thermal@f04d1500 {
		compatible = "brcm,avs-tmon-bcm7445", "brcm,avs-tmon";
		interrupt-names = "tmon";
		interrupt-parent = <&avs_host_l2_intc>;
		reg = <0xf04d1500 0x28>;
		interrupts = <0x6>;
	};
```

## G9/src/armbcm-linux-sources-3.14.28.1.14_p14/linux/Documentation/devicetree/bindings/usb/bdc-udc.txt
```
USB Device Controller (UDC) for Broadcom Device Controller (BDC)

Required properties:

- compatible: Must be "brcm,bdc-udc-v0.16" or "brcm,bdc-udc"

- reg: Address and length of the register set for the device

- interrupts: Interrupt number for this device

Example:
	bdc@f0472000 {                                          
		compatible = "brcm,bdc-udc-v0.16", "brcm,bdc-udc";
		reg = <0xf0472000 0xfc4>;
		interrupts = <0x0 0x76 0x0>;
	};
```

## G9/src/armbcm-linux-sources-3.14.28.1.14_p14/linux/Documentation/devicetree/bindings/watchdog/brcm,bcm7038-wdt.txt
```
BCM7038 Watchdog timer

Required properties:

- compatible : should be "brcm,bcm7038-wdt"
- reg : Specifies base physical address and size of the registers.

Optional properties:

- clocks: the clock running the watchdog
- clock-frequency: the rate of the clock

Example:

watchdog {
	compatible = "brcm,bcm7038-wdt";
	clocks = <&upg_fixed>;
	reg = <0xf040a7e8 0x16>;
};
```

## G9/src/armbcm-linux-sources-3.14.28.1.14_p14/linux/arch/arm/configs/brcmstb_hardened_defconfig
```kconfig
# CONFIG_LOCALVERSION_AUTO is not set
# CONFIG_SWAP is not set
CONFIG_SYSVIPC=y
CONFIG_POSIX_MQUEUE=y
CONFIG_NO_HZ=y
CONFIG_HIGH_RES_TIMERS=y
CONFIG_IRQ_TIME_ACCOUNTING=y
CONFIG_LOG_BUF_SHIFT=16
CONFIG_BLK_DEV_INITRD=y
CONFIG_EXPERT=y
# CONFIG_KALLSYMS is not set
# CONFIG_PRINTK is not set
# CONFIG_BUG is not set
# CONFIG_ELF_CORE is not set
# CONFIG_COMPAT_BRK is not set
CONFIG_CC_STACKPROTECTOR_REGULAR=y
CONFIG_MODULES=y
CONFIG_MODVERSIONS=y
# CONFIG_LBDAF is not set
# CONFIG_BLK_DEV_BSG is not set
CONFIG_ARCH_BCM=y
CONFIG_ARCH_BRCMSTB=y
# CONFIG_BRCM_MOCA is not set
CONFIG_ARM_LPAE=y
CONFIG_PCI=y
CONFIG_PCI_MSI=y
CONFIG_PCIEPORTBUS=y
CONFIG_PCIEAER=y
CONFIG_SMP=y
CONFIG_AEABI=y
CONFIG_HIGHMEM=y
CONFIG_HIGHPTE=y
CONFIG_SPARSEMEM_MANUAL=y
CONFIG_DEFAULT_MMAP_MIN_ADDR=32768
CONFIG_CMA=y
# CONFIG_ATAGS is not set
CONFIG_ARM_APPENDED_DTB=y
CONFIG_CPU_FREQ=y
CONFIG_CPU_FREQ_GOV_POWERSAVE=y
CONFIG_CPU_FREQ_GOV_USERSPACE=y
CONFIG_CPU_FREQ_GOV_ONDEMAND=y
CONFIG_CPU_FREQ_GOV_CONSERVATIVE=y
CONFIG_CPU_IDLE=y
CONFIG_VFP=y
CONFIG_NEON=y
CONFIG_PM_RUNTIME=y
CONFIG_NET=y
CONFIG_PACKET=y
CONFIG_UNIX=y
CONFIG_INET=y
CONFIG_IP_MULTICAST=y
CONFIG_IP_PNP=y
CONFIG_IP_PNP_DHCP=y
CONFIG_IP_PNP_BOOTP=y
CONFIG_IP_PNP_RARP=y
CONFIG_IP_MROUTE=y
CONFIG_IP_PIMSM_V1=y
CONFIG_IP_PIMSM_V2=y
# CONFIG_INET_XFRM_MODE_TRANSPORT is not set
# CONFIG_INET_XFRM_MODE_TUNNEL is not set
# CONFIG_INET_XFRM_MODE_BEET is not set
# CONFIG_INET_LRO is not set
CONFIG_INET_UDP_DIAG=y
# CONFIG_IPV6 is not set
CONFIG_NETFILTER=y
CONFIG_IP_NF_IPTABLES=y
CONFIG_BRIDGE=y
CONFIG_DEVTMPFS=y
CONFIG_DEVTMPFS_MOUNT=y
CONFIG_DMA_CMA=y
CONFIG_CMA_ALIGNMENT=12
CONFIG_MTD=y
CONFIG_MTD_BLOCK=y
CONFIG_MTD_CFI=y
CONFIG_MTD_JEDECPROBE=y
CONFIG_MTD_CFI_INTELEXT=y
CONFIG_MTD_CFI_AMDSTD=y
CONFIG_MTD_CFI_STAA=y
CONFIG_MTD_ROM=y
CONFIG_MTD_ABSENT=y
CONFIG_MTD_PHYSMAP_OF=y
CONFIG_MTD_M25P80=y
CONFIG_MTD_UBI=y
CONFIG_MTD_UBI_GLUEBI=y
CONFIG_PROC_DEVICETREE=y
CONFIG_BLK_DEV_LOOP=y
CONFIG_BLK_DEV_RAM=y
CONFIG_BLK_DEV_RAM_SIZE=8192
CONFIG_NETDEVICES=y
# CONFIG_NET_VENDOR_3COM is not set
# CONFIG_NET_VENDOR_ADAPTEC is not set
# CONFIG_NET_VENDOR_ALTEON is not set
# CONFIG_NET_VENDOR_AMD is not set
# CONFIG_NET_VENDOR_ARC is not set
# CONFIG_NET_VENDOR_ATHEROS is not set
# CONFIG_NET_CADENCE is not set
# CONFIG_NET_VENDOR_BROCADE is not set
# CONFIG_NET_VENDOR_CHELSIO is not set
# CONFIG_NET_VENDOR_CIRRUS is not set
# CONFIG_NET_VENDOR_CISCO is not set
# CONFIG_NET_VENDOR_DEC is not set
# CONFIG_NET_VENDOR_DLINK is not set
# CONFIG_NET_VENDOR_EMULEX is not set
# CONFIG_NET_VENDOR_EXAR is not set
# CONFIG_NET_VENDOR_FARADAY is not set
# CONFIG_NET_VENDOR_HP is not set
# CONFIG_NET_VENDOR_INTEL is not set
# CONFIG_NET_VENDOR_MARVELL is not set
# CONFIG_NET_VENDOR_MELLANOX is not set
# CONFIG_NET_VENDOR_MICREL is not set
# CONFIG_NET_VENDOR_MICROCHIP is not set
# CONFIG_NET_VENDOR_MYRI is not set
# CONFIG_NET_VENDOR_NATSEMI is not set
# CONFIG_NET_VENDOR_NVIDIA is not set
# CONFIG_NET_VENDOR_OKI is not set
# CONFIG_NET_PACKET_ENGINE is not set
# CONFIG_NET_VENDOR_QLOGIC is not set
# CONFIG_NET_VENDOR_REALTEK is not set
# CONFIG_NET_VENDOR_RDC is not set
# CONFIG_NET_VENDOR_SEEQ is not set
# CONFIG_NET_VENDOR_SILAN is not set
# CONFIG_NET_VENDOR_SIS is not set
# CONFIG_NET_VENDOR_SMSC is not set
# CONFIG_NET_VENDOR_STMICRO is not set
# CONFIG_NET_VENDOR_SUN is not set
# CONFIG_NET_VENDOR_TEHUTI is not set
# CONFIG_NET_VENDOR_TI is not set
# CONFIG_NET_VENDOR_VIA is not set
# CONFIG_NET_VENDOR_WIZNET is not set
# CONFIG_INPUT is not set
# CONFIG_SERIO is not set
# CONFIG_VT is not set
# CONFIG_LEGACY_PTYS is not set
# CONFIG_DEVKMEM is not set
CONFIG_SERIAL_8250=y
# CONFIG_SERIAL_8250_DEPRECATED_OPTIONS is not set
CONFIG_SERIAL_8250_CONSOLE=y
# CONFIG_SERIAL_8250_PCI is not set
CONFIG_SERIAL_OF_PLATFORM=y
CONFIG_HW_RANDOM=y
CONFIG_I2C=y
CONFIG_I2C_CHARDEV=y
CONFIG_I2C_MUX=y
CONFIG_SPI=y
CONFIG_SPI_BITBANG=y
CONFIG_POWER_SUPPLY=y
CONFIG_POWER_RESET=y
# CONFIG_HWMON is not set
CONFIG_THERMAL=y
CONFIG_CPU_THERMAL=y
CONFIG_BRCMSTB_THERMAL=y
CONFIG_REGULATOR=y
CONFIG_REGULATOR_FIXED_VOLTAGE=y
CONFIG_SOUND=y
CONFIG_SND=y
# CONFIG_SND_VERBOSE_PROCFS is not set
# CONFIG_SND_PCI is not set
# CONFIG_SND_SPI is not set
# CONFIG_SND_USB is not set
CONFIG_SND_SOC=y
CONFIG_USB=y
CONFIG_USB_MON=y
CONFIG_USB_XHCI_HCD=y
CONFIG_USB_EHCI_HCD=y
CONFIG_USB_OHCI_HCD=y
CONFIG_MMC=y
CONFIG_MMC_BLOCK_MINORS=16
CONFIG_MMC_SDHCI=y
CONFIG_MMC_SDHCI_PLTFM=y
# CONFIG_IOMMU_SUPPORT is not set
CONFIG_TMPFS=y
# CONFIG_MISC_FILESYSTEMS is not set
# CONFIG_NETWORK_FILESYSTEMS is not set
CONFIG_NLS_CODEPAGE_437=y
CONFIG_NLS_ISO8859_1=y
# CONFIG_SCHED_DEBUG is not set
# CONFIG_FTRACE is not set
CONFIG_STRICT_DEVMEM=y
# CONFIG_ARM_UNWIND is not set
CONFIG_SECURITY_DMESG_RESTRICT=y
# CONFIG_CRYPTO_ANSI_CPRNG is not set
# CONFIG_CRYPTO_HW is not set
```

## G9/src/armbcm-linux-sources-3.14.28.1.14_p14/linux/arch/arm/mach-bcm/Kconfig
```kconfig
config ARCH_BCM
	bool "Broadcom SoC Support"
	depends on ARCH_MULTIPLATFORM
	help
	  This enables support for Broadcom ARM based SoC
          chips

if ARCH_BCM

menu "Broadcom SoC Selection"

config ARCH_BCM_MOBILE
	bool "Broadcom Mobile SoC" if ARCH_MULTI_V7
	depends on MMU
	select ARCH_REQUIRE_GPIOLIB
	select ARM_ERRATA_754322
	select ARM_ERRATA_764369 if SMP
	select ARM_GIC
	select CPU_V7
	select CLKSRC_OF
	select GENERIC_CLOCKEVENTS
	select GENERIC_TIME
	select GPIO_BCM_KONA
	select SPARSE_IRQ
	select TICK_ONESHOT
	select CACHE_L2X0
	select HAVE_ARM_ARCH_TIMER
	select PINCTRL
	help
	  This enables support for systems based on Broadcom mobile SoCs.
	  It currently supports the 'BCM281XX' family, which includes
	  BCM11130, BCM11140, BCM11351, BCM28145 and
	  BCM28155 variants.

config ARCH_BRCMSTB
	bool "Broadcom BCM7XXX based boards" if ARCH_MULTI_V7
	depends on MMU
	select ARM_GIC
	select MIGHT_HAVE_PCI
	select HAVE_SMP
	select HAVE_ARM_ARCH_TIMER
	select POWER_RESET_BRCMSTB
	select BRCMSTB
	select ARCH_HAS_OPP
	select ARCH_HAS_CPUFREQ
	select PM_OPP if PM
	select ARM_ERRATA_798181 if SMP
	select ARCH_DMA_ADDR_T_64BIT if ARM_LPAE
	select GENERIC_IRQ_CHIP
	select BRCMSTB_GISB_ARB
	select SOC_BRCMSTB
	select ARCH_WANT_OPTIONAL_GPIOLIB
	select SOC_BUS
	select PCI_DOMAINS if PCI
	select BCM7120_L2_IRQ
	help
	  Say Y if you intend to run the kernel on a Broadcom ARM-based STB
	  chipset.

	  This enables support for Broadcom ARM-based set-top box chipsets,
	  including the 7445 family of chips.

endmenu

endif

choice
	prompt "Chipset selection"
	depends on BRCMSTB
	help
	  Select the Broadcom STB chipset you are building for.

config BCM3390A0
	bool "3390 Ax"
	select BRCM_HAS_NAND_MAJOR_7
	select BRCM_HAS_NAND_MINOR_1
	select BRCM_HAS_BSPI_V4
	select BRCM_HAS_MOCA_20_GEN23
	select BRCM_MSPI_64B_WORDS

config BCM3390B0
	bool "3390 Bx"
	select BRCM_HAS_NAND_MAJOR_7
	select BRCM_HAS_NAND_MINOR_1
	select BRCM_HAS_BSPI_V4
	select BRCM_HAS_MOCA_20_GEN23
	select BRCM_MSPI_64B_WORDS

config BCM7250B0
	bool "7250 Bx"
	select BCM7250
	select BRCM_HAS_NAND_MAJOR_7
	select BRCM_HAS_NAND_MINOR_1
	select BRCM_HAS_BSPI_V4
	select BRCM_MSPI_64B_WORDS
	select BRCMSTB_XPT_HASH if PM

config BCM7364A0
	bool "7364 Ax"
	select BCM7364
	select BRCM_GENET_V4
	select BRCM_HAS_NAND_MAJOR_7
	select BRCM_HAS_NAND_MINOR_1
	select BRCM_HAS_BSPI_V4
	select BRCM_HAS_MOCA_20_GEN23
	select BRCM_MSPI_64B_WORDS
	select BRCMSTB_XPT_HASH if PM

config BCM7366C0
	bool "7366 Cx"
	select BCM7366
	select BRCM_GENET_V4
	select BRCM_HAS_NAND_MAJOR_7
	select BRCM_HAS_NAND_MINOR_1
	select BRCM_HAS_BSPI_V4
	select BRCM_HAS_MOCA_20_GEN23
	select BRCM_MSPI_64B_WORDS
	select BRCMSTB_XPT_HASH if PM

config BCM74371A0
	bool "74371 Ax"
	select BCM74371
	select BRCM_GENET_V4
	select BRCM_HAS_NAND_MAJOR_7
	select BRCM_HAS_NAND_MINOR_0
	select BRCM_HAS_BSPI_V4
	select BRCM_HAS_MOCA_20_GEN23
	select BRCM_MSPI_64B_WORDS

config BCM7439B0
	bool "7439 Bx"
	select BCM7439
	select BRCM_GENET_V4
	select BRCM_HAS_NAND_MAJOR_7
	select BRCM_HAS_NAND_MINOR_1
	select BRCM_HAS_BSPI_V4
	select BRCM_HAS_MOCA_20_GEN23
	select BRCM_MSPI_64B_WORDS
	select BRCMSTB_XPT_HASH if PM

config BCM7445D0
	bool "7445 Dx"
	select BCM7445
	select BRCM_GENET_V4
	select BRCM_HAS_MOCA_20_GEN23
	select BRCM_HAS_NAND_MAJOR_7
	select BRCM_HAS_NAND_MINOR_1
	select BRCM_HAS_BSPI_V4
	select BRCM_MSPI_64B_WORDS
	select BRCMSTB_XPT_HASH if PM

endchoice

config SPI_BRCMSTB
	tristate "Broadcom HIF SPI controller support"
	default y
	depends on BRCMSTB
	help
	  Say Y to enable support for SPI (serial) flash devices.

config BCMGENET
	tristate "Broadcom STB 10/100/1000 MAC/PHY support"
	depends on ETHERNET && BRCMSTB
	default y
	select CRC32
	select MII
	select PHYLIB
	select FIXED_PHY
	select BCM7XXX_PHY
	select BCM531XX_PHY
	help
	  Say Y to support the internal 10/100/1000 GENET MAC/PHY on
	  Broadcom set-top chips.  This driver also supports the datapath
	  for the onchip MoCA transceiver.

	  If your chipset supports power management, disabling this driver
	  will keep the device permanently powered down.

config BRCM_MOCA
	tristate "Broadcom MoCA character driver"
	depends on BRCMSTB && (BRCM_HAS_GENET || BRCM_HAS_MOCA_20_GEN21 || \
		BRCM_HAS_MOCA_20_GEN22 || BRCM_HAS_MOCA_20_GEN23) && !BRCM_IKOS
	default y
	help
	  Say Y to build the MoCA control path driver.  This is a simple
	  character driver that allows the MoCA daemon (mocad) to
	  initialize and configure the MoCA interface.

	  If your chipset supports power management, disabling this driver
	  will keep the device permanently powered down.

config BRCM_USB
	tristate "Broadcom STB USB support"
	depends on BRCMSTB && USB
	select BRCM_USB_OHCI if USB_OHCI_HCD
	select BRCM_USB_EHCI if USB_EHCI_HCD
	select BRCM_USB_XHCI if USB_XHCI_HCD
	select BRCM_USB_PHY if USB_OHCI_HCD || USB_EHCI_HCD || USB_XHCI_HCD
	select GENERIC_PHY if BRCM_USB_PHY
	default y
	help
	  Say Y to enable the drivers for the onchip USB controllers.

	  If your chipset supports power management, disabling this driver
	  will keep the device permanently powered down.


config MTD_NAND_BRCMSTB
	tristate "Broadcom NAND controller support"
	default y
	depends on OF && OF_MTD
	select MTD_NAND
	help
	  Say Y to enable the onchip NAND controller.

config BRCM_SDIO
	tristate "Broadcom SDHCI (SDIO) support"
	depends on BRCMSTB && MMC_SDHCI
	default y
	select MMC_SDHCI_IO_ACCESSORS
	help
	  Say Y to enable the driver for the onchip SDIO controller.

	  If you do not plan on using this device, disabling CONFIG_MMC
	  will save about 75KB.

	  If unsure, say Y.

#####################################################################
# Hidden options
#####################################################################

config BRCMSTB
	bool

config BCM7250
	bool

config BCM7364
	bool

config BCM7366
	bool

config BCM74371
	bool

config BCM7439
	bool

config BCM7445
	bool

config BRCM_GENET_V3
	bool

config BRCM_GENET_V4
	bool

config BRCM_GENET_VERSION
	int
	default 3 if BRCM_GENET_V3
	default 4 if BRCM_GENET_V4

# MoCA controller
config BRCM_HAS_MOCA
	bool

# Original MoCA 1.1 (gen1 firmware)
config BRCM_HAS_MOCA_11
	bool
	select BRCM_HAS_MOCA

# Cost-reduced MoCA 1.1 with limited TX RAM (gen1 firmware)
config BRCM_HAS_MOCA_11_LITE
	bool
	select BRCM_HAS_MOCA

# MoCA 1.1 with selected 2.0 features (gen2 firmware)
config BRCM_HAS_MOCA_11_PLUS
	bool
	select BRCM_HAS_MOCA

# MoCA 2.0 (gen3 firmware for 1.1, gen2x firmware for 2.0)
config BRCM_HAS_MOCA_20_GEN21
	bool
	select BRCM_HAS_MOCA

config BRCM_HAS_MOCA_20_GEN22
	bool
	select BRCM_HAS_MOCA

config BRCM_HAS_MOCA_20_GEN23
	bool
	select BRCM_HAS_MOCA

config BRCM_MOCA_VERS
	hex
	default 0x1100 if BRCM_HAS_MOCA_11
	default 0x1101 if BRCM_HAS_MOCA_11_LITE
	default 0x1102 if BRCM_HAS_MOCA_11_PLUS
	default 0x2001 if BRCM_HAS_MOCA_20_GEN21
	default 0x2002 if BRCM_HAS_MOCA_20_GEN22
	default 0x2003 if BRCM_HAS_MOCA_20_GEN23

# select for MoCA on GENET_0
config BRCM_MOCA_ON_GENET_0
	bool
	select BRCM_HAS_GENET_0

# select for MoCA on GENET_1
config BRCM_MOCA_ON_GENET_1
	bool
	select BRCM_HAS_GENET_1

# MoCA is MidRF (default is HighRF)
config BRCM_HAS_MOCA_MIDRF
	bool

config BRCM_HAS_NAND_MINOR_0
	bool

config BRCM_HAS_NAND_MINOR_1
	bool

config BRCM_HAS_NAND_MINOR_2
	bool

config BRCM_HAS_NAND_MINOR_3
	bool

config BRCM_HAS_NAND_MINOR_4
	bool

config BRCM_HAS_NAND_MAJOR_5
	bool
	select BRCM_HAS_NAND

config BRCM_HAS_NAND_MAJOR_6
	bool
	select BRCM_HAS_NAND

config BRCM_HAS_NAND_MAJOR_7
	bool
	select BRCM_HAS_NAND

config BRCMNAND_MAJOR_VERS
	int
	default "7" if BRCM_HAS_NAND_MAJOR_7
	default "6" if BRCM_HAS_NAND_MAJOR_6
	default "5" if BRCM_HAS_NAND_MAJOR_5

config BRCMNAND_MINOR_VERS
	int
	default "4" if BRCM_HAS_NAND_MINOR_4
	default "3" if BRCM_HAS_NAND_MINOR_3
	default "2" if BRCM_HAS_NAND_MINOR_2
	default "1" if BRCM_HAS_NAND_MINOR_1
	default "0" if BRCM_HAS_NAND_MINOR_0

config BRCM_HAS_BSPI_V4
	bool
	select BRCM_HAS_SPI

config BRCM_BSPI_MAJOR_VERS
	int
	default "4" if BRCM_HAS_BSPI_V4
	default "3" if BRCM_HAS_BSPI_V3
	default "2" if BRCM_HAS_BSPI_V2

# For MSPI prior to v1.5 (first version with a revision register)
config BRCM_MSPI_LEGACY
	bool

# MSPI can transfer either 64b or 8b per slot
config BRCM_MSPI_64B_WORDS
	bool

config BRCM_USB_OHCI
       tristate

config BRCM_USB_EHCI
       tristate

config BRCM_USB_XHCI
       tristate

config BRCM_USB_PHY
       tristate
```

## G9/src/armbcm-linux-sources-3.14.28.1.14_p14/linux/drivers/platform/technicolor/Kconfig
```kconfig
menu "Technicolor driver"

config TECHNICOLOR_PLT_ID
	boolean "Platform ID"
	---help---
	  This driver provide the platform ID for Technicolor Set-Top-Box
	  according to device-tree gpio and platform name

if TECHNICOLOR_PLT_ID
config TECHNICOLOR_PLT_ID_PERMDATA
	boolean "Platform permanant data sysfs"
	---help---
	  This driver export generique permanant data from flash as a sysfs
	  into /sys/plt/permdata

config TECHNICOLOR_PLT_ID_PERMDATA_MAC
	int "Number of Mac address"
    default 1
	---help---
	  Define the number of MAC show into /sys/plt/permdata/
endif

endmenu
```
