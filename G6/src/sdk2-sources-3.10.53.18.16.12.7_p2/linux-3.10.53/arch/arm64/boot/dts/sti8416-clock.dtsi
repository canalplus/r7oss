/*
 * Copyright (C) 2014 STMicroelectronics R&D Limited
 * Author: Nunzio Raciti <nunzio.raciti@st.com>
 * Author: Madianga M'boumba Cedric <cedric.madianga@st.com>
 *
 * This program is free software; you can redistribute it and/or modify
 * it under the terms of the GNU General Public License version 2 as
 * published by the Free Software Foundation.
 */

/ {
	clocks {
		/*
		 * Fixed 30MHz oscillator inputs to SoC
		 */
		CLK_SYSIN: CLK_SYSIN {
			#clock-cells = <0>;
			compatible = "fixed-clock";
			clock-frequency = <30000000>;
			clock-output-names = "CLK_SYSIN";
		};

		/*
		 * ARM Peripheral clock for timers
		 */
		arm_periph_clk: arm_periph_clk {
			#clock-cells = <0>;
			compatible = "fixed-clock";
			clock-frequency = <600000000>;
		};

		/*
		 * Macro to ease defining all the clocks as fixed-frequency clocks
		 * as temporary use of clocks by drivers, till clock-driver is available
		 */
		#define FIXED_CLKDEF(name,id,freq)	name: id { \
								#clock-cells = <0>; \
								compatible = "fixed-clock"; \
								clock-frequency = <freq>; \
								clock-output-names = #name; \
							};

		/* CLOCKGEN B0 */
		FIXED_CLKDEF(CLK_ST231_DMU_0, clockgenB0@0, 700000000)
		FIXED_CLKDEF(CLK_ST231_DMU_1, clockgenB0@1, 700000000)
		FIXED_CLKDEF(CLK_VID_DMU_0, clockgenB0@2, 700000000)
		FIXED_CLKDEF(CLK_VID_DMU_1, clockgenB0@3, 700000000)
		FIXED_CLKDEF(CLK_PP_DMU_0, clockgenB0@4, 280000000)
		FIXED_CLKDEF(CLK_PP_DMU_1, clockgenB0@5, 280000000)
		FIXED_CLKDEF(CLK_ICN_CAL2, clockgenB0@6, 700000000)
		FIXED_CLKDEF(CLK_ICN_VDEC1, clockgenB0@7, 500000000)
		FIXED_CLKDEF(CLK_ICN_DISP, clockgenB08@, 500000000)
		FIXED_CLKDEF(CLK_ICN_HSIF, clockgenB0@9, 333000000)
		FIXED_CLKDEF(CLK_IC_VDEC1, clockgenB0@10, 333000000)
		FIXED_CLKDEF(CLK_VID_VP8, clockgenB0@11, 333000000)
		FIXED_CLKDEF(CLK_IC_DISP, clockgenB0@12, 333000000)
		FIXED_CLKDEF(CLK_ICN_REG_2, clockgenB0@13, 200000000)
		FIXED_CLKDEF(CLK_ICN_REG_3, clockgenB0@14, 200000000)
		FIXED_CLKDEF(CLK_PWM_0, clockgenB0@21, 100000000)
		FIXED_CLKDEF(CLK_PWM_1, clockgenB0@22, 100000000)
		FIXED_CLKDEF(CLK_PROMIP_DISP, clockgenB0@23, 100000000)

		/* CLOCKGEN B1 */
		FIXED_CLKDEF(CLK_PLL_VSAFE, clockgenB1@0, 213000000)
		FIXED_CLKDEF(CLK_ICN_NET, clockgenB1@1, 333000000)
		FIXED_CLKDEF(CLK_ICN_TS, clockgenB1@2, 333000000)
		FIXED_CLKDEF(CLK_ICN_VIDIN, clockgenB1@3, 533000000)
		FIXED_CLKDEF(CLK_IC_VIDIN, clockgenB1@4, 333000000)
		FIXED_CLKDEF(CLK_ICN_REG_4, clockgenB1@5, 213000000)
		FIXED_CLKDEF(CLK_PROC_FVDP_MAIN, clockgenB1@6, 400000000)
		FIXED_CLKDEF(CLK_PROC_FVDP_ENC_0, clockgenB1@7, 400000000)
		FIXED_CLKDEF(CLK_PROC_FVDP_ENC_1, clockgenB1@8, 400000000)
		FIXED_CLKDEF(CLK_VCPU_FVDP_MAIN, clockgenB1@9, 355000000)
		FIXED_CLKDEF(CLK_CORE_FP2, clockgenB1@10, 266000000)
		FIXED_CLKDEF(CLK_PROC_STBE, clockgenB1@11, 533000000)
		FIXED_CLKDEF(CLK_FRC2, clockgenB1@12, 27000000)
		FIXED_CLKDEF(CLK_TSOUT_0, clockgenB1@13, 108000000)
		FIXED_CLKDEF(CLK_TSOUT_1, clockgenB1@14, 108000000)
		FIXED_CLKDEF(CLK_MCHI, clockgenB1@15, 27000000)
		FIXED_CLKDEF(CLK_32KB_HSIF, clockgenB1@17, 50000000)
		FIXED_CLKDEF(CLK_EXT_ETH_PHY_25, clockgenB1@18, 25000000)
		FIXED_CLKDEF(CLK_ETH_125_50, clockgenB1@19, 125000000)
		FIXED_CLKDEF(CLK_PROMIP_NTW, clockgenB1@20, 100000000)
		FIXED_CLKDEF(CLK_ETH0_PHY_CLK_INT, clockgenB1@21, 125000000)
		FIXED_CLKDEF(CLK_ETH1_PHY_CLK_INT, clockgenB1@22, 125000000)
		FIXED_CLKDEF(CLK_ETH2_PHY_CLK_INT, clockgenB1@23, 125000000)

		/* CLOCKGEN C0 */
		FIXED_CLKDEF(CLK_MMC_0, clockgenC0@0, 200000000)
		FIXED_CLKDEF(CLK_NAND, clockgenC0@1, 200000000)
		FIXED_CLKDEF(CLK_FLASH, clockgenC0@2, 100000000)
		FIXED_CLKDEF(CLK_ICN_BD, clockgenC0@3, 350000000)
		FIXED_CLKDEF(CLK_ST231_GP0, clockgenC0@4, 700000000)
		FIXED_CLKDEF(CLK_ST231_GP1, clockgenC0@5, 700000000)
		FIXED_CLKDEF(CLK_ST231_SEC, clockgenC0@6, 700000000)
		FIXED_CLKDEF(CLK_CLUST_HVC, clockgenC0@7, 500000000)
		FIXED_CLKDEF(CLK_HWPE_HVC, clockgenC0@8, 400000000)
		FIXED_CLKDEF(CLK_FDMA_0_1, clockgenC0@9, 400000000)
		FIXED_CLKDEF(CLK_HVA, clockgenC0@10, 350000000)
		FIXED_CLKDEF(CLK_GBS, clockgenC0@11, 400000000)
		FIXED_CLKDEF(CLK_ICN_CCI, clockgenC0@12, 600000000)
		FIXED_CLKDEF(CLK_ICN_L0L1, clockgenC0@13, 700000000)
		FIXED_CLKDEF(CLK_ICN_ST231, clockgenC0@14, 500000000)
		FIXED_CLKDEF(CLK_ICN_GBS, clockgenC0@15, 500000000)
		FIXED_CLKDEF(CLK_ICN_VENC, clockgenC0@16, 500000000)
		FIXED_CLKDEF(CLK_ICN_VDEC0, clockgenC0@17, 500000000)
		FIXED_CLKDEF(CLK_PROC_JPEG, clockgenC0@18, 350000000)
		FIXED_CLKDEF(CLK_ICN_TSIF, clockgenC0@19, 350000000)
		FIXED_CLKDEF(CLK_ICN_FH, clockgenC0@20, 350000000)
		FIXED_CLKDEF(CLK_IC_PRED_VDEC0, clockgenC0@21, 30000000)
		FIXED_CLKDEF(CLK_ICN_CCL2, clockgenC0@22, 700000000)
		FIXED_CLKDEF(CLK_IC_VDEC0, clockgenC0@23, 350000000)
		FIXED_CLKDEF(CLK_IC_VENC, clockgenC0@24, 350000000)
		FIXED_CLKDEF(CLK_IC_GBS, clockgenC0@25, 350000000)
		FIXED_CLKDEF(CLK_ICN_REG_0, clockgenC0@26, 200000000)
		FIXED_CLKDEF(CLK_ICN_REG_1, clockgenC0@27, 200000000)
		FIXED_CLKDEF(CLK_MMC_1, clockgenC0@28, 200000000)
		FIXED_CLKDEF(CLK_MMC_2, clockgenC0@29, 50000000)
		FIXED_CLKDEF(CLK_DDR4SS_0_EXT, clockgenC0@30, 100000000)
		FIXED_CLKDEF(CLK_DDR4SS_1_EXT, clockgenC0@31, 100000000)
		FIXED_CLKDEF(CLK_TIMER, clockgenC0@32, 100000000)
		FIXED_CLKDEF(CLK_PROC_STFE, clockgenC0@33, 250000000)
		FIXED_CLKDEF(CLK_ATCLK, clockgenC0@34, 350000000)
		FIXED_CLKDEF(CLK_TRACE, clockgenC0@35, 150000000)
		FIXED_CLKDEF(CLK_DSS, clockgenC0@36, 36864000)
		FIXED_CLKDEF(CLK_FRC_1, clockgenC0@37, 27000000)
		FIXED_CLKDEF(CLK_FRC1_PAD, clockgenC0@38, 27000000)
		FIXED_CLKDEF(CLK_EXT_A5X, clockgenC0@39, 400000000)
		FIXED_CLKDEF(CLK_PMB_A5X, clockgenC0@40, 50000000)
		FIXED_CLKDEF(CLK_PMB_GPU, clockgenC0@41, 50000000)
		FIXED_CLKDEF(CLK_32KB_BOOTDEV, clockgenC0@42, 50000000)
		FIXED_CLKDEF(CLK_SYS_OUT, clockgenC0@43, 100000000)
		FIXED_CLKDEF(CLK_PROMIP_CPU, clockgenC0@44, 100000000)
		FIXED_CLKDEF(CLK_PP_HVC, clockgenC0@45, 400000000)
		FIXED_CLKDEF(CLK_FC_VDEC0, clockgenC0@46, 350000000)
		FIXED_CLKDEF(CLK_OSC_GPU, clockgenC0@47, 30000000)

		/* CLOCKGEN D0 */
		FIXED_CLKDEF(CLK_PCM_0	, clockgenD0@0, 50000000)
		FIXED_CLKDEF(CLK_PCM_1	, clockgenD0@1, 50000000)
		FIXED_CLKDEF(CLK_PCM_2	, clockgenD0@2, 50000000)
		FIXED_CLKDEF(CLK_PCM_3	, clockgenD0@3, 50000000)
		FIXED_CLKDEF(CLK_PCM_4	, clockgenD0@4, 50000000)
		FIXED_CLKDEF(CLK_PCMR_0_MASTER, clockgenD0@5, 50000000)
		FIXED_CLKDEF(CLK_PCMR_1_MASTER, clockgenD0@6, 50000000)
		FIXED_CLKDEF(CLK_PCMR_2_MASTER, clockgenD0@7, 50000000)
		FIXED_CLKDEF(CLK_PCMR_3_MASTER, clockgenD0@8, 50000000)
		FIXED_CLKDEF(CLK_PCMR_4_MASTER, clockgenD0@9, 50000000)

		/*CLOCKGEN D1 */
		FIXED_CLKDEF(CLK_FDMA_TELSS, clockgenD1@38, 400000000)
		FIXED_CLKDEF(CLK_FDMA_2, clockgenD1@39, 400000000)
	};
};
