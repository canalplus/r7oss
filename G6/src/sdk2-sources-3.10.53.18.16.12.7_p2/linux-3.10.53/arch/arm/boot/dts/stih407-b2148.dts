/*
 * Copyright (C) 2014 STMicroelectronics Limited.
 * Author: Giuseppe Condorelli <giuseppe.condorelli@st.com>
 *
 * This program is free software; you can redistribute it and/or modify
 * it under the terms of the GNU General Public License version 2 as
 * publishhed by the Free Software Foundation.
 */
/dts-v1/;

#include "stih407.dtsi"
#include "stihxxx-b2148.dtsi"

/ {
	model = "STiH407 B2148";
	compatible = "st,stih407-b2148", "st,stih407";
	memory{
		device_type = "memory";
		reg = <0x40000000 0x40000000>;
	};
};
