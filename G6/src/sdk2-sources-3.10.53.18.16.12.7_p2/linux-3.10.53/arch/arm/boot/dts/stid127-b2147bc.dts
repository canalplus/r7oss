/*
 * Copyright (C) 2014 STMicroelectronics Limited.
 * Author: Giuseppe Condorelli <giuseppe.condorelli@st.com>
 *
 * This program is free software; you can redistribute it and/or modify
 * it under the terms of the GNU General Public License version 2 as
 * publishhed by the Free Software Foundation.
 */
/dts-v1/;
#include "stid127.dtsi"
#include "stid127-b2147x.dtsi"

/ {
	model = "STiD127 B2147 REV B & C  Board";
	compatible = "st,stid127-b2147", "st,stid127";

	soc {
		pcie0: pcie@fef20000 {
			reset-gpio = <&PIO8 5 0>;
		};

		pcie1: pcie@fef30000 {
			reset-gpio = <&PIO8 7 0>;
		};

	};
};
