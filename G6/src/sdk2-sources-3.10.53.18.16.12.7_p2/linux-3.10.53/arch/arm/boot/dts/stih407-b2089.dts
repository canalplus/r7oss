/*
 * Copyright (C) 2014 STMicroelectronics (R&D) Limited.
 * Author: Giuseppe Cavallaro <peppe.cavallaro@st.com>
 *
 * This program is free software; you can redistribute it and/or modify
 * it under the terms of the GNU General Public License version 2 as
 * published by the Free Software Foundation.
 */
/dts-v1/;
#include "stih407.dtsi"
#include "stihxxx-b2089.dtsi"
/ {
	model = "STiH407 B2089";
	compatible = "st,stih407-b2089", "st,stih407";

	memory {
		device_type = "memory";
		reg = <0x40000000 0x80000000>;
	};

	soc {
		pcie1: pcie@9b10000 {
			status = "okay";
		};
	};
};
