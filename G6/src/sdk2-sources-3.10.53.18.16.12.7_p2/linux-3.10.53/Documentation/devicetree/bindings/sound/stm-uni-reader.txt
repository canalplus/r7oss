## G6/src/sdk2-sources-3.10.53.18.16.12.7_p2/linux-3.10.53/Documentation/devicetree/bindings/sound/stm-uni-reader.txt
```
===============================================================================
			stm uniperipheral reader
===============================================================================

Required properties:
- compatible		: Should be "st,snd_uni_reader"
- reg, reg-names, interrupts, interrupt-names	: Standard way to define device
			resources with names. look in
			Documentation/devicetree/bindings/resource-names.txt
- padcfg-names		: Pad configuration name
- padcfg-0		: Pad configuration
- version		: IP version
- dmas			: phandle of FDMA serving this reader
- dma-names		: Name of FDMA serving this reader
- fdma-initiator	: Initiator type
- fdma-direct-conn	: DREQ is connected directly to FDMA (i.e. no DREQ mux)
- fdma-request-line	: Request line used by FDMA
- description		: Reader description
- card-device		: ALSA card sub-device identifier
- channels		: Maximum number of output channels
- pinctrl-names		: pin control name
- pinctrl-0		: pin control configuration defiend in pinctrl dtsi


Typical usage example:

snd_uni_reader0: snd-uni-reader@0xfe288000 {
	compatible	= "st,snd_uni_reader";
	status		= "disabled";
	reg		= <0xfe288000 0x150>;
	interrupts	= <0 72 0>;
	padcfg-names	= "default";
	padcfg-0	= <&padcfg_b2011_spdif_in>;
	version		= <0>;
	dmas		= <&fdma0_sas>;
	dma-names	= "stm-fdma.3";
	fdma-initiator	= <0>;
	fdma-request-line = <42>;
	description	= "Uni Reader #0 (I2S)";
	card-device	= <5>;
	channels	= <8>;
	pinctrl-names	= "default";
	pinctrl-0	= <&pinctrl_snd_uni_reader0>;
};
```

## G6/src/sdk2-sources-3.10.53.18.16.12.7_p2/linux-3.10.53/Documentation/devicetree/bindings/spi/spi-st.txt
```
Required properties:
- compatible	: "st,comms-ssc-spi" or "st,comms-ssc4-spi"
- reg			: Offset and length of the register set for the device
- interrupts	: the interrupt specifier
- clock-names	: Must contain "ssc".
- clocks		: Must contain an entry for each name in clock-names. See the common
  clock bindings.
- A pinctrl state named "default" must be defined, using the bindings in
  ../pinctrl/pinctrl-binding.txt

Optional properties:
- cs-gpios	: List of GPIO chip selects (see bindings/spi/spi-bus.txt)
- A pinctrl state named "sleep" could be defined to set pins in sleep state
  when driver enters in suspend.

Child nodes represent devices on the SPI bus.  See (see
bindings/spi/spi-bus.txt) for supported options.

Example:

	spi0: spi3{
		compatible		= "st,spi",
		reg			= <0xfed43000 0x110>;
		interrupts		= <GIC_SPI 190 IRQ_TYPE_LEVEL_HIGH>;
		clocks			= <&CLK_S_ICN_REG_0>;
		clock-names		= "ssc";
		status			= "disabled";
		pinctrl-names		= "default";
		pinctrl-0		= <&pinctrl_spi0_default>;
		cs-gpios		= <&PIO13 3>, <&PIO13 4>;
		#address-cells		= <1>;
		#size-cells		= <0>;

		m25p80@0 {
			#address-cells = <1>;
			#size-cells = <1>;
			compatible = "n25q128";
			spi-max-frequency = <1000000>;
			reg = <0>;

			partition@0 {
				label = "Serial Flash 1";
				reg = <0x00000000 0x00500000>;
			};
			partition@1{
				label = "Serial Flash 2";
				reg = <0x00500000 0x00b00000>;
			};
		 };

		spidev@1 {
			 compatible		= "spidev";
			 spi-max-frequency	= <1000000>;
			 reg			= <1>;
		 };


	};
```

## G6/src/sdk2-sources-3.10.53.18.16.12.7_p2/linux-3.10.53/Documentation/devicetree/bindings/sti/mali.txt
```
==============================================================================
 ARM Mali-400 device configuration for STMicroelectronics SoCs.
==============================================================================

SoCs DTSI required properties:
- compatible : "st,mali".
- reg, reg-names, interrupts, interrupt-names   :
			Standard way to define device resources with names.
			Look in
                        Documentation/devicetree/bindings/resource-names.txt

IRQs for each graphical processor has to match with own register resource.
At probe time, these resources will be found by using the reg-name plus
the "_IRQ" suffix as reported in the example below:

If the reg-name is Mali_GP its interrupt must be described as: Mali_GP_IRQ


Boards DT configurable options:
- mali-mem-size : the maximum limit of memory the Mali GPU driver can
			allocate from the OS. If not provided the
			default size is 224MiB.
- gpu-clk-rate : to setup a specific GPU clock rate.

Example:
/* Mali GPU resources */
mali: mali@fd680000 {
	compatible      = "st,mali";
	reg             = <0xfd681000 0x200>,
			<0xfd680000 0x100>,  <0xfd683000 0x100>,
			<0xfd688000 0x1100>, <0xfd684000 0x100>,
			<0xfd68a000 0x1100>, <0xfd685000 0x100>,
			<0xfd68c000 0x1100>, <0xfd686000 0x100>,
			<0xfd68e000 0x1100>, <0xfd687000 0x100>;
	reg-names       = "Mali_L2",
			"Mali_GP", "Mali_GP_MMU",
			"Mali_PP0", "Mali_PP0_MMU",
			"Mali_PP1", "Mali_PP1_MMU",
			"Mali_PP2", "Mali_PP2_MMU",
			"Mali_PP3", "Mali_PP3_MMU";
	interrupts      = <0 80 0>, <0 81 0>,
			<0 78 0>, <0 79 0>,
			<0 82 0>, <0 85 0>,
			<0 83 0>, <0 86 0>,
			<0 84 0>, <0 87 0>;
	interrupt-names = "Mali_GP_IRQ",  "Mali_GP_MMU_IRQ",
		       "Mali_PP0_IRQ", "Mali_PP0_MMU_IRQ",
		       "Mali_PP1_IRQ", "Mali_PP1_MMU_IRQ",
		       "Mali_PP2_IRQ", "Mali_PP2_MMU_IRQ",
		       "Mali_PP3_IRQ", "Mali_PP3_MMU_IRQ";
	status = "okay";
	gpu-clk-rate = <400000000>;
	};

Example Board configuration:
mali: mali@09f00000 {
	mali-mem-size = <300000000>;
};
```

## G6/src/sdk2-sources-3.10.53.18.16.12.7_p2/linux-3.10.53/Documentation/devicetree/bindings/sti/st-socinfo.txt
```
==============================================================================
        st-socinfo: configuration for STMicroelectronics SoCs.
==============================================================================

SoCs DTSI required properties:
- compatible : "st,stih416-socinfo", "st,stih407-socinfo", "st,stid127-socinfo".
- st,syscfg  : System configuration register bank in which can be found
               "Device ID" register. Should be a phandle of the syscfg node.

Board DTS required properties:
- model      : Usually described at board level (in opposition with the two
               previous properties), this property gives the full board name,
               starting with SoC name, followed by space character and board
               name.


Example :

model = "STiH407 B2089";

soc {
        socinfo {
                compatible = "st,stih407-socinfo";
                st,syscfg = <&syscfg_core>;
        };

        syscfg_core:core-syscfg@92b0000{
                compatible = "st,stih407-core-syscfg", "syscon";
                reg = <0x92b0000 0x1000>;
        };
};
```

## G6/src/sdk2-sources-3.10.53.18.16.12.7_p2/linux-3.10.53/Documentation/devicetree/bindings/thermal/st-thermal.txt
```
Binding for Thermal sensor driver for STMicroelectronics STi series of SoCs.

Required parameters:
1) compatible : st,<SoC>-<module>-thermal
		Should be one of
		"st,stih415-sas-thermal",
		"st,stih415-mpe-thermal",
		"st,stih416-sas-thermal"
		"st,stih416-mpe-thermal"
		"st,stid127-thermal" or
		"st,stih407-thermal" according to the
		SoC type (stih415, stih416, stid127, stih407) and module type (sas or mpe).
		On stid127 & stih407 there is only one die/module, so there is no module type in the
		compatible string.
2) clock-names : Should be set to "thermal".
3) clocks: 	phandle of the clock used by the thermal sensor.
		For (2) and (3) refer :
		Documentation/devicetree/bindings/clock/clock-bindings.txt

Optional:
1) reg : For non-sysconf based sensor's, physical base address and length of the
	 sensor's registers.
2) interrupts:	Standard way to define interrupt number.
		refer: Documentation/devicetree/bindings/resource-names.txt
		Interrupt is mandatory to be defined when compatible is stih416-mpe-thermal.
		For thermal sensor's for which no interrupt has been defined, a polling delay
		of 1000ms will be used to read the temperature from device.

Example:
temp1{
	compatible	= "st,stih416-mpe-thermal";
	reg		= <0xfdfe8000 0x10>;
	clock-names	= "thermal";
	clocks		= <&CLK_M_MPETHSENS>;
	interrupts	=  <0 23 0>;
};
```

## G6/src/sdk2-sources-3.10.53.18.16.12.7_p2/linux-3.10.53/Documentation/devicetree/bindings/timer/st,lpc-timer.txt
```
Binding for LPC Timer on STMicroelectronics STi series SoCs

Required properties:
- compatible: Should be "st,st_lpc_timer"
- reg: Base address and length of the LPC Timers registers.
- clock-names: Set to "lpc_clk".
- clocks: phandle of the clock used by the LPC Timer

Example:
	lpc-timer@0x8788000 {
		compatible = "st,st_lpc_timer";
		reg = <0x8788000 0x1000>;
		clock-names = "lpc_clk";
		clocks = <&CLK_S_D3_FLEXGEN CLK_LPC_1>;
	};
```

## G6/src/sdk2-sources-3.10.53.18.16.12.7_p2/linux-3.10.53/Documentation/devicetree/bindings/usb/dwc3-st.txt
```
ST DWC3 glue logic

This file documents the parameters for the dwc3-st driver
This driver provides the glue logic to use the dwc3 on STiH407 platforms based.

Required properties:
 - compatible: must be "st,stih407-dwc3"
 - reg		: glue logic base address and USB syscfg ctrl register offest
 - reg-names	: register names.
 - st,syscon    : should be phandle to system configuration node which
		  encompases this glue registers.
 - resets       : phandle pointing to the system reset controller
 - #address-cells : must be <1>
 - pinctrl-0	: Pin control group

Optional properties:
 - st,dwc3-drd-device: to program the HC as "device" (static setup)

The DWC3 is a subnode to DWC3 core driver as shown below.
Take a look at Documentation/devicetree/bindings/usb/dwc3.txt

Example:

st_dwc3: dwc3@8f94000 {
	status		= "disabled";
	compatible	= "st,stih407-dwc3";
	reg		= <0x08f94000 0x1000>, <0x110 0x4>;
	reg-names	= "reg-glue", "syscfg-reg";
	st,syscfg	= <&syscfg_core>;
	resets          = <&powerdown STIH407_USB3_POWERDOWN>;
	#address-cells	= <1>;
	#size-cells	= <1>;
	pinctrl-names	= "default";
	pinctrl-0	= <&pinctrl_usb3>;
	ranges;

	dwc3: dwc3@9900000 {
		compatible	= "synopsys,dwc3";
		reg		= <0x09900000 0x100000>;
		interrupts	=  <GIC_SPI 155 IRQ_TYPE_NONE>;

		/* usb2 picophy port2, MiPHY2 port for USB3 */
		phys = <&usb3_picophy>;
		phy-names = "usb2-phy";

		usb3-phy = <&usb3_phy>;
	};
};
```

## G6/src/sdk2-sources-3.10.53.18.16.12.7_p2/linux-3.10.53/Documentation/devicetree/bindings/usb/dwc3.txt
```
synopsys DWC3 CORE

DWC3- USB3 CONTROLLER

Required properties:
 - compatible: must be "synopsys,dwc3"
 - reg : Address and length of the register set for the device
 - interrupts: Interrupts used by the dwc3 controller.

Optional properties:
 - usb2-phy : the handle to the USB2/HS PHY.
 - usb3-phy : the handle to the USB3/SS PHY
 - phys: from the *Generic PHY* bindings
 - phy-names: from the *Generic PHY* bindings
 - tx-fifo-resize: determines if the FIFO *has* to be reallocated.

This is usually a subnode to DWC3 glue to which it is connected.

dwc3@4a030000 {
	compatible = "synopsys,dwc3";
	reg = <0x4a030000 0xcfff>;
	interrupts = <0 92 4>
	usb2-phy = <&usb2_phy>;
	usb3-phy = <&usb3,phy>;
	tx-fifo-resize;
};
```

## G6/src/sdk2-sources-3.10.53.18.16.12.7_p2/linux-3.10.53/Documentation/devicetree/bindings/usb/phy-st-usb3.txt
```
ST USB-PHY controllers

The DWC3 port#2 can be used with a MiPHY2 to manage USB3 devices.

This is to document the DT parameters to be passed from the blob in that case.

Required properties:

MiPHY2:
- compatible : should be "st,stih407-usb3phy"
- reg : base physical address of the phy registers and length of memory mapped
	region.
	It must have: "usb3-uport", "pipew";
	So MiPHY and pipe wrapper.
- st,syscfg: sysconfig register to manage the device.
- resets: to reset the device.

Optional property:
- st,auto-calibration: boolean property to advice system to perform
		       autocalibration on device disconnection.
		       This will allow to setup the proper callback in the
		       phy-st-usb3.c source. To setup only for those socs that
		       support autocalibration.
- st,no-ssc: boolean property to disable ssc modulation at miphy setup time.
		       The are spare hard disks that don't support it and
		       so they result unusable due to continuous electrical
		       problems at runtime.

Example:

/* miPHY2 */
usb3_phy: usb3_phy@0 {
	compatible	= "st,stih407-usb3phy";
	#phy-cells	= <0>;
	resets		= <&softreset STIH407_MIPHY2_SOFTRESET>;
	reg		= <0x08f90000 0xff>, <0x08f95000 0xff>;
	reg-names	= "usb3-uport", "pipew";
	st,syscfg	= <&syscfg_core>;
	st,auto-calibration;
};
```

## G6/src/sdk2-sources-3.10.53.18.16.12.7_p2/linux-3.10.53/Documentation/devicetree/bindings/usb/st-hcd.txt
```
ST HCD (Host Controller Driver) for USB 2.0 and 1.1

The device node has following properties.

Required properties:
 - compatible: must be "st,usb-3000-065lp"
 - st,amba-config: stbus to amba bridge settings to configure usb2 plug.
 - reg: physical base addresses of the controller and length of memory mapped
   region.
 - reg-names: Names associated to the reg defines above.
   Should be "ehci", "ohci" and "protocol".
 - interrupts: interrupt numbers to the cpu.
 - interrupt-names: should be "ehci" and "ohci".
 - pinctrl-names, pinctrl-0: the pincontrol settings to configure muxing
   properly for USB pins.
 - clocks: from common clock binding: handle to usb clocks.
 - clock-names: from common clock binding:
   Must be "ic" for the interconnect clock and "ohci" for the 48MHz clock.
 - resets, reset-names: the power-down and soft-reset lines of USB IP.
   Associated names must be "powerdown" and "softreset".

Example:

st_usb_bus_config: st-usb-amba-config {
			st,bridge_type2;
			st,sd_config_missing;
			st,complete_on_error;
			st,read_ahead;
			st,max_opcode_LD64_ST64;
			st,chunks_in_msg = <0>;
			st,packets_in_chunk = <2>;
			st,threshold = <256>;
		};

usb0: usb@fe100000 {
	compatible	= "st,usb-3000-065lp";
	st,amba-config = <&st_usb_bus_config>;
	reg		= <0xfe1ffc00 0x100>,
			  <0xfe1ffe00 0x100>;
			  <0xfe1fff00 0x100>;
	reg-names	= "ohci", "ehci", "protocol";

	interrupts	=  <0 148 0>, <0 149 0>;
	interrupt-names	= "ehci","ohci";
	pinctrl-names	= "default";
	pinctrl-0	= <&pinctrl_usb0>;
	clocks		= <&CLK_S_ICN_IF_2>,
			  <&CLK_S_USB48>;
	clock-names	= "ic", "ohci";

	resets		= <&powerdown STIH416_USB0_POWERDOWN>,
			  <&softreset STIH416_USB0_SOFTRESET>;
	reset-names	= "power", "softreset";

	phys = <&usb2_phy>;
	phy-names = "usb2-phy";
};
```

## G6/src/sdk2-sources-3.10.53.18.16.12.7_p2/linux-3.10.53/Documentation/devicetree/bindings/watchdog/st-lpc-wdt.txt
```
* ST LPC WDT

Required properties:
- compatible : "st,<soc>-lpc-wdt"
- reg: LPC registers base address + range
- clock-names : Should be "lpc_wdt"
- clocks: Clock used by LPC device
- timeout-sec: watchdog timeout in seconds
- st,syscfg: syscfg node used to configure
		cpu reset type and mask.
- st,rst_type: Choose between "warm" or "cold" reset

Example:
	wdt@0xfde05000 {
	        compatible	= "st,stih416-lpc-wdt";
		reg		= <0xfde05000 0x1000>;
		clock-names	= "lpc_wdt";
		clocks		= <&CLK_M_MPETHSENS>;
		timeout-sec	= <600>;
		st,syscfg	= <&syscfg_system>;
		st,rst_type	= "warm";
	};
```
