## G6/src/sdk2-sources-3.10.53.18.16.12.7_p2/linux-3.10.53/drivers/thermal/st/Kconfig
```kconfig
config ST_THERMAL
	tristate "Thermal sensors on STMicroelectronics STi series of SoCs"
	depends on ARCH_STI
	help
	  Support for thermal sensors on STMicroelectronics STi series of SoCs.

config ST_THERMAL_SYSCFG
	bool "STi series syscfg register access based thermal sensors"
	depends on ST_THERMAL

config ST_THERMAL_MEMMAP
	bool "STi series memory mapped access based thermal sensors"
	depends on ST_THERMAL
```

## G6/src/sdk2-sources-3.10.53.18.16.12.7_p2/linux-3.10.53/drivers/video/wyaavio/Kconfig
```kconfig
menuconfig SCART
	tristate "Support for SCART interface"
	
config SCART_ST6437
	tristate "scart driver for st6437  Controller"
	depends on SCART
	help
	  Generic scart support for ST6437
```
