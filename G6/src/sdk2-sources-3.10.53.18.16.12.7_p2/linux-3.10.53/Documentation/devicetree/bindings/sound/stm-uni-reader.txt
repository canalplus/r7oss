## G6/src/sdk2-sources-3.10.53.18.16.12.7_p2/linux-3.10.53/arch/arm/configs/sti_defconfig
```kconfig
# CONFIG_SWAP is not set
CONFIG_POSIX_MQUEUE=y
CONFIG_NO_HZ=y
CONFIG_HIGH_RES_TIMERS=y
CONFIG_IKCONFIG=y
CONFIG_IKCONFIG_PROC=y
CONFIG_LOG_BUF_SHIFT=19
CONFIG_CGROUPS=y
CONFIG_CGROUP_FREEZER=y
CONFIG_CGROUP_DEVICE=y
CONFIG_CPUSETS=y
CONFIG_CGROUP_CPUACCT=y
CONFIG_RESOURCE_COUNTERS=y
CONFIG_MEMCG=y
CONFIG_MEMCG_KMEM=y
CONFIG_NAMESPACES=y
CONFIG_EMBEDDED=y
CONFIG_PERF_EVENTS=y
# CONFIG_COMPAT_BRK is not set
CONFIG_MODULE_UNLOAD=y
CONFIG_MODULE_SRCVERSION_ALL=y
CONFIG_ARCH_STI=y
CONFIG_PCI=y
CONFIG_PCI_MSI=y
CONFIG_PCI_ST=y
CONFIG_STM_PCIE_TRACKER_BUG=y
CONFIG_SMP=y
CONFIG_PREEMPT=y
CONFIG_AEABI=y
CONFIG_HIGHMEM=y
CONFIG_HIGHPTE=y
CONFIG_CC_STACKPROTECTOR=y
CONFIG_ARM_APPENDED_DTB=y
CONFIG_CPU_FREQ=y
CONFIG_CPU_FREQ_GOV_USERSPACE=y
CONFIG_CPU_FREQ_GOV_ONDEMAND=y
CONFIG_GENERIC_CPUFREQ_CPU0=y
CONFIG_VFP=y
CONFIG_NEON=y
CONFIG_PM_RUNTIME=y
CONFIG_PM_OPP=y
CONFIG_NET=y
CONFIG_PACKET=y
CONFIG_UNIX=y
CONFIG_INET=y
CONFIG_IP_PNP=y
CONFIG_IP_PNP_DHCP=y
CONFIG_SYN_COOKIES=y
CONFIG_IPV6=y
CONFIG_NETFILTER=y
CONFIG_NF_CONNTRACK=y
CONFIG_NF_CONNTRACK_IPV4=y
CONFIG_IP_NF_IPTABLES=y
CONFIG_IP_NF_FILTER=y
CONFIG_NF_NAT_IPV4=y
CONFIG_IP_NF_RAW=y
CONFIG_NF_CONNTRACK_IPV6=y
CONFIG_IP6_NF_IPTABLES=y
CONFIG_IP6_NF_FILTER=y
CONFIG_IP6_NF_RAW=y
CONFIG_NF_NAT_IPV6=y
CONFIG_DEVTMPFS=y
CONFIG_DEVTMPFS_MOUNT=y
CONFIG_CONNECTOR=y
CONFIG_MTD=y
CONFIG_MTD_BLOCK=y
CONFIG_MTD_STM_SPI_FSM=y
CONFIG_MTD_NAND=y
CONFIG_MTD_NAND_STM_BCH=y
CONFIG_MTD_UBI=y
CONFIG_EEPROM_AT24=y
CONFIG_BLK_DEV_SD=y
CONFIG_ATA=y
CONFIG_SATA_AHCI_PLATFORM=y
CONFIG_SATA_AHCI_ST=y
CONFIG_NETDEVICES=y
CONFIG_VETH=y
# CONFIG_NET_VENDOR_3COM is not set
# CONFIG_NET_VENDOR_ADAPTEC is not set
# CONFIG_NET_VENDOR_ALTEON is not set
# CONFIG_NET_VENDOR_AMD is not set
# CONFIG_NET_VENDOR_ATHEROS is not set
# CONFIG_NET_CADENCE is not set
# CONFIG_NET_VENDOR_BROADCOM is not set
# CONFIG_NET_VENDOR_BROCADE is not set
# CONFIG_NET_VENDOR_CHELSIO is not set
# CONFIG_NET_VENDOR_CIRRUS is not set
# CONFIG_NET_VENDOR_CISCO is not set
# CONFIG_NET_VENDOR_DEC is not set
# CONFIG_NET_VENDOR_DLINK is not set
# CONFIG_NET_VENDOR_EMULEX is not set
# CONFIG_NET_VENDOR_EXAR is not set
# CONFIG_NET_VENDOR_FARADAY is not set
# CONFIG_NET_VENDOR_HP is not set
# CONFIG_NET_VENDOR_INTEL is not set
# CONFIG_NET_VENDOR_MARVELL is not set
# CONFIG_NET_VENDOR_MELLANOX is not set
# CONFIG_NET_VENDOR_MICREL is not set
# CONFIG_NET_VENDOR_MICROCHIP is not set
# CONFIG_NET_VENDOR_MYRI is not set
# CONFIG_NET_VENDOR_NATSEMI is not set
# CONFIG_NET_VENDOR_NVIDIA is not set
# CONFIG_NET_VENDOR_OKI is not set
# CONFIG_NET_PACKET_ENGINE is not set
# CONFIG_NET_VENDOR_QLOGIC is not set
# CONFIG_NET_VENDOR_RDC is not set
# CONFIG_NET_VENDOR_SEEQ is not set
# CONFIG_NET_VENDOR_SILAN is not set
# CONFIG_NET_VENDOR_SIS is not set
# CONFIG_NET_VENDOR_SMSC is not set
CONFIG_STMMAC_ETH=y
CONFIG_FASTPATH_ST=y
CONFIG_ISVE_ST=y
# CONFIG_NET_VENDOR_SUN is not set
# CONFIG_NET_VENDOR_TEHUTI is not set
# CONFIG_NET_VENDOR_TI is not set
# CONFIG_NET_VENDOR_VIA is not set
# CONFIG_NET_VENDOR_WIZNET is not set
CONFIG_ICPLUS_PHY=y
CONFIG_REALTEK_PHY=y
CONFIG_RTL8366_SMI=y
CONFIG_RTL8366_SMI_DEBUG_FS=y
CONFIG_RTL8367_PHY=y
CONFIG_USB_PEGASUS=y
CONFIG_USB_USBNET=y
CONFIG_INPUT_MATRIXKMAP=y
# CONFIG_INPUT_MOUSEDEV is not set
# CONFIG_KEYBOARD_ATKBD is not set
CONFIG_KEYBOARD_GPIO=y
CONFIG_KEYBOARD_ST_KEYSCAN=y
# CONFIG_INPUT_MOUSE is not set
# CONFIG_SERIO is not set
# CONFIG_LEGACY_PTYS is not set
# CONFIG_DEVKMEM is not set
CONFIG_SERIAL_ST_ASC=y
CONFIG_SERIAL_ST_ASC_CONSOLE=y
CONFIG_HW_RANDOM=y
CONFIG_HW_RANDOM_ST=y
CONFIG_I2C=y
CONFIG_I2C_CHARDEV=y
CONFIG_I2C_ST=y
CONFIG_SPI=y
CONFIG_SPI_GPIO=y
CONFIG_SPI_ST=y
CONFIG_SPI_SPIDEV=y
CONFIG_GPIO_SYSFS=y
CONFIG_GPIO_ST_WAKEUP=y
CONFIG_POWER_SUPPLY=y
CONFIG_POWER_RESET=y
CONFIG_POWER_RESET_ST=y
# CONFIG_HWMON is not set
CONFIG_THERMAL=y
CONFIG_CPU_THERMAL=y
CONFIG_ST_THERMAL=y
CONFIG_ST_THERMAL_SYSCFG=y
CONFIG_ST_THERMAL_MEMMAP=y
CONFIG_WATCHDOG=y
CONFIG_ST_LPC_WATCHDOG=y
CONFIG_REGULATOR=y
CONFIG_REGULATOR_ST_PWM=y
CONFIG_REGULATOR_ST_FLASHSS=y
CONFIG_MEDIA_SUPPORT=y
CONFIG_MEDIA_CAMERA_SUPPORT=y
CONFIG_MEDIA_ANALOG_TV_SUPPORT=y
CONFIG_MEDIA_DIGITAL_TV_SUPPORT=y
CONFIG_MEDIA_RC_SUPPORT=y
CONFIG_MEDIA_CONTROLLER=y
CONFIG_VIDEO_V4L2_SUBDEV_API=y
CONFIG_DVB_DYNAMIC_MINORS=y
CONFIG_LIRC=y
CONFIG_RC_DEVICES=y
CONFIG_RC_ST=y
CONFIG_V4L_PLATFORM_DRIVERS=y
CONFIG_VIDEO_STI=y
CONFIG_FB=y
CONFIG_FB_MODE_HELPERS=y
CONFIG_FB_SIMPLE=y
CONFIG_SOUND=y
CONFIG_SND=y
CONFIG_SND_PCM_OSS=y
CONFIG_SND_STM=y
CONFIG_USB=y
CONFIG_USB_XHCI_HCD=y
CONFIG_USB_EHCI_HCD=y
CONFIG_USB_OHCI_HCD=y
CONFIG_USB_HCD_ST=y
CONFIG_USB_STORAGE=y
CONFIG_USB_DWC3=y
CONFIG_DWC3_HOST_USB3_LPM_ENABLE=y
CONFIG_USB_PHY=y
CONFIG_ST_USB3_MIPHY=y
CONFIG_PHY_STI8416_USB2=y
CONFIG_MMC=y
CONFIG_MMC_SDHCI=y
CONFIG_MMC_SDHCI_PLTFM=y
CONFIG_MMC_SDHCI_ST=y
CONFIG_NEW_LEDS=y
CONFIG_LEDS_CLASS=y
CONFIG_LEDS_GPIO=y
CONFIG_LEDS_TRIGGERS=y
CONFIG_LEDS_TRIGGER_HEARTBEAT=y
CONFIG_RTC_CLASS=y
# CONFIG_RTC_SYSTOHC is not set
CONFIG_RTC_DRV_ST_SBC=y
CONFIG_MALI400=y
CONFIG_ST_AMBA_BRIDGE=y
CONFIG_COMMON_CLK_DEBUG=y
# CONFIG_IOMMU_SUPPORT is not set
CONFIG_ST_REMOTEPROC=y
CONFIG_MEMORY=y
CONFIG_ST_DDR_CNTRL=y
CONFIG_PWM=y
CONFIG_PWM_ST=y
CONFIG_PHY_STIH41X_USB=y
CONFIG_PHY_MIPHY365X=y
CONFIG_PHY_STID127_USB=y
CONFIG_PHY_MIPHY28LP=y
CONFIG_PHY_STIH407_USB=y
CONFIG_PHY_STI8416_USB=y
CONFIG_EXT2_FS=y
CONFIG_EXT2_FS_XATTR=y
CONFIG_EXT2_FS_POSIX_ACL=y
CONFIG_EXT2_FS_SECURITY=y
CONFIG_EXT3_FS=y
CONFIG_EXT3_FS_POSIX_ACL=y
CONFIG_EXT3_FS_SECURITY=y
CONFIG_EXT4_FS=y
CONFIG_EXT4_FS_POSIX_ACL=y
CONFIG_EXT4_FS_SECURITY=y
# CONFIG_DNOTIFY is not set
CONFIG_FUSE_FS=y
CONFIG_VFAT_FS=y
CONFIG_NTFS_FS=y
CONFIG_TMPFS=y
CONFIG_TMPFS_POSIX_ACL=y
CONFIG_JFFS2_FS=y
CONFIG_JFFS2_FS_XATTR=y
CONFIG_UBIFS_FS=y
CONFIG_NFS_FS=y
CONFIG_ROOT_NFS=y
CONFIG_NLS_CODEPAGE_437=y
CONFIG_NLS_ISO8859_1=y
CONFIG_PRINTK_TIME=y
CONFIG_FRAME_WARN=2048
CONFIG_DEBUG_SECTION_MISMATCH=y
CONFIG_DEBUG_INFO=y
CONFIG_DEBUG_MEMORY_INIT=y
# CONFIG_FTRACE is not set
CONFIG_KPTRACE=y
CONFIG_KPTRACE_SYNC=y
CONFIG_STM_SYSTRACE=y
CONFIG_CRYPTO_MANAGER=y
CONFIG_CRYPTO_SEQIV=y
CONFIG_CRYPTO_MD5=y
CONFIG_CRYPTO_SHA1=y
CONFIG_CRYPTO_SHA256=y
# CONFIG_CRYPTO_ANSI_CPRNG is not set
# CONFIG_CRYPTO_HW is not set
CONFIG_XZ_DEC=y
```

## G6/src/sdk2-sources-3.10.53.18.16.12.7_p2/linux-3.10.53/arch/arm/mach-sti/Kconfig
```kconfig
menuconfig ARCH_STI
	bool "STMicroelectronics Consumer Electronics SOCs with Device Trees" if ARCH_MULTI_V7
	select GENERIC_CLOCKEVENTS
	select CLKDEV_LOOKUP
	select ARM_GIC
	select ARM_GLOBAL_TIMER
	select ST_LPC_CLOCK
	select ARCH_HAS_CPUFREQ
	select ARCH_HAS_OPP
	select PINCTRL
	select PINCTRL_ST
	select MFD_SYSCON
	select ARCH_HAS_RESET_CONTROLLER
	select MIGHT_HAVE_CACHE_L2X0
	select HAVE_SMP
	select HAVE_ARM_SCU if SMP
	select ARCH_REQUIRE_GPIOLIB
	select MIGHT_HAVE_PCI
	select NEED_MACH_IO_H if PCI
	select ARM_ERRATA_754322
	select ARM_ERRATA_764369 if SMP
	select ARM_ERRATA_775420
	select ST_LPM if SUSPEND
	select ZONE_DMA
	select SOC_BUS
	help
	  Include support for STiH41x SOCs like STiH415/416 using the device tree
	  for discovery
	  More information at Documentation/arm/STiH41x and
	  at Documentation/devicetree


if ARCH_STI

config SOC_STIH415
	bool "STiH415 STMicroelectronics Consumer Electronics family"
	default y
	select STIH415_RESET
	help
	  This enables support for STMicroelectronics Digital Consumer
	  Electronics family StiH415 parts, primarily targetted at set-top-box
	  and other digital audio/video applications using Flattned Device
	  Trees.

config SOC_STIH416
	bool "STiH416 STMicroelectronics Consumer Electronics family"
	default y
	select STIH416_RESET
	help
	  This enables support for STMicroelectronics Digital Consumer
	  Electronics family StiH416 parts, primarily targetted at set-top-box
	  and other digital audio/video applications using Flattened Device
	  Trees.

config SOC_STIH407
	bool "STiH407 STMicroelectronics Consumer Electronics family"
	default y
	select STIH407_RESET
	select USB_ARCH_HAS_XHCI
	help
	  This enables support for STMicroelectronics Digital Consumer
	  Electronics family StiH407 parts, targetted at set-top-box
	  and other digital audio/video applications using Flattened Device
	  Trees.

config SOC_STID127
	bool "STiD127 STMicroelectronics Consumer Electronics family"
	default y
	select STID127_RESET
	help
	  This enables support for STMicroelectronics Digital Consumer
	  Electronics family StiD127 parts, primarily targetted at set-top-box
	  and other digital audio/video applications using Flattened Device
	  Trees.

config ST_CID_IRQMUX
	bool "st cid steerer irq mux"
	default y
	depends on SOC_STID127
	help
	  Enable this option to support CID irqmux mapping in the kernel

endif
```

## G6/src/sdk2-sources-3.10.53.18.16.12.7_p2/linux-3.10.53/drivers/lpm/Kconfig
```kconfig
config ST_LPM
	bool "LPM on STMicroelectronics STi series of SoCs"
	depends on ARCH_STI
	help
	  Support for LPM driver on STMicroelectronics STi series
	  of SoCs.
	  Enable this config parameter for enabling ST LPM driver
	  in the kernel.
```

## G6/src/sdk2-sources-3.10.53.18.16.12.7_p2/linux-3.10.53/drivers/media/platform/sti/Kconfig
```kconfig
config VIDEO_STI
	bool "STMicroelectronics Video driver setup"
	depends on VIDEO_DEV && ARCH_STI
	select VIDEOBUF2_VMALLOC
	select V4L2_MEM2MEM_DEV
	select VIDEOBUF2_BPA2_CONTIG
	help
	  Enables proper configuration of VIDEO subsystem for STi platforms.
	  It mainly consists in setting following kernel features:
	  VIDEOBUF2 / V4L2_MEM2MEM_DEV.
	  In addition it provides BPA2 driver to support video operations.

config VIDEOBUF2_BPA2_CONTIG
	depends on VIDEO_STI
	select VIDEOBUF2_CORE
	select VIDEOBUF2_MEMOPS
	tristate
```

## G6/src/sdk2-sources-3.10.53.18.16.12.7_p2/linux-3.10.53/drivers/net/ethernet/stmicro/isve/Kconfig
```kconfig
config ISVE_ST
	tristate "Integrated SoC Virtual Ethernet driver"
	depends on HAS_IOMEM && ARCH_STI && OF
	select NET_CORE
	select CRC32
	---help---
	  This is the virtual Ethernet driver used in the new ST SoC
	  generations.
	  It dials with a special HW bridge designed to allow the communication
	  among DOCSIS system CPUs.
	  This means that all devices connected through a sort of virtual
	  Ethernet devices.

	  Say N to exclude this support.
```

## G6/src/sdk2-sources-3.10.53.18.16.12.7_p2/linux-3.10.53/drivers/net/ethernet/stmicro/stmfp/Kconfig
```kconfig
#
# STMFP network device configuration
#

config FASTPATH_ST
	tristate "ST FastPath Network Device Driver"
	select NET_CORE
	select MII
	select PHYLIB
	select FIXED_PHY
	depends on ARCH_STI && OF
	---help---
	  Driver for ST FastPath Ethernet device. This hardware is used
	  on some ST embedded platforms to route packets from multiple on
	  chip devices to external Ethernet ports. This driver implements a
	  simple Ethernet interface on each of the hardware ports.
	  If you have a controller with this interface, say Y or M here.
	  If unsure, say N.
```

## G6/src/sdk2-sources-3.10.53.18.16.12.7_p2/linux-3.10.53/drivers/pci/host/Kconfig
```kconfig
menu "PCI host controller drivers"
	depends on PCI

config PCI_MVEBU
	bool "Marvell EBU PCIe controller"
	depends on ARCH_MVEBU

config PCIE_DW
	bool

config PCI_EXYNOS
	bool "Samsung Exynos PCIe controller"
	depends on SOC_EXYNOS5440
	select PCIEPORTBUS
	select PCIE_DW

config PCI_TEGRA
	bool "NVIDIA Tegra PCIe controller"
	depends on ARCH_TEGRA

config PCI_ST
	bool "ST STiH41x PCIe controller"
	depends on ARCH_STI

config STM_PCIE_TRACKER_BUG
	bool "ST PCIe: Workaround tracker bug"
	depends on SMP && PCI_ST && SOC_STIH407
	select NEED_MACH_IO_H
	default n
	---help---
	  Enable workaround for tracker bug on Cannes STBUS->AXI convertor. The tracker
	  fills in missing bits of information for the STBUS->AXI convertor. It cannot
	  handle out of order traffic, which is a problem when the CPUs issue transactions
	  to the PCIe cell at the same time. The PCIe cell is free to re-order these transactions,
	  as they have different IDs. Unfortunately this confuses the tracker which expects in-order,
	  and the interconnect dies. The workaround is to lock around each readl/writel to ensure that
	  the read or write has completed before the other CPU starts its operation.

endmenu
```

## G6/src/sdk2-sources-3.10.53.18.16.12.7_p2/linux-3.10.53/drivers/phy/Kconfig
```kconfig
#
# PHY
#

menu "PHY Subsystem"

config GENERIC_PHY
	tristate "PHY Core"
	help
	  Generic PHY support.

	  This framework is designed to provide a generic interface for PHY
	  devices present in the kernel. This layer will have the generic
	  API by which phy drivers can create PHY using the phy framework and
	  phy users can obtain reference to the PHY. All the users of this
	  framework should select this config.

config PHY_STIH41X_USB
	tristate "STMicroelectronics USB2 PHY driver for STiH41x series"
	depends on ARCH_STI
	depends on GENERIC_PHY
	help
	  Enable this to support the USB transceiver that is part of
	  STMicroelectronics STiH41x SoC series.

config PHY_MIPHY365X
	tristate "STMicroelectronics MIPHY365X PHY driver for STiH41x series"
	depends on ARCH_STI
	depends on GENERIC_PHY
	help
	  Enable this to support the miphy transceiver (for SATA/PCIE)
	  that is part of STMicroelectronics STiH41x SoC series.

config PHY_STID127_USB
	tristate "STMicroelectronics USB2 PHY driver for STiD127"
	depends on ARCH_STI
	depends on GENERIC_PHY
	help
	  Enable this to support the USB transceiver that is part of
	  STMicroelectronics STiD127 SoC.

config PHY_MIPHY28LP
	tristate "STMicroelectronics MIPHY28LP PHY driver for STiH407"
	depends on ARCH_STI
	depends on GENERIC_PHY
	help
	  Enable this to support the miphy transceiver (for SATA/PCIE/USB3)
	  that is part of STMicroelectronics STiH407 SoC.

config PHY_STIH407_USB
	tristate "STMicroelectronics USB2 picoPHY driver for STiH407 family"
	depends on ARCH_STI
	depends on GENERIC_PHY
	help
	  Enable this support to enable the picoPHY device used by USB2
	  and USB3 controllers on STMicroelectronics STiH407 SoC families.

config PHY_STI8416_USB
	tristate "STMicroelectronics USB2 PHY driver for STi8416"
	depends on ARCH_STI
	depends on GENERIC_PHY
	help
	  Enable this to support the USB transceiver that is part of
	  STMicroelectronics STi8416 SoC.

endmenu
```

## G6/src/sdk2-sources-3.10.53.18.16.12.7_p2/linux-3.10.53/drivers/platform/Kconfig
```kconfig
if X86
source "drivers/platform/x86/Kconfig"
endif
if GOLDFISH
source "drivers/platform/goldfish/Kconfig"
endif
if ARCH_STI
source "drivers/platform/sti/Kconfig"
endif
```

## G6/src/sdk2-sources-3.10.53.18.16.12.7_p2/linux-3.10.53/drivers/platform/sti/Kconfig
```kconfig
#
# STi Platform Specific Drivers
#

source "drivers/platform/sti/mali/Kconfig"

config ST_SOCINFO
	bool "Export SoC identifiers from DT and syscfg register"
	select SOC_BUS
	default y

config ST_AMBA_BRIDGE
	tristate "STBus<->AMBA bridge configuration on STMicroelectronics STI SoCs"
	depends on ARCH_STI
	help
	  This driver allows configuration of STBus/AMBA bridge on STMicroelectronics
	  STI series SoCs.
```

## G6/src/sdk2-sources-3.10.53.18.16.12.7_p2/linux-3.10.53/drivers/reset/sti/Kconfig
```kconfig
if ARCH_STI

config STI_RESET_SYSCFG
	bool
	select RESET_CONTROLLER

config STIH415_RESET
	bool
	select STI_RESET_SYSCFG

config STIH416_RESET
	bool
	select STI_RESET_SYSCFG

config STIH407_RESET
	bool
	select STI_RESET_SYSCFG

config STID127_RESET
	bool
	select STI_RESET_SYSCFG

config STI8416_RESET
	bool
	select STI_RESET_SYSCFG

endif
```
