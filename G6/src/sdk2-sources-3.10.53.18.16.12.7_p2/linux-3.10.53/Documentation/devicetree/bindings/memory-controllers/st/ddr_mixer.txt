## G6/src/sdk2-sources-3.10.53.18.16.12.7_p2/linux-3.10.53/Documentation/devicetree/bindings/memory-controllers/st/ddr_mixer.txt
```
DDR Mixer
---------

DDR mixer can be described as a parent node with instances of
the IP as child nodes. The mandatory properties are:
- #address-cells: number of cells required to define the base address
		  that is memory mapped. Should be 1.
- #size-cells: number of cells to describe the size of the memory mapped area.
	       Should be 1.
- compatible: should be "st,ddr-mixer" and "simple-bus"

No other properties are required.

The child nodes have the name format as "ddr-mixer@base-address",
where base-address is the memoery mapped physical address of the IP.
The mandatory properties are:
- reg: should be a list property with first cell indicating the physical
base address of the IP and the second cell indicating the size of the
memory mapped region.
No other properties are required.

ddr-mixer {
	#address-cells = <1>;
	#size-cells = <1>;
	ranges;
	compatible = "st,ddr-mixer", "simple-bus";
	ddr-mixer@09012000 {
		reg = <0x09012000 0x2000>;
	};
};
```

## G6/src/sdk2-sources-3.10.53.18.16.12.7_p2/linux-3.10.53/Documentation/devicetree/bindings/memory-controllers/st/ddr_pctl.txt
```
DDR PCTL controller
-------------------

DDR-PCTL controller can be described as a parent node with instances of
the IP as child nodes. The mandatory properties are:
- #address-cells: number of cells required to define the base address
		  that is memory mapped. Should be 1.
- #size-cells: number of cells to describe the size of the memory mapped area.
	       Should be 1.
- compatible: should be "simple-bus" for non 407-family SoCs, while it should be
	      "st,ddr-pctl" for 407-family SoCs. For 407-family SoCs, "simple-bus"
	      is optional.
No other properties are required.

The child nodes have the name format as "ddr-pctl@base-address",
where base-address is the memoery mapped physical address of the IP.
The mandatory properties are:
- compatible: should be st,ddr-controller
- reg: should be a list property with first cell indicating the physical
base address of the IP and the second cell indicating the size of the
memory mapped region.

No other properties are required.

Example:
	ddr-pctl-controller {
		#address-cells = <1>;
		#size-cells = <1>;
		ranges;
		compatible = "st,ddr-pctl", "simple-bus";
		ddr-pctl@09010000 {
			compatible = "st,ddr-controller";
			reg = <0x09010000 0x2000>;
		};
	};
```

## G6/src/sdk2-sources-3.10.53.18.16.12.7_p2/linux-3.10.53/Documentation/devicetree/bindings/mmc/sdhci-st.txt
```
* STMicroelectronics sdhci-st MMC/SD controller

This file documents differences between the core properties in mmc.txt
and the properties used by the sdhci-st driver

Required properties:
- compatible: Must be "st,sdhci" and it can be compatible to "st,sdhci-stih407"
	      to set the internal glue logic used for configuring the MMC
	      subsystem (mmcss) inside the FlashSS (available in STiH407 SoC).
- clocks: card clock, must be "mmc".
- reg: this must provide the host controller base address and it can also
       contain the FlashSS Top register for TX/RX delay used by the driver
       to configure DDL inside the flashSS.

Optional properties:
- reset: to provide a reset to the HC.
- max-frequency: can be 200MHz, 100Mz or 50MHz (default) and used for
		 configuring the CCONFIG3 in the mmcss.
- mmc-cap-uhs-sdr50: to enable the SDR50 in the mmcss.
- mmc-cap-uhs-sdr104: to enable the SDR104 in the mmcss.
- mmc-cap-uhs-ddr50: to enable the DDR50 in the mmcss.
- non-removable: non-removable slot (bindings/mmc/mmc.txt).
  Also used for configuring mmcss in STiH407 SoC family.
- st,no-hispd-bit: to disable HISPD bit field in HI-SPEED SD card.
- mmc-cap-1p8: to enable 1.8V support in the mmcss.
- mmc-cap-cnt-timer-max: to enable the returning timer count max flavour.

Example:

mmc1: sdhci@09080000 {
	compatible	= "st,sdhci";
	status		= "disabled";
	reg = <0x09060000 0x7ff>, <0x9061008 0x20>;
	reg-names = "mmc", "top-mmc-delay";
	interrupts	=  <0 90 0>;
	interrupt-names = "mmcirq";
	clock-names	= "mmc";
	clocks		= <&CLK_MMC_1>;
	cd-gpios	= <&PIO19 0 0>;
	resets		= <&softreset STIH407_MMC1_SOFTRESET>;
};
```

## G6/src/sdk2-sources-3.10.53.18.16.12.7_p2/linux-3.10.53/Documentation/devicetree/bindings/net/isve.txt
```
* Integrated SoC Virtual Ethernet driver

Required properties:
- compatible: Should be "st,isve"
- reg: Address and length of the downstream and upstream control queue
       registers.
- interrupts: Should contain downstream and upstream interrupts
- interrupt-names: Should contain the interrupt names "isveirq_ds", "isveirq_us"
		   so the downstream and upstream interrupt names.

Optional properties:
isve,queue_number		Number of the queue
isve,skip_hdr			Extra bytes to remove (also in case of the
				HW is programmed to remove both extra and docsis
				headers from the incoming frames) to keep the
				Ethernet frame aligned to 32bit.
isve,hw_rem_hdr			This can be 1 to remove the docsis header,
				2 to remove the extra header and 3 to remove
				all the headers.

Glue logic to manage internal docis APIs:

ISVE can use a internal glue logic to manage some docsis registers shared
among all the queues. For example to enable/disable the upstream/downstream
queues. The glue logic needs the following properties:

- compatible: Should be "st,docsis"
- reg: downsteam and upstream base address

Examples:

isve interface

	if17:queue_3 {
		compatible	= "st,isve";
		device_type = "network";
		reg = <0xfee2e460 0x20>, <0xfee1a478 0x20>;
		interrupts = <GIC_SPI 78 IRQ_TYPE_NONE>, < GIC_SPI 89 IRQ_TYPE_NONE>;
		interrupt-names = "isveirq_ds", "isveirq_us";

		isve,downstream_queue_size = <32>;
		isve,upstream_queue_size = <32>;
		isve,queue_number = <3>;
		isve,skip_hdr = <0x2>; /* two extra bytes have to be removed */
		isve,hw_rem_hdr = <0x3>; /* remove docsis and extra HDR */
	};

common glue logic:

	docsis: docsis@fee00000 {
		compatible = "st,docsis";
		status = "okay";
		reg = <0xfee2e000 0x100>, <0xfee1a000 0x100>;
		reg-names = 	"dfwd-reg", "upiim-reg";
	};
```

## G6/src/sdk2-sources-3.10.53.18.16.12.7_p2/linux-3.10.53/Documentation/devicetree/bindings/net/rtl83xx.txt
```
* Realtek RTL83xx switches

Required properties:
- compatible: Should be "realtek,rtl8367rb".

  Just this device has been fully tested.

- gpio-reset: gpio line to reset the switch
- gpio-sck: gpio line to manage the SCL (i2c) for SMI
- gpio-sda: gpio line to manage the SDA (i2c) for SMI
- rtl8367rb,extif0; rtl8367rb,extif1; rtl8367rb,extif2;
  different families have embedded just one or two or three extended mac
  interface. So this parameter is to advice that this iface is available
- rtl8367rb,extif1-mode: supported modes that can be:
  0: disabled, 1: RGMII, 2: MII MAC, 3: MII PHY, 4/5: TMII MAC/PHY, 6: GMII
- rtl8367rb,extif1-txdelay and rtl8367rb,extif1-rxdelay: set to 1 for adding
  2ns of extra delay
- rtl8367rb,extif1-force_mode: to disable ANE and force the link.
- rtl8367rb,extif1-duplex: 1 to enable duplex
- rtl8367rb,extif1-speed: 0: 10, 1: 100, 2: 1000

Examples:

	realtek: rtl8367rb {
		compatible	= "realtek,rtl8367rb";
		status		= "okay";

		gpio-reset	= <&PIO0 7 0>;
		gpio-sck	= <&PIO1 1 0>;
		gpio-sda	= <&PIO1 0 0>;

		rtl8367rb,extif1;
		rtl8367rb,extif1-mode = <1>;	// RGMII
		rtl8367rb,extif1-txdelay = <0>;
		rtl8367rb,extif1-rxdelay = <1>;
		rtl8367rb,extif1-force_mode = <1>;
		rtl8367rb,extif1-txpause = <2>;
		rtl8367rb,extif1-rxpause = <2>;
		rtl8367rb,extif1-link = <1>;
		rtl8367rb,extif1-duplex = <1>;
		rtl8367rb,extif1-speed = <2>; // Giga speed
	};
```

## G6/src/sdk2-sources-3.10.53.18.16.12.7_p2/linux-3.10.53/Documentation/devicetree/bindings/net/sti-dwmac.txt
```
STMicroelectronics SoC DWMAC controller

The device node has following properties.

Required properties:
 - compatible	: Can be "st,stih415-dwmac", "st,stih416-dwmac" or
   "st,stid127-dwmac".
 - reg		: Offset of the glue configuration register map in system
   configuration regmap pointed by st,syscon property and size.
 - st,syscon	: Should be phandle to system configuration node which
   encompases this glue registers.
 - st,gmac_en: this is to enable the gmac into a dedicated sysctl control
   register available on STiH407 SoC.

Optional properties:
 - resets	: phandle pointing to the system reset controller with correct
   reset line index for ethernet reset.
 - st,ext-phyclk: valid only for RMII where PHY can generate 50MHz clock or
   MAC can generate it.
 - st,tx-retime-src: This specifies which clk is wired up to the mac for
   retimeing tx lines. This is totally board dependent and can take one of the
   posssible values from "txclk", "clk_125" or "clkgen".
   If not passed, the internal clock will be used by default.

Sub-nodes:
The dwmac core should be added as subnode to STMicroelectronics dwmac glue.
- dwmac :	The binding details of dwmac can be found in
  Documentation/devicetree/bindings/net/stmmac.txt

Example:

ethernet0: ethernet0{
	#address-cells = <1>;
	#size-cells = <1>;
	compatible		= "st,stih415-dwmac";
	reg			= <0x148 0x4>;
	resets			= <&softreset STIH415_ETH0_SOFTRESET>;
	st,syscon		= <&syscfg_rear>;
	st,tx-retime-src	= "clk_125";
	ranges;

	dwmac0:dwmac@fe810000 {
		device_type 	= "network";
		compatible	= "snps,dwmac", "snps,dwmac-3.610";
		reg 		= <0xfe810000 0x8000>;
		interrupts 	= <0 147 0>;
		interrupt-names = "macirq";
		...
	};
};
```

## G6/src/sdk2-sources-3.10.53.18.16.12.7_p2/linux-3.10.53/Documentation/devicetree/bindings/net/stmfp.txt
```
* STMicroelectronics 100/1000 Fastpath Ethernet driver (STMFP)

Required properties:
- compatible: Should be "st,fplite" or "st,fp"
- reg: Address and length of the register set for the device
- interrupts: Should contain the STMFP interrupts
- interrupt-names: Should contain the interrupt names "fptxdmairq"
  "fprxdma0irq", "fprxdma1irq" property
- st,fp_clk_rate : fastpath clock rate (MHz)
- reset : reset index information of sysconf
- clocks  : clocks used in fastpath driver (CLK_FP, CLK_IFE_216_FP)
- pinctrl-0 : PIO structure for FP, pinctrl_fp0 is for FP_RGMII0
  and pinctrl_fp1 is for FP_RGMII1
- phy-mode: String, operation mode of the PHY interface.
  Supported value is: "rgmii"

- fpdocsis : DOCSIS interface specific platform info (Interface node)
- fpgige0 : FPGIGE0 interface specific platform info (Interface node)
- fpgige1 : FPGIGE1 interface specific platform info (Interface node)



Interface node(fpdocsis,fpgige0,fpgige1) specific Optional properties:
- st,phy-bus-id : Mdio bus number to connect.
- st,phy-addr : phy address to connect to.

Examples:

		fpethernet:stmfp@fee80000 {
			compatible = "st,fplite";
			status = "disabled";
			device_type = "network";

			reg = <0xfee80000 0x40000>;
			interrupts = <0 101 0>, <0 102 0>, <0 103 0>;
			interrupt-names = "fptxdmairq", "fprxdma0irq", "fprxdma1irq";

			resets = <&softreset STID127_FP_SOFTRESET>;
			reset-names = "stmfpeth";

			pinctrl-names = "default";
			pinctrl-0 = <&pinctrl_fp0>, <&pinctrl_fp1>;

			clocks = <&CLOCKGEN_DOC 0>, <&CLOCKGEN_DOC 2>;
			clock-names = "CLK_FP", "CLK_IFE_216_FP";

			st,fp_clk_rate = <200>;
		};
```

## G6/src/sdk2-sources-3.10.53.18.16.12.7_p2/linux-3.10.53/Documentation/devicetree/bindings/pci/st-pcie.txt
```
STMicroelectronics STi PCIe controller

This binding describes a PCIe device.

Required properties:
 - compatible: "st,stih416-pcie"
 - device_type: Must be "pci"
 - reg: A list of physical base address and length for each set of controller
   registers. Base addresses and lengths of the pcie controller, ahb bridge
   on some SOCs, configuration space, memory window, configuration register(s).
 - reg-names: Must include the following entries:
   "pcie cntrl": PCIe control registers
   "pcie ahb": ahb bride registers; Optional, depending on SOC used
   "pcie cs": configuration space region
   "mem-window": memory made avalaible to the controller
   "syscfg0": PCIe IP configuration register
 - interrupts: A list of interrupt outputs of the controller.
 - interrupt-names: Must include the following entries:
   "pcie inta": PCI legacy INTA
   "pcie syserr": PCIe error interrupt
   "msi": STi interrupt that is asserted when an MSI is received
 - #address-cells: Must be 3
 - #size-cells: Must be 2
 - ranges: ranges for the PCI memory (non-prefetchable and prefetchable memory)
 - st,syscfg : should be a phandle of the syscfg node.
 - st,ahb-fixup: Only required when "pcie ahb" is provided as register area.
 - resets, reset-names: the power-down and soft-reset lines of PCIe IP.
   Associated names must be "powerdown" and "softreset".
 - phys, phy-names: the phandle for the PHY device.
   Associated name must be "pcie_phy"

Optional properties:
 - reset-gpio: a GPIO spec to define which pin is connected to the bus reset.

Example:

pcie1: pcie@fe800000 {
	compatible = "st,stih416-pcie";
	device_type = "pci";
	reg = <0xfe800000 0x00001000   /* cntrl registers */
	       0xfe808000 0x00000008   /* ahb registers */
	       0x2fff0000 0x00010000   /* configuration space */
	       0x40000000 0x80000000   /* lmi mem window */
	       0x82C 0x04>;            /* syscfg 2523 */
	reg-names = "pcie cntrl", "pcie ahb", "pcie cs", "mem-window",
		    "syscfg0";

	interrupts = <GIC_SPI 166 IRQ_TYPE_LEVEL_HIGH>,
		     <GIC_SPI 169 IRQ_TYPE_LEVEL_HIGH>,
		     <GIC_SPI 167 IRQ_TYPE_LEVEL_HIGH>;
	interrupt-names = "pcie inta", "pcie syserr", "msi";

	#address-cells = <3>;
	#size-cells = <2>;
	ranges = <0x82000000 0 0x20000000 0x20000000 0 0x05550000   /* non-prefetchable memory */
		  0xc2000000 0 0x25550000 0x25550000 0 0x0AAA0000>; /* prefetchable memory */
	st,syscfg = <&syscfg_rear>;
	st,ahb-fixup = <0x26C208>;

	resets		= <&powerdown STIH416_PCIE1_POWERDOWN>,
			  <&softreset STIH416_PCIE1_SOFTRESET>;
	reset-names	= "power", "softreset";

	phys = <&miphy365x_phy MIPHY365X_PCIE1_PORT1>;
	phy-names = "pcie_phy";

	status		= "disabled";
};
```
