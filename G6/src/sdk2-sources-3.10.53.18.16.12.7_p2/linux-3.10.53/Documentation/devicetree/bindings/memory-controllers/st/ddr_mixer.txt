## G6/src/sdk2-sources-3.10.53.18.16.12.7_p2/linux-3.10.53/Documentation/devicetree/bindings/phy/phy-miphy28lp.txt
```
STMicroelectronics STi MIPHY28LP PHY binding
============================================

This binding describes a miphy device that is used to control PHY hardware
for SATA, PCIe or USB3.

Required properties:
- compatible: Should be "st,miphy28lp-phy"
- #phy-cells: 1, see below
- reg: Address and length of the register set for the device
- reg-names: The names of the register addresses corresponding to the registers
   filled in "reg". Is can also contain the offset of the system configuration
   registers used as glue-logic to setup the device for SATA/PCIe or USB3
   devices.
- st,syscfg : should be a phandle of the syscfg node.
- resets, reset-names: soft-reset lines of MIPHY IP.
   Associated names must be "miphy-sw-rst".

Optional properties:
- st,osc-rdy: to check the MIPHY0_OSC_RDY status in the glue-logic. This
  is not available in all the MiPHY. For example, for STiH407, only the MiPHY0
  has this bit.
- st,osc-force-ext: to select the external oscillator. This can change from
  different MiPHY inside the same SoC.
- st,sata_gen: to select which SATA_SPDMODE has to be set in the SATA system
  config register.
- st,px_rx_pol_inv: to invert polarity of RXn/RXp (respectively negative line and positive
  line).
- st,scc-on: enable ssc on sata/pcie to reduce effects of EMI.

example:

		miphy28lp_phy0: miphy28lp@0 {
			compatible	= "st,miphy28lp-phy";
			#phy-cells	= <1>;
			reg		= <0x9b22000 0xff>,
					  <0x9b09000 0xff>,
					  <0x9b04000 0xff>,
					  <0x114 0x4>,
					  <0x818 0x4>,
					  <0xe0  0x4>,
					  <0xec  0x4>;
			reg-names	= "sata-up", "pcie-up", "pipew",
					  "miphy-ctrl-glue",
					  "miphy-status-glue",
					  "pcie-glue", "sata-glue";
			st,syscfg	= <&syscfg_core>;

			resets		= <&softreset STIH407_MIPHY0_SOFTRESET>;
			reset-names	= "miphy-sw-rst";
		};


Specifying phy control of devices
=================================

Device nodes should specify the configuration required in their "phys"
property, containing a phandle to the miphy device node and an index
specifying which configuration to use, as described in phy-bindings.txt.

example:
		sata0: sata@9b20000  {
			...
			phys		= <&miphy28lp_phy0 MIPHY28LP_SATA>;
			phy-names	= "ahci_phy";
			...
		};

Macro definitions for the supported miphy configuration can be found in:

include/dt-bindings/phy/phy-miphy28lp.h
```

## G6/src/sdk2-sources-3.10.53.18.16.12.7_p2/linux-3.10.53/Documentation/devicetree/bindings/phy/phy-miphy365x.txt
```
STMicroelectronics STi MIPHY365x PHY binding
============================================

This binding describes a miphy device that is used to control PHY hardware
for SATA and PCIe.

Required properties:
- compatible: Should be "st,miphy365x-phy"
- #phy-cells: 1, see below
- reg: Address and length of the register set for the device
- reg-names: The names of the register addresses corresponding to the registers
   filled in "reg".
- st,syscfg : should be a phandle of the syscfg node.

example:

	miphy365x_phy: miphy365x@0 {
			compatible = "st,miphy365x-phy";
			#phy-cells = <1>;
			reg =	<0xfe382000 0x100>,
				<0xfe38a000 0x100>,
				<0xfe394000 0x100>,
				<0xfe804000 0x100>;
			reg-names = "sata0", "sata1", "pcie0", "pcie1";
			st,syscfg= <&syscfg_rear>;
		};

Specifying phy control of devices
=================================

Device nodes should specify the configuration required in their "phys"
property, containing a phandle to the miphy device node and an index
specifying which configuration to use, as described in phy-bindings.txt.

example:
		sata0: sata@fe380000 {
			...
			phys		= <&miphy365x_phy MIPHY365X_SATA0_PORT0>;
			phy-names	= "miphy365x";
			...
		};
Macro definitions for the supported miphy configuration can be found in:

include/dt-bindings/phy/phy-miphy365x.h
```

## G6/src/sdk2-sources-3.10.53.18.16.12.7_p2/linux-3.10.53/Documentation/devicetree/bindings/phy/phy-stih407-usb.txt
```
ST STiH407 USB-PHY controller

This is the driver to provide the picoPHY ports for both USB2 and USB3
Host controllers available on STiH407 SoC families.

On STiH410, we have to use the DWC3 port#2 with a picoPHY to manage USB2
devices. The USB2 Controller will use the ports #0 and #1.

This is to document the DT parameters to be passed from the blob in that case.

Required properties:
- compatible : can be st,stih407-usb2-phy
- reg : Contain the offset and length of the system configuration registers
   used as glue logic to control & parameter phy.
- reg-names : The names of the system configuration registers filled in "reg".
- st,syscfg: sysconfig register to manage phy parameter at driver level.
- resets, reset-names: to reset the whole phy / port.

Example:
usb2_picophy0: usbpicophy@0 {
	compatible = "st,stih407-usb2-phy";
	reg =	<0xf8 0x04>,	/* syscfg 5062 */
		<0xf4 0x04>;    /* syscfg 5061 */
	reg-names =	"param",
			"ctrl";
	#phy-cells = <0>;

	st,syscfg = <&syscfg_core>;
	resets = <&softreset STIH407_PICOPHY_SOFTRESET>,
		 <&picophyreset STIH407_PICOPHY0_RESET>;
	reset-names = "global",
		      "port";
};

usb2_picophy1: usbpicophy@1 {
	compatible = "st,stih407-usb2-phy";
	#phy-cells = <0>;
	reg =	<0xfc 0x04>,	/* syscfg 5063 */
		<0xf4 0x04>;    /* syscfg 5061 */
	reg-names =	"param",
			"ctrl";

	st,syscfg = <&syscfg_core>;
	resets = <&softreset STIH407_PICOPHY_SOFTRESET>,
		 <&picophyreset STIH407_PICOPHY1_RESET>;
	reset-names = "global",
		      "port";
};

usb2_picophy2: usbpicophy@2 {
	compatible = "st,stih407-usb2-phy";
	#phy-cells = <0>;
	reg =	<0x100 0x04>,	/* syscfg 5064 */
		<0xf4 0x04>;    /* syscfg 5061 */
	reg-names =	"param",
			"ctrl";

	st,syscfg = <&syscfg_core>;
	resets = <&softreset STIH407_PICOPHY_SOFTRESET>,
		 <&picophyreset STIH407_PICOPHY2_RESET>;
	reset-names = "global",
		      "port";
};
```

## G6/src/sdk2-sources-3.10.53.18.16.12.7_p2/linux-3.10.53/Documentation/devicetree/bindings/phy/phy-stih41x-usb.txt
```
STMicroelectronics STIH41x USB PHY binding
------------------------------------------

Required properties:
- compatible : should be "st,stih416-usb-phy" or "st,stih415-usb-phy";
- st,syscfg : should be a phandle of the syscfg node.
- clock-names : Must contain "osc_phy".
- clocks : Must contain an entry for each name in clock-names. See the common
  clock bindings.
- #phy-cells : from the generic phy bindings, must be 0 for this phy;

Example:
usb2_phy: usb2phy@0 {
	compatible = "st,stih416-usb-phy";
	#phy-cells = <0>;

	st,syscfg	= <&syscfg_rear>;

	clocks		= <&CLK_SYSIN>;
	clock-names	= "osc_phy";
};
```

## G6/src/sdk2-sources-3.10.53.18.16.12.7_p2/linux-3.10.53/Documentation/devicetree/bindings/power/st_lpm.txt
```
ST LPM Device
-------------

Required properties:
- compatible: should be "st,lpm" for non 407 family SoCs, while it
	      should be "st,stih407-family-lpm" as well as "st,lpm"
	      for 407-family SoCs.
- reg: There are 4 address-size list property. The first one refer to
       the base of the SBC controller. The second one refer to the
       mailbox address and size. Third one refer to the
       configuration registers and the last one refer to the pmem area
       where normally the LPM-f/w has to be loaded and ran from.
- reg-names: Should list the registers names
- interrupts: Standrard interrupt line and type description.

- gpios: A list property, first cell containing the phandle to the gpio
	 port and the second one describes the pin number, that is passed
	 as a parameter to the phandle. This is the gpio pin that is used
	 to switch on/off the SoC power domain by the SBC controller.

- st,lmi-ret-gpio: As the name suggests, this describes the list property
		   describing the gpio pin responsible for lmi retention
		   during the CPS. The first cell contains the phandle to the
		   gpio port and the second one describes the pin number.
- st,fw_name : Should contains the LPM Firmware name

Properties such as compatible, reg, interrupts, st,fw_name typically goes to
the chip description DT file, while gpios and st,lmi-ret-gpio typically goes
to the board description DT file. 

Example:
	lpm:stm-lpm@9400000 {
		compatible = "st,stih407-family-lpm", "st,lpm";
		reg = <0x9400000 0xa0000>,
		<0x94b4000 0x400>,
		<0x94b5100 0x100>,
		<0x020000 0x0>;
		reg-names = "base", "mailbox", "confreg", "pmem";
		interrupts = <GIC_SPI 144 IRQ_TYPE_NONE>;
		st,fw_name = "lpm-fw-STiH407.elf";
		status = "disabled";
	};

	lpm:stm-lpm@9400000 {
		status = "okay";
		gpios = <&PIO3 2>;
		st,lmi-ret-gpio = <&PIO5 2>;
	};
```

## G6/src/sdk2-sources-3.10.53.18.16.12.7_p2/linux-3.10.53/Documentation/devicetree/bindings/pwm/pwm-st.txt
```
Binding for PWM driver for STMicroelectronics SoCs.

Required parameters:
- compatible : st,pwm
- #pwm-cells : number of cells used to specify a PWM.First cell specifies the per-chip
		index of the PWM to use and the second cell is the period in nanoseconds.
		Fixed to 2 for STiH41x.
- reg : physical base address and length of the controller's registers.
- pinctrl-names: Set to "default".
- pinctrl-0: List of phandles pointing to pin configuration nodes for PWM module.
	      For (4) & (5), please refer the following binding doc:
	      Documentation/devicetree/bindings/pinctrl/pinctrl-bindings.txt
- clock-names: Set to "pwm".
- clocks: phandle of the clock used by the PWM module.
	   For (6) & (7), please refer the following binding doc:
	   Documentation/devicetree/bindings/clock/clock-bindings.txt
Optional properties:
- st,pwm-num-chan: number of available channels. If not passed the driver will
  consider single channel by default.

Example:
pwm1: pwm@fe510000 {
	compatible = "st,pwm";
	#pwm-cells = <2>;
	reg = <0xfe510000 0x68>;
	pinctrl-names = "default";
	pinctrl-0 = <&pinctrl_pwm1_chan0_default
		     &pinctrl_pwm1_chan1_default
		     &pinctrl_pwm1_chan2_default
		     &pinctrl_pwm1_chan3_default>;
	clock-names = "pwm";
	clocks = <&CLK_SYSIN>;
	st,pwm-num-chan = <4>;
};
```

## G6/src/sdk2-sources-3.10.53.18.16.12.7_p2/linux-3.10.53/Documentation/devicetree/bindings/regulator/st-flashss.txt
```
ST Voltage regulator for FlashSS vsense

This is the voltage regulator driver to manage the vsense inside the ST flash
sub-system that is used for configuring MMC, NAND, SPI voltages.

Required properties:
- compatible: can be "st,vmmc", "st,vnand" or "st,vspi" because it is shared
  among these devices inside the ST FlashSS. Currently it is only tested on
  MMC.

Required properties:
- regulator-name: regulator name.
- reg: is the vsense top config base address in the flashSS hardware.

Any property defined as part of the core regulator
binding, defined in regulator.txt, can also be used.

Example:

vmmc_reg: voltage-regulator {
	compatible = "st,vmmc";
	regulator-name = "vmmc0";
	reg = <0x9061004 0x4>;
};
```

## G6/src/sdk2-sources-3.10.53.18.16.12.7_p2/linux-3.10.53/Documentation/devicetree/bindings/remoteproc/st-rproc.txt
```
STMicroelectronics remote processor support
===========================================================================

This binding provides support for adjunct processors found on ST SoCs.
The remote processors can be started/stopped by the Linux driver, or they can
be started by a boot loader (and thus are already be running when Linux
starts). The driver detects if a remote processor is already running.

The node name is significant, as it defines the name of the CPU and the name
of the firmware to load: rproc-<name>-fw.

Required properties:
- compatible: Must contain "st,rproc".
- boot_addr: The register that holds the boot vector for the CPU.
	The format for this is <regmap_phandle reg lsb msb>, with
	regmap_phandle: reference to a "syscon" node.
	reg: register offset in the regmap.
	lsb: least significant bit to use.
	msb: most significant bit to use.
- resets, reset-names: the soft-reset lines for the CPU.
	Associated names must be "manual_reset" and "power_reset".

Optional properties:
- interrupts: interrupt-specifier for the watchdog interrupt generated by the
	CPU. Refer to Documentation/devicetree/bindings/resource-names.txt

Example node:

cpu1@0 {
	compatible	= "st,rproc";
	boot_addr	= <&syscfg_cpu 0x98 0 28>;
	resets		= <&softreset 0>, <&softreset 1>;
	reset-names	= "manual_reset", "power_reset";
	interrupts	=  <0 38 0>;
};
```

## G6/src/sdk2-sources-3.10.53.18.16.12.7_p2/linux-3.10.53/Documentation/devicetree/bindings/reset/st,sti-picophyreset.txt
```
STMicroelectronics STi family Sysconfig Picophy SoftReset Controller
=============================================================================

This binding describes a reset controller device that is used to enable and
disable on-chip PicoPHY USB2 phy(s) using "softreset" control bits found in
the STi family SoC system configuration registers.

The actual action taken when softreset is asserted is hardware dependent.
However, when asserted it may not be possible to access the hardware's
registers and after an assert/deassert sequence the hardware's previous state
may no longer be valid.

Please refer to reset.txt in this directory for common reset
controller binding usage.

Required properties:
- compatible: Should be "st,<chip>-softreset"
- #reset-cells: 1, see below

example:

	picophyreset: picophyreset-controller {
		#reset-cells = <1>;
		compatible = "st,stih407-picophyreset";
	};

Specifying picophyreset control of devices
=======================================

Device nodes should specify the reset channel required in their "resets"
property, containing a phandle to the picophyreset device node and an
index specifying which channel to use, as described in reset.txt

example:
	usb2_picophy0: usbpicophy@0 {
		resets = <&picophyreset STIH407_PICOPHY0_RESET>;
	};

Macro definitions for the supported reset channels can be found in:
include/dt-bindings/reset-controller/stih407-resets.h
```

## G6/src/sdk2-sources-3.10.53.18.16.12.7_p2/linux-3.10.53/Documentation/devicetree/bindings/rng/st,rng.txt
```
Random number generator driver for STMicroelectronics STiH41x series of SoCs.

Required parameters:
1) compatible	: should be "st,rng"
2) reg		: Base address of the HW IP and Size of its memory map.
3) clock	: Input Clock

Example:
rng0{
	compatible      = "st,rng";
	reg		= <0xfee80000 0x1000>;
	clocks          = <&CLK_SYSIN>;
}
```

## G6/src/sdk2-sources-3.10.53.18.16.12.7_p2/linux-3.10.53/Documentation/devicetree/bindings/rtc/rtc-st-lpc.txt
```
* ST LPC RTC

Required properties:
- compatible : "st,lpc-rtc"
- interrupt-parent: controller from which depends the IRQ
- reg : Address range of the rtc registers
- interrupts: Should contain the rtc interrupt number
- clock-names : Should be "lpc_rtc"
- clocks: Clock used by RTC device

Example:

	rtc@0xfde05000 {
	        compatible = "st,lpc-rtc";
		interrupt-parent = <&intc>;
	        reg = <0xfde05000 0x1000>;
		interrupts = <GIC_SPI 118 IRQ_TYPE_EDGE_RISING>;
		clock-names = "lpc_rtc";
		clocks		= <&CLK_M_MPETHSENS>;
	};
```

## G6/src/sdk2-sources-3.10.53.18.16.12.7_p2/linux-3.10.53/Documentation/devicetree/bindings/rtc/rtc-st-sbc.txt
```
* ST SBC RTC

Required properties:
No special parameters except the compatible one
- compatible : "st,rtc-sbc"

Example:

	rtc_sbc@0 {
	        compatible = "st,rtc-sbc";
	};
```

## G6/src/sdk2-sources-3.10.53.18.16.12.7_p2/linux-3.10.53/Documentation/devicetree/bindings/sound/stm-audio-glue.txt
```
===============================================================================
			stm audio glue
===============================================================================

Required properties:
- compatible   : board type, Should be "st,snd_audio_glue_<soc>",
- st,syscfg	: phandle to sysconf registers bank to power on/off the device

Typical usage example:

snd_audio_glue: snd-audio-glue {
			compatible	= "st,snd_audio_glue_stih416";
			status		= "okay";
			st,syscfg	= <&syscfg_rear>;
		};
```
