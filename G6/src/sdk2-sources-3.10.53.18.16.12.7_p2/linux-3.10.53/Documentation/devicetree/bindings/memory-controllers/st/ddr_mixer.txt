## G6/src/sdk2-sources-3.10.53.18.16.12.7_p2/linux-3.10.53/Documentation/devicetree/bindings/sound/stm-conv-biphase.txt
```
===============================================================================
			stm bi-phase formatter converter
===============================================================================

Required properties:
- compatible	 : Should be "st,snd_conv_biphase_<soc>".
- source-bus-id  : Player device is attached to.
- channel-to	 : Output channel (usually 1).
- channel-from	 : Input channel (usually 0).
- idle-value	 : Bi-phase formatter idle value (usually 0)
- st,syscfg 	 : phandle to Sysconf registers bank to enable/disable bi-phase formatter

Optional properties
- format		: Bitmask of the supported converter audio format
- oversampling		: Number of time oversampling (default is 256)

Typical usage example:

snd_conv_biphase: snd-conv-biphase {
			compatible	= "st,snd_conv_biphase_stih416";
			status		= "disabled";
			source-bus-id	= "snd_uni_player.3";
			channel-to	= <1>;
			channel-from	= <0>;
			idle-value	= <0>;
			st,syscfg	= <&syscfg_rear>;
		};
```

## G6/src/sdk2-sources-3.10.53.18.16.12.7_p2/linux-3.10.53/Documentation/devicetree/bindings/sound/stm-conv-dac-buffer.txt
```
===============================================================================
			stm dac sysconf converter
===============================================================================

Required properties:
- compatible	: Should be "st,snd_conv_dac_buf_<dac_buffer>".
- source-bus-id	: Player device is attached to.
- reg		: Dac buffer register address on I2C bus
- st,buffer-gain : gain to be used

The differents values that can be used for gain are :
 0 => 0db
 1 => +6dB
 2 => +12dB
 3 => +16dB
 4 => +20dB
 5 => +24dB
 6 => +26dB
 7 => +28dB

Typical usage example:

i2c@fed40000 {
	status = "okay";
	#address-cells = <1>;
	#size-cells = <0>;

	snd_dac_buffer@4a {
		compatible = "st,snd_dac_buf_st6440";
		reg = <0x4a>;
		st,source-bus-id = <&snd_uni_player2>;
		st,buffer-gain = <5>;
	};
};
```

## G6/src/sdk2-sources-3.10.53.18.16.12.7_p2/linux-3.10.53/Documentation/devicetree/bindings/sound/stm-conv-dac-sc.txt
```
===============================================================================
			stm dac sysconf converter
===============================================================================

Required properties:
- compatible	: Should be "st,snd_conv_dac_sc_<soc>".
- source-bus-id	: Player device is attached to.
- channel-to	: Output channel (usually 1).
- channel-from	: Input channel (usually 0).
- st,syscfg    : phandle to Sysconf registers bank to access the DAC related registers:

Typical usage example:

snd_conv_dac_sc: snd-conv-dac-sc {
			compatible	= "st,snd_conv_dac_sc_stih416";
			status		= "disabled";
			source-bus-id	= "snd_uni_player.2";
			channel-to	= <1>;
			channel-from	= <0>;
			st,syscfg	= <&syscfg_rear>;
		};
```

## G6/src/sdk2-sources-3.10.53.18.16.12.7_p2/linux-3.10.53/Documentation/devicetree/bindings/sound/stm-uni-player.txt
```
===============================================================================
			stm uniperipheral player
===============================================================================

Required properties:
- compatible		: Should be "st,snd_uni_player"
- reg, reg-names, interrupts, interrupt-names	: Standard way to define device
			resources with names. look in
			Documentation/devicetree/bindings/resource-names.txt
- version		: IP version
- dmas			: phandle of FDMA serving this player
- dma-names		: Name of FDMA serving this player
- fdma-initiator	: Initiator type
- fdma-direct-conn	: DREQ is connected directly to FDMA (i.e. no DREQ mux)
- fdma-request-line	: Request line used by FDMA
- description		: Player description
- card-device		: ALSA card sub-device id
- mode			: Player mode (hdmi or pcm or spdif)
- iec958-lr-pol		: IEC958 device (hdmi/spdif) player LR polarity
			  (0=low, 1=high). Not used for players in pcm mode!
- iec958-i2s-mode	: IEC958 device (hdmi/spdif) player I2S mode.
			  (0=I2S, 1=Sony). Not used for players in pcm mode!
- channels		: Maximum number of output channels
- parking		: Enable parking mode
- standby		: Enable standby mode
- underflow		: Enable underflow recovery mode
- s16-swap-lr		: Swap left/right channels for S16 data
- pinctrl-names		: pin control name
- pinctrl-0		: pin control configuration defiend in pinctrl dtsi
- clocks		: handle of the player clock defiend in clock dtsi
- clock-names		: name of the player clock


Typical usage example:

snd_uni_player0: snd-uni-player@0xfe285000 {
	compatible	= "st,snd_uni_player";
	status		= "disabled";
	reg		= <0xfe285000 0x150>;
	interrupts	= <0 67 0>;
	version		= <0>;
	dmas		= <&fdma0_sas>;
	dma-names	= "stm-fdma.3";
	fdma-initiator	= <0>;
	fdma-request-line = <37>;
	description	= "Uni Player #0 (DAC)";
	card-device	= <0>;
	mode		= "PCM";
	channels	= <2>;
	parking		= <0>;
	pinctrl-names	= "default";
	pinctrl-0	= <&pinctrl_snd_uni_player3>;
	clocks 		= <&CLK_S_PCM_0>;
	clock-names 	= "uni_player_clk";
};
```
